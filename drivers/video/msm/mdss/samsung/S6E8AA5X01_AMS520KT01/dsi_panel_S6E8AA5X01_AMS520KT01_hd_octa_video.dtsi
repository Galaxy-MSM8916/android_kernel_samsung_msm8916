/* Copyright (c) 2013-2014, The Linux Foundation. All rights reserved.
 *
 * This program is free software; you can redistribute it and/or modify
 * it under the terms of the GNU General Public License version 2 and
 * only version 2 as published by the Free Software Foundation.
 *
 * This program is distributed in the hope that it will be useful,
 * but WITHOUT ANY WARRANTY; without even the implied warranty of
 * MERCHANTABILITY or FITNESS FOR A PARTICULAR PURPOSE.  See the
 * GNU General Public License for more details.
 */

/*---------------------------------------------------------------------------
 * This file is autogenerated file using gcdb parser. Please do not edit it.
 * Update input XML file to add a new entry or update variable in this file
 * VERSION = "1.0"
 *---------------------------------------------------------------------------

 */
&mdss_mdp {
	ss_dsi_panel_S6E8AA5X01_AMS520KT01_HD: ss_dsi_panel_S6E8AA5X01_AMS520KT01_HD {
		qcom,mdss-dsi-panel-name = "ss_dsi_panel_S6E8AA5X01_AMS520KT01_HD";
		qcom,mdss-dsi-panel-controller = <&mdss_dsi0>;
		qcom,mdss-dsi-panel-type = "dsi_video_mode";
		qcom,mdss-dsi-panel-destination = "display_1";
		qcom,cont-splash-enabled;
		qcom,mdss-dsi-panel-framerate = <60>;
		qcom,mdss-dsi-virtual-channel-id = <0>;
		qcom,mdss-dsi-stream = <0>;
		qcom,mdss-dsi-panel-width = <720>;
		qcom,mdss-dsi-panel-height = <1280>;
		qcom,mdss-pan-physical-width-dimension = <65>; /* <Width> real size of panel in mm */
		qcom,mdss-pan-physical-height-dimension = <115>; /*<Height> real size of panel in mm */
		qcom,mdss-dsi-lp11-init;
		qcom,mdss-dsi-init-delay-us = <2000>;
		qcom,mdss-dsi-h-front-porch = <224>;
		qcom,mdss-dsi-h-back-porch = <100>;
		qcom,mdss-dsi-h-pulse-width = <20>;
		qcom,mdss-dsi-h-sync-skew = <0>;
		qcom,mdss-dsi-v-back-porch = <8>;
		qcom,mdss-dsi-v-front-porch = <14>;
		qcom,mdss-dsi-v-pulse-width = <2>;
		qcom,mdss-dsi-h-left-border = <0>;
		qcom,mdss-dsi-h-right-border = <0>;
		qcom,mdss-dsi-v-top-border = <0>;
		qcom,mdss-dsi-v-bottom-border = <0>;
		qcom,mdss-dsi-bpp = <24>;
		qcom,mdss-dsi-color-order = "rgb_swap_rgb";
		qcom,mdss-dsi-underflow-color = <0xFF>;
		qcom,mdss-dsi-border-color = <0>;
		qcom,mdss-dsi-dma-trigger = "trigger_sw";
		qcom,mdss-dsi-mdp-trigger = "none";
		qcom,esd-check-enabled;
		qcom,mdss-dsi-panel-status-check-mode="reg_read_irq";
		qcom,mdss-dsi-panel-status-irq-trigger="rising";
		qcom,mdss-dsi-bl-min-level = <1>;
		qcom,mdss-dsi-bl-max-level = <255>;
		qcom,mdss-dsi-bl-pmic-control-type = "bl_ctrl_dcs";
		qcom,mdss-dsi-lane-0-state;
		qcom,mdss-dsi-lane-1-state;
		qcom,mdss-dsi-lane-2-state;
		qcom,mdss-dsi-lane-3-state;
		qcom,mdss-dsi-bllp-eof-power-mode;
		qcom,mdss-dsi-bllp-power-mode;
		qcom,mdss-dsi-traffic-mode = "burst_mode";
		qcom,mdss-dsi-force-clk-lane-hs;
		qcom,mdss-dsi-reset-sequence = <1 5>, <0 1>, <1 10>;
		qcom,mdss-dsi-h-sync-pulse = <0>;
		qcom,mdss-dsi-hfp-power-mode;
		qcom,mdss-dsi-panel-timings = [8B 1E 14 00 44 4A 18 28 19 03 04 00];
		qcom,mdss-dsi-t-clk-pre = <0x1C>;
		qcom,mdss-dsi-t-clk-post = <0x04>;
		qcom,mdss-dsi-pixel-packing = "loose";
		qcom,mdss-dsi-lane-map = "lane_map_0123";
		qcom,mdss-dsi-on-command-state = "dsi_lp_mode";
		qcom,mdss-dsi-off-command-state = "dsi_hs_mode";
		qcom,mdss-dsi-rx-eot-ignore;
		qcom,mdss-dsi-tx-eot-append;
		qcom,mdss-dsi-on-command = [
			39 00 00 00 00 00 03 F0 5A 5A /* Tesk key ON */
			39 01 00 00 00 00 02 CC 4C /* PCD Polarity Setting */
			05 01 00 00 14 00 02 11 00 /* Sleep out  wait 20ms */

			39 00 00 00 00 00 22 /* 360nit 2.0 Gamma */
			CA 01 00 01 00 01 00 /* V255 R,G,B*/
			80 80 80 /* V203 R,G,B*/
			80 80 80 /* V151 R,G,B*/
			80 80 80 /* V87 R,G,B*/
			80 80 80 /* V51 R,G,B*/
			80 80 80 /* V35 R,G,B*/
			80 80 80 /* V23 R,G,B*/
			80 80 80 /* V11 R,G,B*/
			80 80 80 /* V3 R,G,B*/
			00 00 00 /* VT R,G,B*/

			39 00 00 00 00 00 03 B2 04 EE /* AID setting *//* AOR 96.78% */
			39 00 00 00 00 00 03 B6 AC 0F /* ELVSS */

			39 01 00 00 10 00 02 F7 03 /* gamma upate */

			39 00 00 00 00 00 04 C0 D8 D8 40 /* pentile setting */
			39 00 00 00 00 00 02 B0 06 /* global para */
			39 00 00 00 78 00 02 B8 A8 /* De_DIM setting */

			39 01 00 00 00 00 03 F0 A5 A5 /* Tesk key OFF */
		];

		qcom,mdss-dsi-off-command = [
			05 01 00 00 00 00 02 28 00
			05 01 00 00 78 00 02 10 00
		];

/*
* ************************************************************************************************************************************
*
*
*			Below  parameters are samsung dependent thigs
*
*
* ************************************************************************************************************************************
*/
		/*samsung,support_factory_panel_swap;*/
		/**************************************************
		*			RX CMDS
		* samsung,mdnie_read_rx_cmds_revA = [ 06 01 00 00 00 00 01 D7 04 03];
		* D7 = register address, 04 = size, 03 = start postion
		***************************************************/
		samsung,manufacture_id0_rx_cmds_revA = [ 06 01 00 00 00 00 01 da 01 00];
		samsung,manufacture_id1_rx_cmds_revA = [ 06 01 00 00 00 00 01 db 01 00];
		samsung,manufacture_id2_rx_cmds_revA = [ 06 01 00 00 00 00 01 dc 01 00];

		samsung,smart_dimming_mtp_rx_cmds_revA = [ 06 01 00 00 00 00 01 C8 21 00];

		samsung,ddi_id_rx_cmds_revA = [06 01 00 00 00 00 01 D5 05 00 ];

		samsung,mtp_read_sysfs_rx_cmds_revA = [ 06 01 00 00 00 00 01 01 01 01];

		samsung,mdnie_read_rx_cmds_revA = [ 06 01 00 00 00 00 01 D7 04 03];

		samsung,manufacture_date_rx_cmds_revA = [ 06 01 00 00 00 00 01 B5 02 17];	/* read B6 24~25th , 23=0x17*/

		samsung,hbm_rx_cmds_revA = [ 06 01 00 00 00 00 01 C8 06 21];	/* read C8h 34th~39th , 33=0x21*/
		samsung,cell_id_rx_cmds_revA = [06 01 00 00 00 00 01 C8 07 28];     /* read C8 41~47th , 40=0x28 */
		samsung,hbm2_rx_cmds_revA = [ 06 01 00 00 00 00 01 C8 0F 48];	/* read C8h 73th~87th , 72=0x48*/
		samsung,elvss_rx_cmds_revA = [ 06 01 00 00 00 00 01 b6 01 15];	/* read C6 22th , 21=0x15*/

		samsung,outdoor_mode_support;

		/**************************************************
		*			TX CMDS
		***************************************************/
		samsung,display_on_tx_cmds_revA = [05 01 00 00 00 00 02 29 00];

		samsung,packet_size_tx_cmds_revA = [37 01 00 00 00 00 02 07 00];

		samsung,reg_read_pos_tx_cmds_revA = [15 01 00 00 00 00 02 B0 00];

		samsung,level1_key_enable_tx_cmds_revA = [
			29 01 00 00 00 00 03 F0 5A 5A
		];
		samsung,level1_key_disable_tx_cmds_revA = [
			29 01 00 00 00 00 03 F0 A5 A5
		];
		samsung,level2_key_enable_tx_cmds_revA = [
			29 01 00 00 00 00 03 F0 5A 5A
		];
		samsung,level2_key_disable_tx_cmds_revA = [
			29 01 00 00 00 00 03 F0 A5 A5
		];

		samsung,gamma_tx_cmds_revA = [
			39 01 00 00 00 00 22	/* Brightness Condition Set - Gamma 2.2 Setting*/
			CA 01 00 01 00 01 00
			80 80 80 80 80 80 80
			80 80 80 80 80 80 80
			80 80 80 80 80 80 80
			80 80 80 00 00 00

			39 01 00 00 10 00 02 F7 03	/* gamma upate */
		];

		samsung,hbm_gamma_tx_cmds_revA = [
			39 01 00 00 00 00 23            /* Brightness Condition Set - Gamma 2.2 Setting*/
			B4 0B
			FF FF FF
			FF FF FF
			FF FF FF
			FF FF FF
			FF FF FF
			FF FF FF
			FF FF FF
			80 80 80
			80 80 80
			80 80 80
			00 00 00
		];

		samsung,hbm_etc_tx_cmds_revA = [
			39 01 00 00 00 00 03 B6 BC 0F	/* MPS/ELVSS Setting */
			39 01 00 00 00 00 02 B5 50		/* OPR Average Calculation */
			39 01 00 00 00 00 02 53 C0		/* HBM Control */
			39 01 00 00 00 00 02 55 02		/* 0x02 : ACL 15% on */
			39 01 00 00 01 00 02 F7 03		/* gamma upate */
		];

		samsung,hbm_off_tx_cmds_revA = [
			39 01 00 00 00 00 02 53 00
		];

		/*
		* ************************************************************************************************************************
		* AID command list and mappings
		* ************************************************************************************************************************
		*/
		samsung,aid_tx_cmds_revA = [
			39 01 00 00 00 00 03 B2 04 EE   /* 00 samsung_brightness aor 96.78% */
			39 01 00 00 00 00 03 B2 04 E1   /* 01 samsung_brightness aor 95.78% */
			39 01 00 00 00 00 03 B2 04 D2   /* 02 samsung_brightness aor 94.63% */
			39 01 00 00 00 00 03 B2 04 CE   /* 03 samsung_brightness aor 94.33% */
			39 01 00 00 00 00 03 B2 04 C0   /* 04 samsung_brightness aor 93.25% */
			39 01 00 00 00 00 03 B2 04 B3   /* 05 samsung_brightness aor 92.25% */
			39 01 00 00 00 00 03 B2 04 AE   /* 06 samsung_brightness aor 91.87% */
			39 01 00 00 00 00 03 B2 04 A3   /* 07 samsung_brightness aor 91.03% */
			39 01 00 00 00 00 03 B2 04 93   /* 08 samsung_brightness aor 89.80% */
			39 01 00 00 00 00 03 B2 04 8E   /* 09 samsung_brightness aor 89.42% */
			39 01 00 00 00 00 03 B2 04 80   /* 10 samsung_brightness aor 88.34% */
			39 01 00 00 00 00 03 B2 04 75   /* 11 samsung_brightness aor 87.50% */
			39 01 00 00 00 00 03 B2 04 6A   /* 12 samsung_brightness aor 86.66% */
			39 01 00 00 00 00 03 B2 04 52   /* 13 samsung_brightness aor 84.82% */
			39 01 00 00 00 00 03 B2 04 42   /* 14 samsung_brightness aor 83.59% */
			39 01 00 00 00 00 03 B2 04 3E   /* 15 samsung_brightness aor 83.28% */
			39 01 00 00 00 00 03 B2 04 2A   /* 16 samsung_brightness aor 81.75% */
			39 01 00 00 00 00 03 B2 04 10   /* 17 samsung_brightness aor 79.75% */
			39 01 00 00 00 00 03 B2 04 00   /* 18 samsung_brightness aor 78.53% */
			39 01 00 00 00 00 03 B2 03 E2   /* 19 samsung_brightness aor 76.23% */
			39 01 00 00 00 00 03 B2 03 C4   /* 20 samsung_brightness aor 73.93% */
			39 01 00 00 00 00 03 B2 03 B4   /* 21 samsung_brightness aor 72.70% */
			39 01 00 00 00 00 03 B2 03 9F   /* 22 samsung_brightness aor 71.09% */
			39 01 00 00 00 00 03 B2 03 83   /* 23 samsung_brightness aor 68.94% */
			39 01 00 00 00 00 03 B2 03 61   /* 24 samsung_brightness aor 66.33% */
			39 01 00 00 00 00 03 B2 03 43   /* 25 samsung_brightness aor 64.03% */
			39 01 00 00 00 00 03 B2 03 2E   /* 26 samsung_brightness aor 62.42% */
			39 01 00 00 00 00 03 B2 03 06   /* 27 samsung_brightness aor 59.36% */
			39 01 00 00 00 00 03 B2 02 E0   /* 28 samsung_brightness aor 56.44% */
			39 01 00 00 00 00 03 B2 02 BE   /* 29 samsung_brightness aor 53.83% */
			39 01 00 00 00 00 03 B2 02 92   /* 30 samsung_brightness aor 50.46% */
			39 01 00 00 00 00 03 B2 02 6F   /* 31 samsung_brightness aor 47.78% */
			39 01 00 00 00 00 03 B2 02 3B   /* 32 samsung_brightness aor 43.76% */
			39 01 00 00 00 00 03 B2 02 11   /* 33 samsung_brightness aor 40.57% */
			39 01 00 00 00 00 03 B2 01 F2   /* 34 samsung_brightness aor 38.19% */
			39 01 00 00 00 00 03 B2 01 F0   /* 35 samsung_brightness aor 38.04% */
			39 01 00 00 00 00 03 B2 01 BE   /* 36 samsung_brightness aor 34.20% */
			39 01 00 00 00 00 03 B2 01 80   /* 37 samsung_brightness aor 29.45% */
			39 01 00 00 00 00 03 B2 01 3F   /* 38 samsung_brightness aor 24.46% */
			39 01 00 00 00 00 03 B2 00 F4   /* 39 samsung_brightness aor 18.71% */
			39 01 00 00 00 00 03 B2 00 AC   /* 40 samsung_brightness aor 13.19% */
			39 01 00 00 00 00 03 B2 00 5E   /* 41 samsung_brightness aor 07.21% */
			39 01 00 00 00 00 03 B2 00 0F   /* 42 samsung_brightness aor 1.15% */
		];

		samsung,aid_map_table_revA = <
			5	0		6	1		7	2		8	3		9	4
			10	5		11	6		12	7		13	8		14	9
			15	10		16	11		17	12		19	13		20	14
			21	15		22	16		24	17		25	18		27	19
			29	20		30	21		32	22		34	23		37	24
			39	25		41	26		44	27		47	28		50	29
			53	30		56	31		60	32		64	33		68	34
			72	34		77	34		82	34		87	34		93	34
			98	34		105	34		111	34		119	35		126	36
			134	37		143	38		152	39		162	40		172	41
			183	42		195	42		207	42		220	42		234	42
			249	42		265	42		282	42		300	42		316	42
			333	42		360	42
		>;

		/*
		* ************************************************************************************************************************
		* ACL command list and mappings
		* ************************************************************************************************************************
		*/

		samsung,acl_on_tx_cmds_revA = [
			39 01 00 00 00 00 02 B5 50
			39 01 00 00 00 00 02 55 02
		];

		samsung,acl_off_tx_cmds_revA = [
			39 01 00 00 00 00 02 B5 40
			39 01 00 00 00 00 02 55 00
		];

		/*
		* ************************************************************************************************************************
		* ELVSS(ACL Off) command list and mappings
		* ************************************************************************************************************************
		*/

		samsung,elvss_lowtemp_tx_cmds_revA = [
			29 01 00 00 00 00 02 B0 07
			29 01 00 00 00 00 02 B8 00
		];	/* Low Temperature Command */

		samsung,elvss_lowtemp2_tx_cmds_revA = [
			29 01 00 00 00 00 02 B0 15
			29 01 00 00 00 00 02 B6 00
		];	/* Low Temperature Command: default */

		samsung,elvss_tx_cmds_revA = [
			39 01 00 00 00 00 03 B6 AC 0F /* 0 DEFAULT_ELVSS(0x0F) */
			39 01 00 00 00 00 03 B6 AC 11 /* 1 DEFAULT_ELVSS(0x11) */
			39 01 00 00 00 00 03 B6 AC 13 /* 2 DEFAULT_ELVSS(0x13) */
			39 01 00 00 00 00 03 B6 AC 15 /* 3 DEFAULT_ELVSS(0x15) */
			39 01 00 00 00 00 03 B6 AC 17 /* 4 DEFAULT_ELVSS(0x17) */
			39 01 00 00 00 00 03 B6 AC 19 /* 5 DEFAULT_ELVSS(0x19) */
			39 01 00 00 00 00 03 B6 AC 1C /* 6 DEFAULT_ELVSS(0x1C) */
			39 01 00 00 00 00 03 B6 AC 1F /* 7 DEFAULT_ELVSS(0x1F) */
			39 01 00 00 00 00 03 B6 BC 1F /* 8 DEFAULT_ELVSS(0x1F) */
			39 01 00 00 00 00 03 B6 BC 1E /* 9 DEFAULT_ELVSS(0x1E) */
			39 01 00 00 00 00 03 B6 BC 1D /* 10 DEFAULT_ELVSS(0x1D) */
			39 01 00 00 00 00 03 B6 BC 1C /* 11 DEFAULT_ELVSS(0x1C) */
			39 01 00 00 00 00 03 B6 BC 1B /* 12 DEFAULT_ELVSS(0x1B) */
			39 01 00 00 00 00 03 B6 BC 19 /* 13 DEFAULT_ELVSS(0x19) */
			39 01 00 00 00 00 03 B6 BC 18 /* 14 DEFAULT_ELVSS(0x18) */
			39 01 00 00 00 00 03 B6 BC 17 /* 15 DEFAULT_ELVSS(0x17) */
			39 01 00 00 00 00 03 B6 BC 16 /* 16 DEFAULT_ELVSS(0x16) */
			39 01 00 00 00 00 03 B6 BC 15 /* 17 DEFAULT_ELVSS(0x15) */
			39 01 00 00 00 00 03 B6 BC 14 /* 18 DEFAULT_ELVSS(0x14) */
			39 01 00 00 00 00 03 B6 BC 13 /* 19 DEFAULT_ELVSS(0x13) */
			39 01 00 00 00 00 03 B6 BC 12 /* 20 DEFAULT_ELVSS(0x12) */
			39 01 00 00 00 00 03 B6 BC 11 /* 21 DEFAULT_ELVSS(0x11) */
			39 01 00 00 00 00 03 B6 BC 0F /* 22 DEFAULT_ELVSS(0x0F) */
		];
		/* bl_level, Index in elvss command list */
		samsung,smart_acl_elvss_map_table_revA = <
			5	0		6	0		7	0		8	0		9	0
			10	0		11	0		12	0		13	0		14	0
			15	0		16	0		17	0		19	0		20	0
			21	1		22	2		24	3		25	4		27	5
			29	6		30	7		32	7		34	7		37	7
			39	7		41	8		44	8		47	8		50	8
			53	8		56	8		60	8		64	8		68	8
			72	8		77	9		82	9		87	9		93	9
			98	9		105	10		111	10		119	11		126	11
			134	11		143	11		152	11		162	11		172	11
			183	12		195	13		207	13		220	14		234	15
			249	16		265	17		282	18		300	19		316	20
			333	21		360	22
			>;

		/*
		* ************************************************************************************************************************
		* candela to index mappings
		* ************************************************************************************************************************
		*/
		samsung,candela_map_table_revA = <
		/*<idx>	<from>	<till>		<candella> */
			0		0		5		5
			1		6		6		6
			2		7		7		7
			3		8		8		8
			4		9		9		9
			5		10		10		10
			6		11		11		11
			7		12		12		12
			8		13		13		13
			9		14		14		14
			10		15		15		15
			11		16		16		16
			12		17		17		17
			13		18		18		19
			14		19		19		20
			15		20		20		21
			16		21		21		22
			17		22		22		24
			18		23		23		25
			19		24		24		27
			20		25		25		29
			21		26		26		30
			22		27		27		32
			23		28		28		34
			24		29		29		37
			25		30		30		39
			26		31		32		41
			27		33		34		44
			28		35		36		47
			29		37		38		50
			30		39		40		53
			31		41		43		56
			32		44		45		60
			33		46		48		64
			34		49		51		68
			35		52		55		72
			36		56		59		77
			37		60		63		82
			38		64		67		87
			39		68		71		93
			40		71		74		98
			41		75		79		105
			42		80		85		111
			43		86		91		119
			44		92		97		126
			45		97		103		134
			46		104		110		143
			47		111		117		152
			48		118		125		162
			49		126		133		172
			50		134		142		183
			51		143		151		195
			52		152		161		207
			53		162		171		220
			54		172		182		234
			55		183		194		249
			56		195		206		265
			57		207		218		282
			58		219		230		300
			59		231		242		316
			60		243		253		333
			61		254		255		360
		>;
	};
};
