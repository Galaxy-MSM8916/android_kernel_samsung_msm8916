/* Copyright (c) 2013-14, Samsung Electronics Corporation. All rights reserved.
 *
 * This program is free software; you can redistribute it and/or modify
 * it under the terms of the GNU General Public License version 2 and
 * only version 2 as published by the Free Software Foundation.
 *
 * This program is distributed in the hope that it will be useful,
 * but WITHOUT ANY WARRANTY; without even the implied warranty of
 * MERCHANTABILITY or FITNESS FOR A PARTICULAR PURPOSE.  See the
 * GNU General Public License for more details.
 */

/*---------------------------------------------------------------------------
 * This file is autogenerated file using gcdb parser. Please do not edit it.
 * Update input XML file to add a new entry or update variable in this file
 * VERSION = "1.0"
 *---------------------------------------------------------------------------*/
&mdss_mdp {
	ss_dsi_panel_ILI9881C_SKI499017_HD: ss_dsi_panel_ILI9881C_SKI499017_HD {
		qcom,mdss-dsi-panel-name = "ss_dsi_panel_ILI9881C_SKI499017_HD";
		label = "ss_dsi_panel_ILI9881C_SKI499017_HD";
		
		qcom,mdss-dsi-panel-controller = <&mdss_dsi0>;
		qcom,mdss-dsi-panel-type = "dsi_video_mode";
		qcom,mdss-dsi-panel-destination = "display_1";
		qcom,cont-splash-enabled;
		qcom,mdss-dsi-panel-framerate = <60>;
		qcom,mdss-dsi-virtual-channel-id = <0>;
		qcom,mdss-dsi-stream = <0>;
		qcom,mdss-dsi-panel-width = <720>;
		qcom,mdss-dsi-panel-height = <1280>;
		qcom,mdss-pan-physical-width-dimension = <62>; /* <Width> real size of panel in mm */
		qcom,mdss-pan-physical-height-dimension = <106>; /*<Height> real size of panel in mm */
		qcom,mdss-dsi-lp11-init;
		qcom,mdss-dsi-init-delay-us = <100>;
	
		qcom,mdss-dsi-h-front-porch = <100>;//   
		qcom,mdss-dsi-h-back-porch = <120>;//
		qcom,mdss-dsi-h-pulse-width = <60>;//
		qcom,mdss-dsi-h-sync-skew = <0>;
		qcom,mdss-dsi-v-back-porch = <20>;//
		qcom,mdss-dsi-v-front-porch = <20>;//
		qcom,mdss-dsi-v-pulse-width = <8>;//

		qcom,mdss-dsi-h-left-border = <0>;
		qcom,mdss-dsi-h-right-border = <0>;
		qcom,mdss-dsi-v-top-border = <0>;
		qcom,mdss-dsi-v-bottom-border = <0>;
		qcom,mdss-dsi-bpp = <24>;
		qcom,mdss-dsi-color-order = <0>;
		qcom,mdss-dsi-underflow-color = <0xff>;
		qcom,mdss-dsi-border-color = <0>;
		qcom,mdss-dsi-dma-trigger = "trigger_sw";
		qcom,mdss-dsi-mdp-trigger = "none";
		qcom,mdss-dsi-bl-min-level = <1>;
		qcom,mdss-dsi-bl-max-level = <255>;
		qcom,mdss-dsi-bl-pmic-control-type = "bl_ctrl_dcs";
		qcom,mdss-dsi-lane-0-state;
		qcom,mdss-dsi-lane-1-state;
		qcom,mdss-dsi-lane-2-state;
		qcom,mdss-dsi-lane-3-state;
		qcom,mdss-dsi-bllp-eof-power-mode;
		qcom,mdss-dsi-bllp-power-mode;
		qcom,mdss-dsi-traffic-mode = "burst_mode";
		qcom,mdss-dsi-force-clk-lane-hs;
		qcom,mdss-dsi-reset-sequence = <1 20>, <0 1>, <1 20>;
		qcom,mdss-dsi-h-sync-pulse = <0>;

/*		qcom,mdss-dsi-hfp-power-mode;*/
		qcom,mdss-dsi-hbp-power-mode;
/*		qcom,mdss-dsi-hsa-power-mode;*/

		qcom,mdss-dsi-panel-timings = [86 1E 14 00 42 46 18 30 16 03 04 00];
		qcom,mdss-dsi-t-clk-pre = <0x1B>;
		qcom,mdss-dsi-t-clk-post = <0x04>;

		qcom,mdss-dsi-on-command = [
					39 01 00 00 00 00 04 FF 98 81 03
					39 01 00 00 00 00 02 01 00
					39 01 00 00 00 00 02 02 00
					39 01 00 00 00 00 02 03 72
					39 01 00 00 00 00 02 04 00
					39 01 00 00 00 00 02 05 00
					39 01 00 00 00 00 02 06 09
					39 01 00 00 00 00 02 07 00
					39 01 00 00 00 00 02 08 00
					39 01 00 00 00 00 02 09 01
					39 01 00 00 00 00 02 0A 00
					39 01 00 00 00 00 02 0B 00
					39 01 00 00 00 00 02 0C 01
					39 01 00 00 00 00 02 0D 00
					39 01 00 00 00 00 02 0E 00
					39 01 00 00 00 00 02 0F 00
					39 01 00 00 00 00 02 10 00
					39 01 00 00 00 00 02 11 00
					39 01 00 00 00 00 02 12 00
					39 01 00 00 00 00 02 13 00
					39 01 00 00 00 00 02 14 00
					39 01 00 00 00 00 02 15 00
					39 01 00 00 00 00 02 16 00
					39 01 00 00 00 00 02 17 00
					39 01 00 00 00 00 02 18 00
					39 01 00 00 00 00 02 19 00
					39 01 00 00 00 00 02 1A 00
					39 01 00 00 00 00 02 1B 00
					39 01 00 00 00 00 02 1C 00
					39 01 00 00 00 00 02 1D 00
					39 01 00 00 00 00 02 1E 40
					39 01 00 00 00 00 02 1F 80
					39 01 00 00 00 00 02 20 05
					39 01 00 00 00 00 02 21 02
					39 01 00 00 00 00 02 22 00
					39 01 00 00 00 00 02 23 00
					39 01 00 00 00 00 02 24 00
					39 01 00 00 00 00 02 25 00
					39 01 00 00 00 00 02 26 00
					39 01 00 00 00 00 02 27 00
					39 01 00 00 00 00 02 28 33
					39 01 00 00 00 00 02 29 02
					39 01 00 00 00 00 02 2A 00
					39 01 00 00 00 00 02 2B 00
					39 01 00 00 00 00 02 2C 00
					39 01 00 00 00 00 02 2D 00
					39 01 00 00 00 00 02 2E 00
					39 01 00 00 00 00 02 2F 00
					39 01 00 00 00 00 02 30 00
					39 01 00 00 00 00 02 31 00
					39 01 00 00 00 00 02 32 00
					39 01 00 00 00 00 02 33 00
					39 01 00 00 00 00 02 34 04
					39 01 00 00 00 00 02 35 00
					39 01 00 00 00 00 02 36 00
					39 01 00 00 00 00 02 37 00
					39 01 00 00 00 00 02 38 3C
					39 01 00 00 00 00 02 39 00
					39 01 00 00 00 00 02 3A 40
					39 01 00 00 00 00 02 3B 40
					39 01 00 00 00 00 02 3C 00
					39 01 00 00 00 00 02 3D 00
					39 01 00 00 00 00 02 3E 00
					39 01 00 00 00 00 02 3F 00
					39 01 00 00 00 00 02 40 00
					39 01 00 00 00 00 02 41 00
					39 01 00 00 00 00 02 42 00
					39 01 00 00 00 00 02 43 00
					39 01 00 00 00 00 02 44 00
					39 01 00 00 00 00 02 50 01
					39 01 00 00 00 00 02 51 23
					39 01 00 00 00 00 02 52 45
					39 01 00 00 00 00 02 53 67
					39 01 00 00 00 00 02 54 89
					39 01 00 00 00 00 02 55 AB
					39 01 00 00 00 00 02 56 01
					39 01 00 00 00 00 02 57 23
					39 01 00 00 00 00 02 58 45
					39 01 00 00 00 00 02 59 67
					39 01 00 00 00 00 02 5A 89
					39 01 00 00 00 00 02 5B AB
					39 01 00 00 00 00 02 5C CD
					39 01 00 00 00 00 02 5D EF
					39 01 00 00 00 00 02 5E 11
					39 01 00 00 00 00 02 5F 01
					39 01 00 00 00 00 02 60 00
					39 01 00 00 00 00 02 61 15
					39 01 00 00 00 00 02 62 14
					39 01 00 00 00 00 02 63 0E
					39 01 00 00 00 00 02 64 0F
					39 01 00 00 00 00 02 65 0C
					39 01 00 00 00 00 02 66 0D
					39 01 00 00 00 00 02 67 06
					39 01 00 00 00 00 02 68 02
					39 01 00 00 00 00 02 69 07
					39 01 00 00 00 00 02 6A 02
					39 01 00 00 00 00 02 6B 02
					39 01 00 00 00 00 02 6C 02
					39 01 00 00 00 00 02 6D 02
					39 01 00 00 00 00 02 6E 02
					39 01 00 00 00 00 02 6F 02
					39 01 00 00 00 00 02 70 02
					39 01 00 00 00 00 02 71 02
					39 01 00 00 00 00 02 72 02
					39 01 00 00 00 00 02 73 02
					39 01 00 00 00 00 02 74 02
					39 01 00 00 00 00 02 75 01
					39 01 00 00 00 00 02 76 00
					39 01 00 00 00 00 02 77 14
					39 01 00 00 00 00 02 78 15
					39 01 00 00 00 00 02 79 0E
					39 01 00 00 00 00 02 7A 0F
					39 01 00 00 00 00 02 7B 0C
					39 01 00 00 00 00 02 7C 0D
					39 01 00 00 00 00 02 7D 06
					39 01 00 00 00 00 02 7E 02
					39 01 00 00 00 00 02 7F 07
					39 01 00 00 00 00 02 80 02
					39 01 00 00 00 00 02 81 02
					39 01 00 00 00 00 02 82 02
					39 01 00 00 00 00 02 83 02
					39 01 00 00 00 00 02 84 02
					39 01 00 00 00 00 02 85 02
					39 01 00 00 00 00 02 86 02
					39 01 00 00 00 00 02 87 02
					39 01 00 00 00 00 02 88 02
					39 01 00 00 00 00 02 89 02
					39 01 00 00 00 00 02 8A 02
					39 01 00 00 00 00 04 FF 98 81 04
					39 01 00 00 00 00 02 6C 15
					39 01 00 00 00 00 02 6E 2B
					39 01 00 00 00 00 02 6F 32
					39 01 00 00 00 00 02 3A 94
					39 01 00 00 00 00 02 8D 19
					39 01 00 00 00 00 02 87 BA
					39 01 00 00 00 00 02 26 76
					39 01 00 00 00 00 02 B2 D1
					39 01 00 00 00 00 02 B5 06
					39 01 00 00 00 00 04 FF 98 81 01
					39 01 00 00 00 00 02 22 09
					39 01 00 00 00 00 02 31 00
					39 01 00 00 00 00 02 50 B7
					39 01 00 00 00 00 02 51 B7
					39 01 00 00 00 00 02 60 22
					39 01 00 00 00 00 02 61 00
					39 01 00 00 00 00 02 60 19
					39 01 00 00 00 00 02 63 10
					39 01 00 00 00 00 02 A0 08
					39 01 00 00 00 00 02 A1 18
					39 01 00 00 00 00 02 A2 25
					39 01 00 00 00 00 02 A3 13
					39 01 00 00 00 00 02 A4 14
					39 01 00 00 00 00 02 A5 28
					39 01 00 00 00 00 02 A6 1C
					39 01 00 00 00 00 02 A7 1E
					39 01 00 00 00 00 02 A8 83
					39 01 00 00 00 00 02 A9 1C
					39 01 00 00 00 00 02 AA 28
					39 01 00 00 00 00 02 AB 75
					39 01 00 00 00 00 02 AC 1D
					39 01 00 00 00 00 02 AD 1F
					39 01 00 00 00 00 02 AE 53
					39 01 00 00 00 00 02 AF 29
					39 01 00 00 00 00 02 B0 2A
					39 01 00 00 00 00 02 B1 51
					39 01 00 00 00 00 02 B2 5F
					39 01 00 00 00 00 02 B3 39
					39 01 00 00 00 00 02 C0 08
					39 01 00 00 00 00 02 C1 18
					39 01 00 00 00 00 02 C2 25
					39 01 00 00 00 00 02 C3 13
					39 01 00 00 00 00 02 C4 14
					39 01 00 00 00 00 02 C5 28
					39 01 00 00 00 00 02 C6 1C
					39 01 00 00 00 00 02 C7 1E
					39 01 00 00 00 00 02 C8 83
					39 01 00 00 00 00 02 C9 1C
					39 01 00 00 00 00 02 CA 28
					39 01 00 00 00 00 02 CB 75
					39 01 00 00 00 00 02 CC 1D
					39 01 00 00 00 00 02 CD 1F
					39 01 00 00 00 00 02 CE 53
					39 01 00 00 00 00 02 CF 29
					39 01 00 00 00 00 02 D0 2D
					39 01 00 00 00 00 02 D1 51
					39 01 00 00 00 00 02 D2 5F
					39 01 00 00 00 00 02 D3 39
					39 01 00 00 00 00 04 FF 98 81 02
					39 01 00 00 00 00 02 11 02
					39 01 00 00 00 00 02 13 00

					/* Initializing  Sequence Page 0 */
					39 01 00 00 00 00 04 FF 98 81 00
					39 01 00 00 05 00 02 51 00
					39 01 00 00 05 00 02 53 24
					39 01 00 00 05 00 02 55 80
					05 01 00 00 78 00 02 11 00  // Sleep Out  wait 120ms
					05 01 00 00 28 00 02 29 00  // Display On
					39 01 00 00 00 00 02 35 00  // TE on
		
		];
		qcom,mdss-dsi-on-command-state = "dsi_lp_mode";
		qcom,mdss-dsi-off-command-state = "dsi_hs_mode";
		qcom,mdss-dsi-off-command = [
					05 01 00 00 32 00 02 28 00	/* wait 50ms(0x32) */
					05 01 00 00 96 00 02 10 00	/* wait 150ms(0x96) */
					];
		samsung,mdss-dsi-bl-scale-low-level = <8>;
		samsung,mdss-dsi-bl-scale-dim-level = <8>;
		samsung,mdss-dsi-bl-scale-default-level = <89>;
		samsung,mdss-dsi-bl-scale-max-level = <188>;
		samsung,mdss-dsi-bl-pms-low-level = <7>;
		samsung,mdss-dsi-bl-pms-dim-level = <7>;
		samsung,mdss-dsi-bl-pms-default-level = <158>;
		samsung,mdss-dsi-bl-pms-max-level = <255>;
/*
 * ************************************************************************************************************************************
 *
 *
 *			Below  parameters are samsung dependent thigs
 *
 *
 * ************************************************************************************************************************************
 */
		samsung,mdnie-tuning-enable-tft;
		samsung,lcd-display-format-bgr;
		samsung,level2_key_enable_tx_cmds_revA = [
			39 01 00 00 00 00 03 F0 5A 5A
		];
		samsung,level2_key_disable_tx_cmds_revA = [
			39 01 00 00 00 00 03 F0 A5 A5
		];
		samsung,packet_size_tx_cmds_revA = [
			37 01 00 00 00 00 02 07 00
		];
		/*
		 * First parameters can be changed
		 * by function of samsung_nv_read()
		 * because of that means offset of
		 * read position
		 */
		samsung,reg_read_pos_tx_cmds_revA = [
			15 01 00 00 00 00 02 B0 00
		];
		samsung,manufacture_id0_rx_cmds_revA = [06 01 00 00 00 00 01 da 03 00];
		samsung,manufacture_id1_rx_cmds_revA = [06 01 00 00 00 00 01 db 03 00];
		samsung,manufacture_id2_rx_cmds_revA = [06 01 00 00 00 00 01 dc 03 00];
/*
		* Command sets for CABC control
*/
		samsung,panel-vendor = "HSD";
		samsung,tft_pwm_tx_cmds_revA=[
			39 01 00 00 00 00 03 51 0F FF/*First command should be PWM duty change command*/
		];
		samsung,cabc_on_tx_cmds_revA = [
			39 01 00 00 00 00 02 55 01
		];
		samsung,cabc_off_tx_cmds_revA = [
			39 01 00 00 00 00 02 55 00
		];
		/*
		* ************************************************************************************************************************
		* Scaled level to index mappings
		* ************************************************************************************************************************
		*/
		
		samsung,scaled_level_map_table_revA = <
		/*<idx>	  <from>  <till> <scaled_level> */
			0		0		0		0
			1		1		7		1
			2		8		11		3
			3		12		14		5
			4		15		17		7
			5		18		19		9
			6		20		22		11
			7		23		24		13
			8		25		27		15
			9		28		29		17
			10		30		32		19
			11		33		34		20
			12		35		37		21
			13		38		39		22
			14		40		42		24
			15		43		44		25
			16		45		47		26
			17		48		49		27
			18		50		52		28
			19		53		54		29
			20		55		57		30
			21		58		59		31
			22		60		62		32
			23		63		64		34
			24		65		67		36
			25		68		70		38
			26		71		72		40
			27		73		75		42
			28		76		77		44
			29		78		80		46
			30		81		82		48
			31		83		85		50
			32		86		87		52
			33		88		90		54
			34		91		92		56
			35		93		95		58
			36		96		97		60
			37		98		100		62
			38		101		102		64
			39		103		105		66
			40		106		107		68
			41		108		110		70
			42		111		112		72
			43		113		115		74
			44		116		117		76
			45		118		120		78
			46		121		122		80
			47		123		125		82
			48		126		127		84
			49		128		130		86
			50		131		133		88
			51		134		135		90
			52		136		138		92
			53		139		140		94
			54		141		143		96			
			55		144		145		98			
			56		146		148		100
			57		149		150		102
			58		151		153		104
			59		154		155		106
			60		156		158		108
			61		159		160		110
			62		161		163		112
			63		164		165		114
			64		166		168		116
			65		169		170		118
			66		171		173		120
			67		174		175		122
			68		176		178		124
			69		179		180		126
			70		181		183		128
			71		184		185		130
			72		186		188		132
			72		189		190		134
			74		191		193		136			
			75		194		196		138
			76		197		198		140
			77		199		201		143
			78		202		203		147
			79		204		206		151
			80		207		208		155
			81		209		211		159
			82		212		213		163
			83		214		216		167
			84		217		218		171
			85		219		221		175
			86		222		223		179
			87		224		226		183
			88		227		228		187
			89		229		231		191
			90		232		233		195
			91		234		236		199
			92		237		238		203
			93		239		241		207
			94		242		243		211
			95		244		246		215
			96		247		248		219
			97		249		251		223
			98		252		253		227
			99		254		255		231
		>;
	};
};

