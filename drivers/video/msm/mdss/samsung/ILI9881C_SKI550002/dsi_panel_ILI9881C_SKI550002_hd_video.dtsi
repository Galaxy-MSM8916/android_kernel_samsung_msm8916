/* Copyright (c) 2013-14, Samsung Electronics Corporation. All rights reserved.
 *
 * This program is free software; you can redistribute it and/or modify
 * it under the terms of the GNU General Public License version 2 and
 * only version 2 as published by the Free Software Foundation.
 *
 * This program is distributed in the hope that it will be useful,
 * but WITHOUT ANY WARRANTY; without even the implied warranty of
 * MERCHANTABILITY or FITNESS FOR A PARTICULAR PURPOSE.  See the
 * GNU General Public License for more details.
 */

/*---------------------------------------------------------------------------
 * This file is autogenerated file using gcdb parser. Please do not edit it.
 * Update input XML file to add a new entry or update variable in this file
 * VERSION = "1.0"
 *---------------------------------------------------------------------------*/
&mdss_mdp {
	ss_dsi_panel_ILI9881C_SKI550002_HD: ss_dsi_panel_ILI9881C_SKI550002_HD {
		qcom,mdss-dsi-panel-name = "ss_dsi_panel_ILI9881C_SKI550002_HD";
		label = "ss_dsi_panel_ILI9881C_SKI550002_HD";
		qcom,mdss-dsi-panel-controller = <&mdss_dsi0>;
		qcom,mdss-dsi-panel-type = "dsi_video_mode";
		qcom,mdss-dsi-panel-destination = "display_1";
		qcom,cont-splash-enabled;
		qcom,mdss-dsi-panel-framerate = <60>;
		qcom,mdss-dsi-virtual-channel-id = <0>;
		qcom,mdss-dsi-stream = <0>;
		qcom,mdss-dsi-panel-width = <720>;
		qcom,mdss-dsi-panel-height = <1280>;
		qcom,mdss-pan-physical-width-dimension = <72>; /* <Width> real size of panel in mm */
		qcom,mdss-pan-physical-height-dimension = <129>; /*<Height> real size of panel in mm */
		qcom,mdss-dsi-lp11-init;
		qcom,mdss-dsi-init-delay-us = <100>;
		qcom,mdss-dsi-h-front-porch = <102>;
		qcom,mdss-dsi-h-back-porch = <120>;
		qcom,mdss-dsi-h-pulse-width = <60>;
		qcom,mdss-dsi-h-sync-skew = <0>;
		qcom,mdss-dsi-v-back-porch = <24>;
		qcom,mdss-dsi-v-front-porch = <24>;
		qcom,mdss-dsi-v-pulse-width = <8>;
		qcom,mdss-dsi-panel-clockrate = <481000000>;
		qcom,mdss-dsi-h-left-border = <0>;
		qcom,mdss-dsi-h-right-border = <0>;
		qcom,mdss-dsi-v-top-border = <0>;
		qcom,mdss-dsi-v-bottom-border = <0>;
		qcom,mdss-dsi-bpp = <24>;
		qcom,mdss-dsi-color-order = <0>;
		qcom,mdss-dsi-underflow-color = <0xff>;
		qcom,mdss-dsi-border-color = <0>;
		qcom,mdss-dsi-dma-trigger = "trigger_sw";
		qcom,mdss-dsi-mdp-trigger = "none";
		qcom,mdss-dsi-bl-min-level = <1>;
		qcom,mdss-dsi-bl-max-level = <255>;
		qcom,mdss-dsi-bl-pmic-control-type = "bl_ctrl_dcs";
		qcom,mdss-dsi-lane-0-state;
		qcom,mdss-dsi-lane-1-state;
		qcom,mdss-dsi-lane-2-state;
		qcom,mdss-dsi-lane-3-state;
		qcom,mdss-dsi-bllp-eof-power-mode;
		qcom,mdss-dsi-bllp-power-mode;
		qcom,mdss-dsi-traffic-mode = "burst_mode";
		qcom,mdss-dsi-force-clk-lane-hs;
		qcom,mdss-dsi-reset-sequence = <1 20>, <0 1>, <1 20>;
		qcom,mdss-dsi-h-sync-pulse = <0>;
/*		qcom,mdss-dsi-hfp-power-mode;*/
		qcom,mdss-dsi-hbp-power-mode;
/*		qcom,mdss-dsi-hsa-power-mode;*/

		/*			
			Full Rate Bitclk	481.77
			escclk	19.2
			UI	2.084291498
			Tlpx	49.49333333

			T_CLK_PREPARE	38		45.73804574
			T_CLK_ZERO		254.2619543	291.0602911
			T_CLK_TRAIL		60		66.52806653
			T_HS_PREPARE		48.31600832	58.21205821
			T_HS_ZERO		107.5779626	149.7975709
			T_HS_TRAIL		68.31600832	70.68607069
			T_HS_RQST				54.05405405
			T_HS_EXIT		100		141.7004049
			T_TA_GO		208.3333333	208.3333333
			T_TA_SURE		52.08333333	104.1666667
			T_TA_GET		260.4166667	260.4166667
			TEOT of data lane			80.68607069
			TEOT of clock lane			76.52806653
			T_CLK_POST		168.1081081	278.5862786
			T_CLK_PRE		16.63201663	93.4468122
		*/
		qcom,mdss-dsi-panel-timings = [8B 1E 14 00 44 46 18 20 16 03 04 00];
		qcom,mdss-dsi-t-clk-pre = <0x1C>;
		qcom,mdss-dsi-t-clk-post = <0x04>;
		qcom,mdss-dsi-on-command = [
					39 01 00 00 00 00 04 FF 98 81 04
					39 01 00 00 00 00 02 6C 15
					39 01 00 00 00 00 02 6E 2D
					39 01 00 00 00 00 02 6F 33
					39 01 00 00 00 00 02 3A A4
					39 01 00 00 00 00 02 8D 14
					39 01 00 00 00 00 02 87 BA
					39 01 00 00 00 00 02 26 76
					39 01 00 00 00 00 02 B2 D1
					39 01 00 00 00 00 02 B5 06
					39 01 00 00 00 00 02 AB 00
					39 01 00 00 00 00 02 AF 67

					39 01 00 00 00 00 04 FF 98 81 03
					39 01 00 00 00 00 02 01 08
					39 01 00 00 00 00 02 02 00
					39 01 00 00 00 00 02 03 73
					39 01 00 00 00 00 02 04 73
					39 01 00 00 00 00 02 05 14
					39 01 00 00 00 00 02 06 06
					39 01 00 00 00 00 02 07 02
					39 01 00 00 00 00 02 08 05
					39 01 00 00 00 00 02 09 14
					39 01 00 00 00 00 02 0A 14
					39 01 00 00 00 00 02 0B 00
					39 01 00 00 00 00 02 0C 14
					39 01 00 00 00 00 02 0D 14
					39 01 00 00 00 00 02 0E 00
					39 01 00 00 00 00 02 0F 0C

					39 01 00 00 00 00 02 10 0C
					39 01 00 00 00 00 02 11 0C
					39 01 00 00 00 00 02 12 0C
					39 01 00 00 00 00 02 13 14
					39 01 00 00 00 00 02 14 0C
					39 01 00 00 00 00 02 15 00
					39 01 00 00 00 00 02 16 00
					39 01 00 00 00 00 02 17 00
					39 01 00 00 00 00 02 18 00
					39 01 00 00 00 00 02 19 00
					39 01 00 00 00 00 02 1A 00
					39 01 00 00 00 00 02 1B 00
					39 01 00 00 00 00 02 1C 00
					39 01 00 00 00 00 02 1D 00
					39 01 00 00 00 00 02 1E C8
					39 01 00 00 00 00 02 1F 80

					39 01 00 00 00 00 02 20 02
					39 01 00 00 00 00 02 21 00
					39 01 00 00 00 00 02 22 02
					39 01 00 00 00 00 02 23 00
					39 01 00 00 00 00 02 24 00
					39 01 00 00 00 00 02 25 00
					39 01 00 00 00 00 02 26 00
					39 01 00 00 00 00 02 27 00
					39 01 00 00 00 00 02 28 FB
					39 01 00 00 00 00 02 29 43
					39 01 00 00 00 00 02 2A 00
					39 01 00 00 00 00 02 2B 00
					39 01 00 00 00 00 02 2C 07
					39 01 00 00 00 00 02 2D 07
					39 01 00 00 00 00 02 2E FF
					39 01 00 00 00 00 02 2F FF

					39 01 00 00 00 00 02 30 11
					39 01 00 00 00 00 02 31 00
					39 01 00 00 00 00 02 32 00
					39 01 00 00 00 00 02 33 00
					39 01 00 00 00 00 02 34 84
					39 01 00 00 00 00 02 35 80
					39 01 00 00 00 00 02 36 07
					39 01 00 00 00 00 02 37 00
					39 01 00 00 00 00 02 38 00
					39 01 00 00 00 00 02 39 00
					39 01 00 00 00 00 02 3A 00
					39 01 00 00 00 00 02 3B 00
					39 01 00 00 00 00 02 3C 00
					39 01 00 00 00 00 02 3D 00
					39 01 00 00 00 00 02 3E 00
					39 01 00 00 00 00 02 3F 00

					39 01 00 00 00 00 02 40 00
					39 01 00 00 00 00 02 41 88
					39 01 00 00 00 00 02 42 00
					39 01 00 00 00 00 02 43 80
					39 01 00 00 00 00 02 44 08

					39 01 00 00 00 00 02 50 01
					39 01 00 00 00 00 02 51 23
					39 01 00 00 00 00 02 52 45
					39 01 00 00 00 00 02 53 67
					39 01 00 00 00 00 02 54 89
					39 01 00 00 00 00 02 55 AB
					39 01 00 00 00 00 02 56 01
					39 01 00 00 00 00 02 57 23
					39 01 00 00 00 00 02 58 45
					39 01 00 00 00 00 02 59 67
					39 01 00 00 00 00 02 5A 89
					39 01 00 00 00 00 02 5B AB
					39 01 00 00 00 00 02 5C CD
					39 01 00 00 00 00 02 5D EF

					39 01 00 00 00 00 02 5E 10
					39 01 00 00 00 00 02 5F 02
					39 01 00 00 00 00 02 60 08
					39 01 00 00 00 00 02 61 09
					39 01 00 00 00 00 02 62 10
					39 01 00 00 00 00 02 63 12
					39 01 00 00 00 00 02 64 11
					39 01 00 00 00 00 02 65 13
					39 01 00 00 00 00 02 66 0C
					39 01 00 00 00 00 02 67 02
					39 01 00 00 00 00 02 68 02
					39 01 00 00 00 00 02 69 02
					39 01 00 00 00 00 02 6A 02
					39 01 00 00 00 00 02 6B 02
					39 01 00 00 00 00 02 6C 0E
					39 01 00 00 00 00 02 6D 0D
					39 01 00 00 00 00 02 6E 0F
					39 01 00 00 00 00 02 6F 02

					39 01 00 00 00 00 02 70 02
					39 01 00 00 00 00 02 71 06
					39 01 00 00 00 00 02 72 07
					39 01 00 00 00 00 02 73 02
					39 01 00 00 00 00 02 74 02
					39 01 00 00 00 00 02 75 02
					39 01 00 00 00 00 02 76 07
					39 01 00 00 00 00 02 77 06
					39 01 00 00 00 00 02 78 11
					39 01 00 00 00 00 02 79 13
					39 01 00 00 00 00 02 7A 10
					39 01 00 00 00 00 02 7B 12
					39 01 00 00 00 00 02 7C 0F
					39 01 00 00 00 00 02 7D 02
					39 01 00 00 00 00 02 7E 02
					39 01 00 00 00 00 02 7F 02

					39 01 00 00 00 00 02 80 02
					39 01 00 00 00 00 02 81 02
					39 01 00 00 00 00 02 82 0D
					39 01 00 00 00 00 02 83 0E
					39 01 00 00 00 00 02 84 0C
					39 01 00 00 00 00 02 85 02
					39 01 00 00 00 00 02 86 02
					39 01 00 00 00 00 02 87 09
					39 01 00 00 00 00 02 88 08
					39 01 00 00 00 00 02 89 02
					39 01 00 00 00 00 02 8A 02

					39 01 00 00 00 00 04 FF 98 81 01
					39 01 00 00 00 00 02 22 09
					39 01 00 00 00 00 02 31 0B
					39 01 00 00 00 00 02 34 01
					39 01 00 00 00 00 02 42 22
					39 01 00 00 00 00 02 50 B7
					39 01 00 00 00 00 02 51 B7
					39 01 00 00 00 00 02 60 14
					39 01 00 00 00 00 02 61 00
					39 01 00 00 00 00 02 62 19
					39 01 00 00 00 00 02 63 10

					39 01 00 00 00 00 02 A0 01
					39 01 00 00 00 00 02 A1 15
					39 01 00 00 00 00 02 A2 23
					39 01 00 00 00 00 02 A3 11
					39 01 00 00 00 00 02 A4 14
					39 01 00 00 00 00 02 A5 26
					39 01 00 00 00 00 02 A6 1A
					39 01 00 00 00 00 02 A7 18
					39 01 00 00 00 00 02 A8 8C
					39 01 00 00 00 00 02 A9 19
					39 01 00 00 00 00 02 AA 29
					39 01 00 00 00 00 02 AB 89
					39 01 00 00 00 00 02 AC 22
					39 01 00 00 00 00 02 AD 24
					39 01 00 00 00 00 02 AE 5B
					39 01 00 00 00 00 02 AF 2F
					39 01 00 00 00 00 02 B0 30
					39 01 00 00 00 00 02 B1 50
					39 01 00 00 00 00 02 B2 5A
					39 01 00 00 00 00 02 B3 28

					39 01 00 00 00 00 02 C0 0B
					39 01 00 00 00 00 02 C1 1F
					39 01 00 00 00 00 02 C2 2D
					39 01 00 00 00 00 02 C3 1B
					39 01 00 00 00 00 02 C4 1E
					39 01 00 00 00 00 02 C5 30
					39 01 00 00 00 00 02 C6 24
					39 01 00 00 00 00 02 C7 20
					39 01 00 00 00 00 02 C8 94
					39 01 00 00 00 00 02 C9 1F
					39 01 00 00 00 00 02 CA 23
					39 01 00 00 00 00 02 CB 89
					39 01 00 00 00 00 02 CC 22
					39 01 00 00 00 00 02 CD 24
					39 01 00 00 00 00 02 CE 5B
					39 01 00 00 00 00 02 CF 2F
					39 01 00 00 00 00 02 D0 30
					39 01 00 00 00 00 02 D1 50
					39 01 00 00 00 00 02 D2 5A
					39 01 00 00 00 00 02 D3 28

					39 01 00 00 00 00 04 FF 98 81 05
					39 01 00 00 00 00 02 80 01

					39 01 00 00 00 00 02 00 00
					39 01 00 00 00 00 02 01 00
					39 01 00 00 00 00 02 02 00
					39 01 00 00 00 00 02 03 00
					39 01 00 00 00 00 02 04 00
					39 01 00 00 00 00 02 05 00
					39 01 00 00 00 00 02 06 00
					39 01 00 00 00 00 02 07 00
					39 01 00 00 00 00 02 08 00
					39 01 00 00 00 00 02 09 00
					39 01 00 00 00 00 02 0A 00
					39 01 00 00 00 00 02 0B 00
					39 01 00 00 00 00 02 0C 00
					39 01 00 00 00 00 02 0D 00
					39 01 00 00 00 00 02 0E 00
					39 01 00 00 00 00 02 0F 00

					39 01 00 00 00 00 02 10 04
					39 01 00 00 00 00 02 11 04
					39 01 00 00 00 00 02 12 04
					39 01 00 00 00 00 02 13 04
					39 01 00 00 00 00 02 14 04
					39 01 00 00 00 00 02 15 04
					39 01 00 00 00 00 02 16 04
					39 01 00 00 00 00 02 17 04
					39 01 00 00 00 00 02 18 04
					39 01 00 00 00 00 02 19 04
					39 01 00 00 00 00 02 1A 04
					39 01 00 00 00 00 02 1B 04
					39 01 00 00 00 00 02 1C 04
					39 01 00 00 00 00 02 1D 04
					39 01 00 00 00 00 02 1E 04
					39 01 00 00 00 00 02 1F 04

					39 01 00 00 00 00 02 20 04
					39 01 00 00 00 00 02 21 04
					39 01 00 00 00 00 02 22 04
					39 01 00 00 00 00 02 23 04
					39 01 00 00 00 00 02 24 06
					39 01 00 00 00 00 02 25 06
					39 01 00 00 00 00 02 26 06
					39 01 00 00 00 00 02 27 06
					39 01 00 00 00 00 02 28 06
					39 01 00 00 00 00 02 29 06
					39 01 00 00 00 00 02 2A 08
					39 01 00 00 00 00 02 2B 08
					39 01 00 00 00 00 02 2C 08
					39 01 00 00 00 00 02 2D 08
					39 01 00 00 00 00 02 2E 08
					39 01 00 00 00 00 02 2F 08

					39 01 00 00 00 00 02 30 09
					39 01 00 00 00 00 02 31 09
					39 01 00 00 00 00 02 32 09
					39 01 00 00 00 00 02 33 09
					39 01 00 00 00 00 02 34 09
					39 01 00 00 00 00 02 35 09
					39 01 00 00 00 00 02 36 09
					39 01 00 00 00 00 02 37 09
					39 01 00 00 00 00 02 38 0A
					39 01 00 00 00 00 02 39 0A
					39 01 00 00 00 00 02 3A 0A
					39 01 00 00 00 00 02 3B 0A
					39 01 00 00 00 00 02 3C 0A
					39 01 00 00 00 00 02 3D 0A
					39 01 00 00 00 00 02 3E 0A
					39 01 00 00 00 00 02 3F 0A

					39 01 00 00 00 00 02 40 0B
					39 01 00 00 00 00 02 41 0B
					39 01 00 00 00 00 02 42 0B
					39 01 00 00 00 00 02 43 0B
					39 01 00 00 00 00 02 44 0B
					39 01 00 00 00 00 02 45 0B
					39 01 00 00 00 00 02 46 0C
					39 01 00 00 00 00 02 47 0C
					39 01 00 00 00 00 02 48 0C
					39 01 00 00 00 00 02 49 0C
					39 01 00 00 00 00 02 4A 0C
					39 01 00 00 00 00 02 4B 0C
					39 01 00 00 00 00 02 4C 0D
					39 01 00 00 00 00 02 4D 0D
					39 01 00 00 00 00 02 4E 0D
					39 01 00 00 00 00 02 4F 0D

					39 01 00 00 00 00 02 50 0D
					39 01 00 00 00 00 02 51 0D
					39 01 00 00 00 00 02 52 0D
					39 01 00 00 00 00 02 53 0D
					39 01 00 00 00 00 02 54 0D
					39 01 00 00 00 00 02 55 0D
					39 01 00 00 00 00 02 56 0D
					39 01 00 00 00 00 02 57 0D
					39 01 00 00 00 00 02 58 0D
					39 01 00 00 00 00 02 59 0D
					39 01 00 00 00 00 02 5A 0C
					39 01 00 00 00 00 02 5B 0C
					39 01 00 00 00 00 02 5C 0C
					39 01 00 00 00 00 02 5D 0C
					39 01 00 00 00 00 02 5E 0C
					39 01 00 00 00 00 02 5F 0C

					39 01 00 00 00 00 02 60 0C
					39 01 00 00 00 00 02 61 0C
					39 01 00 00 00 00 02 62 0C
					39 01 00 00 00 00 02 63 0C
					39 01 00 00 00 00 02 64 0C
					39 01 00 00 00 00 02 65 0C
					39 01 00 00 00 00 02 66 0D
					39 01 00 00 00 00 02 67 0D
					39 01 00 00 00 00 02 68 0D
					39 01 00 00 00 00 02 69 0D
					39 01 00 00 00 00 02 6A 0D
					39 01 00 00 00 00 02 6B 0D
					39 01 00 00 00 00 02 6C 0D
					39 01 00 00 00 00 02 6D 0D
					39 01 00 00 00 00 02 6E 0D
					39 01 00 00 00 00 02 6F 0D

					39 01 00 00 00 00 02 70 0D
					39 01 00 00 00 00 02 71 0D
					39 01 00 00 00 00 02 72 0D
					39 01 00 00 00 00 02 73 0D
					39 01 00 00 00 00 02 74 0D
					39 01 00 00 00 00 02 75 0D
					39 01 00 00 00 00 02 76 0D
					39 01 00 00 00 00 02 77 0D
					39 01 00 00 00 00 02 78 0D
					39 01 00 00 00 00 02 79 0D
					39 01 00 00 00 00 02 7A 0D
					39 01 00 00 00 00 02 7B 0D
					39 01 00 00 00 00 02 7C 0D
					39 01 00 00 00 00 02 7D 0D
					39 01 00 00 00 00 02 7E 0D
					39 01 00 00 00 00 02 7F 0D

					39 01 00 00 00 00 04 FF 98 81 06
					39 01 00 00 00 00 02 00 0D
					39 01 00 00 00 00 02 01 0D
					39 01 00 00 00 00 02 02 0D
					39 01 00 00 00 00 02 03 0D
					39 01 00 00 00 00 02 04 0D
					39 01 00 00 00 00 02 05 0D
					39 01 00 00 00 00 02 06 0D
					39 01 00 00 00 00 02 07 0D
					39 01 00 00 00 00 02 08 0D
					39 01 00 00 00 00 02 09 0D
					39 01 00 00 00 00 02 0A 0D
					39 01 00 00 00 00 02 0B 0D
					39 01 00 00 00 00 02 0C 0D
					39 01 00 00 00 00 02 0D 0D
					39 01 00 00 00 00 02 0E 0D
					39 01 00 00 00 00 02 0F 0D

					39 01 00 00 00 00 02 10 0E
					39 01 00 00 00 00 02 11 0E
					39 01 00 00 00 00 02 12 0E
					39 01 00 00 00 00 02 13 0E
					39 01 00 00 00 00 02 14 0E
					39 01 00 00 00 00 02 15 0E
					39 01 00 00 00 00 02 16 0E
					39 01 00 00 00 00 02 17 0E
					39 01 00 00 00 00 02 18 0E
					39 01 00 00 00 00 02 19 0E
					39 01 00 00 00 00 02 1A 0E
					39 01 00 00 00 00 02 1B 0E
					39 01 00 00 00 00 02 1C 0E
					39 01 00 00 00 00 02 1D 0E
					39 01 00 00 00 00 02 1E 0E
					39 01 00 00 00 00 02 1F 0E

					39 01 00 00 00 00 02 20 0E
					39 01 00 00 00 00 02 21 0E
					39 01 00 00 00 00 02 22 0E
					39 01 00 00 00 00 02 23 0E
					39 01 00 00 00 00 02 24 0E
					39 01 00 00 00 00 02 25 0E
					39 01 00 00 00 00 02 26 0E
					39 01 00 00 00 00 02 27 0E
					39 01 00 00 00 00 02 28 0E
					39 01 00 00 00 00 02 29 0E
					39 01 00 00 00 00 02 2A 0E
					39 01 00 00 00 00 02 2B 0E
					39 01 00 00 00 00 02 2C 0E
					39 01 00 00 00 00 02 2D 0E
					39 01 00 00 00 00 02 2E 0E
					39 01 00 00 00 00 02 2F 0E

					39 01 00 00 00 00 02 30 0E
					39 01 00 00 00 00 02 31 0E
					39 01 00 00 00 00 02 32 0E
					39 01 00 00 00 00 02 33 0E
					39 01 00 00 00 00 02 34 0E
					39 01 00 00 00 00 02 35 0E
					39 01 00 00 00 00 02 36 0E
					39 01 00 00 00 00 02 37 0E
					39 01 00 00 00 00 02 38 0D
					39 01 00 00 00 00 02 39 0D
					39 01 00 00 00 00 02 3A 0D
					39 01 00 00 00 00 02 3B 0D
					39 01 00 00 00 00 02 3C 0D
					39 01 00 00 00 00 02 3D 0D
					39 01 00 00 00 00 02 3E 0D
					39 01 00 00 00 00 02 3F 0D

					39 01 00 00 00 00 02 40 0C
					39 01 00 00 00 00 02 41 0C
					39 01 00 00 00 00 02 42 0C
					39 01 00 00 00 00 02 43 0C
					39 01 00 00 00 00 02 44 0C
					39 01 00 00 00 00 02 45 0C
					39 01 00 00 00 00 02 46 0C
					39 01 00 00 00 00 02 47 0C
					39 01 00 00 00 00 02 48 0C
					39 01 00 00 00 00 02 49 0C
					39 01 00 00 00 00 02 4A 0C
					39 01 00 00 00 00 02 4B 0C
					39 01 00 00 00 00 02 4C 0C
					39 01 00 00 00 00 02 4D 0C
					39 01 00 00 00 00 02 4E 0C
					39 01 00 00 00 00 02 4F 0C

					39 01 00 00 00 00 02 50 0C
					39 01 00 00 00 00 02 51 0C
					39 01 00 00 00 00 02 52 0C
					39 01 00 00 00 00 02 53 0C
					39 01 00 00 00 00 02 54 0C
					39 01 00 00 00 00 02 55 0C
					39 01 00 00 00 00 02 56 0C
					39 01 00 00 00 00 02 57 0C
					39 01 00 00 00 00 02 58 0C
					39 01 00 00 00 00 02 59 0C
					39 01 00 00 00 00 02 5A 0C
					39 01 00 00 00 00 02 5B 0C
					39 01 00 00 00 00 02 5C 0B
					39 01 00 00 00 00 02 5D 0B
					39 01 00 00 00 00 02 5E 0B
					39 01 00 00 00 00 02 5F 0B

					39 01 00 00 00 00 02 60 0B
					39 01 00 00 00 00 02 61 0B
					39 01 00 00 00 00 02 62 0B
					39 01 00 00 00 00 02 63 0B
					39 01 00 00 00 00 02 64 0A
					39 01 00 00 00 00 02 65 0A
					39 01 00 00 00 00 02 66 0A
					39 01 00 00 00 00 02 67 0A
					39 01 00 00 00 00 02 68 0A
					39 01 00 00 00 00 02 69 0A
					39 01 00 00 00 00 02 6A 0A
					39 01 00 00 00 00 02 6B 0A
					39 01 00 00 00 00 02 6C 0A
					39 01 00 00 00 00 02 6D 0A
					39 01 00 00 00 00 02 6E 0A
					39 01 00 00 00 00 02 6F 0A

					39 01 00 00 00 00 02 70 0A
					39 01 00 00 00 00 02 71 08
					39 01 00 00 00 00 02 72 08
					39 01 00 00 00 00 02 73 08
					39 01 00 00 00 00 02 74 06
					39 01 00 00 00 00 02 75 06
					39 01 00 00 00 00 02 76 06
					39 01 00 00 00 00 02 77 06
					39 01 00 00 00 00 02 78 08
					39 01 00 00 00 00 02 79 08
					39 01 00 00 00 00 02 7A 08
					39 01 00 00 00 00 02 7B 08
					39 01 00 00 00 00 02 7C 06
					39 01 00 00 00 00 02 7D 06
					39 01 00 00 00 00 02 7E 0E
					39 01 00 00 00 00 02 7F 0E

					39 01 00 00 00 00 04 FF 98 81 07
					39 01 00 00 00 00 02 00 00
					39 01 00 00 00 00 02 01 00
					39 01 00 00 00 00 02 02 00
					39 01 00 00 00 00 02 03 00
					39 01 00 00 00 00 02 04 00
					39 01 00 00 00 00 02 05 00
					39 01 00 00 00 00 02 06 00
					39 01 00 00 00 00 02 07 00
					39 01 00 00 00 00 02 08 00
					39 01 00 00 00 00 02 09 00
					39 01 00 00 00 00 02 0A 00
					39 01 00 00 00 00 02 0B 00
					39 01 00 00 00 00 02 0C 00
					39 01 00 00 00 00 02 0D 00
					39 01 00 00 00 00 02 0E 00
					39 01 00 00 00 00 02 0F 00

					39 01 00 00 00 00 02 10 00
					39 01 00 00 00 00 02 11 00
					39 01 00 00 00 00 02 12 00
					39 01 00 00 00 00 02 13 00
					39 01 00 00 00 00 02 14 00
					39 01 00 00 00 00 02 15 00
					39 01 00 00 00 00 02 16 00
					39 01 00 00 00 00 02 17 00
					39 01 00 00 00 00 02 18 00
					39 01 00 00 00 00 02 19 00
					39 01 00 00 00 00 02 1A 00
					39 01 00 00 00 00 02 1B 00
					39 01 00 00 00 00 02 1C 00
					39 01 00 00 00 00 02 1D 00
					39 01 00 00 00 00 02 1E 00
					39 01 00 00 00 00 02 1F 00

					39 01 00 00 00 00 02 20 00
					39 01 00 00 00 00 02 21 00
					39 01 00 00 00 00 02 22 00
					39 01 00 00 00 00 02 23 00
					39 01 00 00 00 00 02 24 00
					39 01 00 00 00 00 02 25 00
					39 01 00 00 00 00 02 26 00
					39 01 00 00 00 00 02 27 00
					39 01 00 00 00 00 02 28 00
					39 01 00 00 00 00 02 29 00
					39 01 00 00 00 00 02 2A 00
					39 01 00 00 00 00 02 2B 00
					39 01 00 00 00 00 02 2C 00
					39 01 00 00 00 00 02 2D 00
					39 01 00 00 00 00 02 2E 00
					39 01 00 00 00 00 02 2F 00

					39 01 00 00 00 00 02 30 00
					39 01 00 00 00 00 02 31 00
					39 01 00 00 00 00 02 32 00
					39 01 00 00 00 00 02 33 00
					39 01 00 00 00 00 02 34 81
					39 01 00 00 00 00 02 35 81
					39 01 00 00 00 00 02 36 81
					39 01 00 00 00 00 02 37 81
					39 01 00 00 00 00 02 38 81
					39 01 00 00 00 00 02 39 81
					39 01 00 00 00 00 02 3A 82
					39 01 00 00 00 00 02 3B 82
					39 01 00 00 00 00 02 3C 82
					39 01 00 00 00 00 02 3D 82
					39 01 00 00 00 00 02 3E 82
					39 01 00 00 00 00 02 3F 82

					39 01 00 00 00 00 02 40 82
					39 01 00 00 00 00 02 41 82
					39 01 00 00 00 00 02 42 82
					39 01 00 00 00 00 02 43 82
					39 01 00 00 00 00 02 44 82
					39 01 00 00 00 00 02 45 82
					39 01 00 00 00 00 02 46 82
					39 01 00 00 00 00 02 47 82
					39 01 00 00 00 00 02 48 82
					39 01 00 00 00 00 02 49 82
					39 01 00 00 00 00 02 4A 82
					39 01 00 00 00 00 02 4B 82
					39 01 00 00 00 00 02 4C 82
					39 01 00 00 00 00 02 4D 82
					39 01 00 00 00 00 02 4E 82
					39 01 00 00 00 00 02 4F 82

					39 01 00 00 00 00 02 50 83
					39 01 00 00 00 00 02 51 83
					39 01 00 00 00 00 02 52 83
					39 01 00 00 00 00 02 53 83
					39 01 00 00 00 00 02 54 83
					39 01 00 00 00 00 02 55 83
					39 01 00 00 00 00 02 56 83
					39 01 00 00 00 00 02 57 83
					39 01 00 00 00 00 02 58 83
					39 01 00 00 00 00 02 59 83
					39 01 00 00 00 00 02 5A 84
					39 01 00 00 00 00 02 5B 84
					39 01 00 00 00 00 02 5C 84
					39 01 00 00 00 00 02 5D 84
					39 01 00 00 00 00 02 5E 84
					39 01 00 00 00 00 02 5F 84

					39 01 00 00 00 00 02 60 84
					39 01 00 00 00 00 02 61 84
					39 01 00 00 00 00 02 62 85
					39 01 00 00 00 00 02 63 85
					39 01 00 00 00 00 02 64 85
					39 01 00 00 00 00 02 65 85
					39 01 00 00 00 00 02 66 85
					39 01 00 00 00 00 02 67 85
					39 01 00 00 00 00 02 68 85
					39 01 00 00 00 00 02 69 85
					39 01 00 00 00 00 02 6A 86
					39 01 00 00 00 00 02 6B 86
					39 01 00 00 00 00 02 6C 86
					39 01 00 00 00 00 02 6D 86
					39 01 00 00 00 00 02 6E 87
					39 01 00 00 00 00 02 6F 87

					39 01 00 00 00 00 02 70 87
					39 01 00 00 00 00 02 71 87
					39 01 00 00 00 00 02 72 87
					39 01 00 00 00 00 02 73 87
					39 01 00 00 00 00 02 74 88
					39 01 00 00 00 00 02 75 88
					39 01 00 00 00 00 02 76 88
					39 01 00 00 00 00 02 77 88
					39 01 00 00 00 00 02 78 88
					39 01 00 00 00 00 02 79 88
					39 01 00 00 00 00 02 7A 89
					39 01 00 00 00 00 02 7B 89
					39 01 00 00 00 00 02 7C 89
					39 01 00 00 00 00 02 7D 89
					39 01 00 00 00 00 02 7E 89
					39 01 00 00 00 00 02 7F 89

					39 01 00 00 00 00 04 FF 98 81 08
					39 01 00 00 00 00 02 00 8A
					39 01 00 00 00 00 02 01 8A
					39 01 00 00 00 00 02 02 8A
					39 01 00 00 00 00 02 03 8A
					39 01 00 00 00 00 02 04 8A
					39 01 00 00 00 00 02 05 8A
					39 01 00 00 00 00 02 06 8A
					39 01 00 00 00 00 02 07 8B
					39 01 00 00 00 00 02 08 8B
					39 01 00 00 00 00 02 09 8B
					39 01 00 00 00 00 02 0A 8B
					39 01 00 00 00 00 02 0B 8B
					39 01 00 00 00 00 02 0C 8B
					39 01 00 00 00 00 02 0D 8C
					39 01 00 00 00 00 02 0E 8C
					39 01 00 00 00 00 02 0F 8C

					39 01 00 00 00 00 02 10 8C
					39 01 00 00 00 00 02 11 8C
					39 01 00 00 00 00 02 12 8C
					39 01 00 00 00 00 02 13 8C
					39 01 00 00 00 00 02 14 8C
					39 01 00 00 00 00 02 15 8C
					39 01 00 00 00 00 02 16 8C
					39 01 00 00 00 00 02 17 8C
					39 01 00 00 00 00 02 18 8C
					39 01 00 00 00 00 02 19 8C
					39 01 00 00 00 00 02 1A 8C
					39 01 00 00 00 00 02 1B 8C
					39 01 00 00 00 00 02 1C 8C
					39 01 00 00 00 00 02 1D 8C
					39 01 00 00 00 00 02 1E 8C
					39 01 00 00 00 00 02 1F 8C

					39 01 00 00 00 00 02 20 8C
					39 01 00 00 00 00 02 21 8C
					39 01 00 00 00 00 02 22 8C
					39 01 00 00 00 00 02 23 8C
					39 01 00 00 00 00 02 24 8C
					39 01 00 00 00 00 02 25 8C
					39 01 00 00 00 00 02 26 8C
					39 01 00 00 00 00 02 27 8C
					39 01 00 00 00 00 02 28 8C
					39 01 00 00 00 00 02 29 8C
					39 01 00 00 00 00 02 2A 8C
					39 01 00 00 00 00 02 2B 8C
					39 01 00 00 00 00 02 2C 8C
					39 01 00 00 00 00 02 2D 8C
					39 01 00 00 00 00 02 2E 8C
					39 01 00 00 00 00 02 2F 8C

					39 01 00 00 00 00 02 30 8B
					39 01 00 00 00 00 02 31 8B
					39 01 00 00 00 00 02 32 8B
					39 01 00 00 00 00 02 33 8B
					39 01 00 00 00 00 02 34 8B
					39 01 00 00 00 00 02 35 8B
					39 01 00 00 00 00 02 36 8A
					39 01 00 00 00 00 02 37 8A
					39 01 00 00 00 00 02 38 8A
					39 01 00 00 00 00 02 39 8A
					39 01 00 00 00 00 02 3A 8A
					39 01 00 00 00 00 02 3B 8A
					39 01 00 00 00 00 02 3C 89
					39 01 00 00 00 00 02 3D 89
					39 01 00 00 00 00 02 3E 89
					39 01 00 00 00 00 02 3F 89

					39 01 00 00 00 00 02 40 89
					39 01 00 00 00 00 02 41 89
					39 01 00 00 00 00 02 42 89
					39 01 00 00 00 00 02 43 89
					39 01 00 00 00 00 02 44 89
					39 01 00 00 00 00 02 45 89
					39 01 00 00 00 00 02 46 89
					39 01 00 00 00 00 02 47 89
					39 01 00 00 00 00 02 48 8A
					39 01 00 00 00 00 02 49 8A
					39 01 00 00 00 00 02 4A 8A
					39 01 00 00 00 00 02 4B 8A
					39 01 00 00 00 00 02 4C 8B
					39 01 00 00 00 00 02 4D 8B
					39 01 00 00 00 00 02 4E 8B
					39 01 00 00 00 00 02 4F 8B

					39 01 00 00 00 00 02 50 8C
					39 01 00 00 00 00 02 51 8C
					39 01 00 00 00 00 02 52 8C
					39 01 00 00 00 00 02 53 8C
					39 01 00 00 00 00 02 54 8C
					39 01 00 00 00 00 02 55 8C
					39 01 00 00 00 00 02 56 8C
					39 01 00 00 00 00 02 57 8C
					39 01 00 00 00 00 02 58 8C
					39 01 00 00 00 00 02 59 8C
					39 01 00 00 00 00 02 5A 8C
					39 01 00 00 00 00 02 5B 8C
					39 01 00 00 00 00 02 5C 8C
					39 01 00 00 00 00 02 5D 8C
					39 01 00 00 00 00 02 5E 8C
					39 01 00 00 00 00 02 5F 8C

					39 01 00 00 00 00 02 60 8C
					39 01 00 00 00 00 02 61 8C
					39 01 00 00 00 00 02 62 8C
					39 01 00 00 00 00 02 63 8C
					39 01 00 00 00 00 02 64 8C
					39 01 00 00 00 00 02 65 8C
					39 01 00 00 00 00 02 66 8C
					39 01 00 00 00 00 02 67 8C
					39 01 00 00 00 00 02 68 8C
					39 01 00 00 00 00 02 69 8C
					39 01 00 00 00 00 02 6A 8C
					39 01 00 00 00 00 02 6B 8C
					39 01 00 00 00 00 02 6C 8D
					39 01 00 00 00 00 02 6D 8D
					39 01 00 00 00 00 02 6E 8D
					39 01 00 00 00 00 02 6F 8D

					39 01 00 00 00 00 02 70 8D
					39 01 00 00 00 00 02 71 8D
					39 01 00 00 00 00 02 72 8D
					39 01 00 00 00 00 02 73 8D
					39 01 00 00 00 00 02 74 8D
					39 01 00 00 00 00 02 75 8D
					39 01 00 00 00 00 02 76 8D
					39 01 00 00 00 00 02 77 8D
					39 01 00 00 00 00 02 78 8D
					39 01 00 00 00 00 02 79 8D
					39 01 00 00 00 00 02 7A 8D
					39 01 00 00 00 00 02 7B 8D
					39 01 00 00 00 00 02 7C 8D
					39 01 00 00 00 00 02 7D 8D
					39 01 00 00 00 00 02 7E 90
					39 01 00 00 00 00 02 7F 92

					39 01 00 00 00 00 04 FF 98 81 09
					39 01 00 00 00 00 02 00 00
					39 01 00 00 00 00 02 01 00
					39 01 00 00 00 00 02 02 00
					39 01 00 00 00 00 02 03 00
					39 01 00 00 00 00 02 04 00
					39 01 00 00 00 00 02 05 00
					39 01 00 00 00 00 02 06 00
					39 01 00 00 00 00 02 07 00
					39 01 00 00 00 00 02 08 04
					39 01 00 00 00 00 02 09 04
					39 01 00 00 00 00 02 0A 04
					39 01 00 00 00 00 02 0B 04
					39 01 00 00 00 00 02 0C 04
					39 01 00 00 00 00 02 0D 04
					39 01 00 00 00 00 02 0E 04
					39 01 00 00 00 00 02 0F 04

					39 01 00 00 00 00 02 10 08
					39 01 00 00 00 00 02 11 08
					39 01 00 00 00 00 02 12 08
					39 01 00 00 00 00 02 13 08
					39 01 00 00 00 00 02 14 08
					39 01 00 00 00 00 02 15 08
					39 01 00 00 00 00 02 16 08
					39 01 00 00 00 00 02 17 08
					39 01 00 00 00 00 02 18 08
					39 01 00 00 00 00 02 19 08
					39 01 00 00 00 00 02 1A 08
					39 01 00 00 00 00 02 1B 08
					39 01 00 00 00 00 02 1C 08
					39 01 00 00 00 00 02 1D 08
					39 01 00 00 00 00 02 1E 08
					39 01 00 00 00 00 02 1F 08

					39 01 00 00 00 00 02 20 08
					39 01 00 00 00 00 02 21 08
					39 01 00 00 00 00 02 22 08
					39 01 00 00 00 00 02 23 08
					39 01 00 00 00 00 02 24 08
					39 01 00 00 00 00 02 25 08
					39 01 00 00 00 00 02 26 08
					39 01 00 00 00 00 02 27 08
					39 01 00 00 00 00 02 28 08
					39 01 00 00 00 00 02 29 08
					39 01 00 00 00 00 02 2A 08
					39 01 00 00 00 00 02 2B 08
					39 01 00 00 00 00 02 2C 08
					39 01 00 00 00 00 02 2D 08
					39 01 00 00 00 00 02 2E 08
					39 01 00 00 00 00 02 2F 08

					39 01 00 00 00 00 02 30 08
					39 01 00 00 00 00 02 31 08
					39 01 00 00 00 00 02 32 08
					39 01 00 00 00 00 02 33 08
					39 01 00 00 00 00 02 34 08
					39 01 00 00 00 00 02 35 08
					39 01 00 00 00 00 02 36 08
					39 01 00 00 00 00 02 37 08
					39 01 00 00 00 00 02 38 08
					39 01 00 00 00 00 02 39 08
					39 01 00 00 00 00 02 3A 08
					39 01 00 00 00 00 02 3B 08
					39 01 00 00 00 00 02 3C 08
					39 01 00 00 00 00 02 3D 08
					39 01 00 00 00 00 02 3E 08
					39 01 00 00 00 00 02 3F 08

					39 01 00 00 00 00 02 40 08
					39 01 00 00 00 00 02 41 08
					39 01 00 00 00 00 02 42 08
					39 01 00 00 00 00 02 43 08
					39 01 00 00 00 00 02 44 08
					39 01 00 00 00 00 02 45 08
					39 01 00 00 00 00 02 46 08
					39 01 00 00 00 00 02 47 08
					39 01 00 00 00 00 02 48 08
					39 01 00 00 00 00 02 49 08
					39 01 00 00 00 00 02 4A 08
					39 01 00 00 00 00 02 4B 08
					39 01 00 00 00 00 02 4C 08
					39 01 00 00 00 00 02 4D 08
					39 01 00 00 00 00 02 4E 08
					39 01 00 00 00 00 02 4F 08

					39 01 00 00 00 00 02 50 08
					39 01 00 00 00 00 02 51 08
					39 01 00 00 00 00 02 52 08
					39 01 00 00 00 00 02 53 08
					39 01 00 00 00 00 02 54 08
					39 01 00 00 00 00 02 55 08
					39 01 00 00 00 00 02 56 08
					39 01 00 00 00 00 02 57 08
					39 01 00 00 00 00 02 58 08
					39 01 00 00 00 00 02 59 08
					39 01 00 00 00 00 02 5A 09
					39 01 00 00 00 00 02 5B 09
					39 01 00 00 00 00 02 5C 09
					39 01 00 00 00 00 02 5D 09
					39 01 00 00 00 00 02 5E 09
					39 01 00 00 00 00 02 5F 09

					39 01 00 00 00 00 02 60 09
					39 01 00 00 00 00 02 61 09
					39 01 00 00 00 00 02 62 09
					39 01 00 00 00 00 02 63 09
					39 01 00 00 00 00 02 64 09
					39 01 00 00 00 00 02 65 09
					39 01 00 00 00 00 02 66 0A
					39 01 00 00 00 00 02 67 0A
					39 01 00 00 00 00 02 68 0A
					39 01 00 00 00 00 02 69 0A
					39 01 00 00 00 00 02 6A 0A
					39 01 00 00 00 00 02 6B 0A
					39 01 00 00 00 00 02 6C 0A
					39 01 00 00 00 00 02 6D 0A
					39 01 00 00 00 00 02 6E 0A
					39 01 00 00 00 00 02 6F 0A

					39 01 00 00 00 00 02 70 0B
					39 01 00 00 00 00 02 71 0B
					39 01 00 00 00 00 02 72 0B
					39 01 00 00 00 00 02 73 0B
					39 01 00 00 00 00 02 74 0B
					39 01 00 00 00 00 02 75 0B
					39 01 00 00 00 00 02 76 0B
					39 01 00 00 00 00 02 77 0B
					39 01 00 00 00 00 02 78 0C
					39 01 00 00 00 00 02 79 0C
					39 01 00 00 00 00 02 7A 0C
					39 01 00 00 00 00 02 7B 0C
					39 01 00 00 00 00 02 7C 0C
					39 01 00 00 00 00 02 7D 0C
					39 01 00 00 00 00 02 7E 0C
					39 01 00 00 00 00 02 7F 0C

					39 01 00 00 00 00 04 FF 98 81 0A
					39 01 00 00 00 00 02 00 0C
					39 01 00 00 00 00 02 01 0C
					39 01 00 00 00 00 02 02 0C
					39 01 00 00 00 00 02 03 0C
					39 01 00 00 00 00 02 04 0D
					39 01 00 00 00 00 02 05 0D
					39 01 00 00 00 00 02 06 0D
					39 01 00 00 00 00 02 07 0D
					39 01 00 00 00 00 02 08 0D
					39 01 00 00 00 00 02 09 0D
					39 01 00 00 00 00 02 0A 0D
					39 01 00 00 00 00 02 0B 0D
					39 01 00 00 00 00 02 0C 0E
					39 01 00 00 00 00 02 0D 0E
					39 01 00 00 00 00 02 0E 0E
					39 01 00 00 00 00 02 0F 0E

					39 01 00 00 00 00 02 10 0E
					39 01 00 00 00 00 02 11 0E
					39 01 00 00 00 00 02 12 0E
					39 01 00 00 00 00 02 13 0E
					39 01 00 00 00 00 02 14 0E
					39 01 00 00 00 00 02 15 0E
					39 01 00 00 00 00 02 16 0E
					39 01 00 00 00 00 02 17 0E
					39 01 00 00 00 00 02 18 0E
					39 01 00 00 00 00 02 19 0E
					39 01 00 00 00 00 02 1A 0E
					39 01 00 00 00 00 02 1B 0E
					39 01 00 00 00 00 02 1C 0E
					39 01 00 00 00 00 02 1D 0E
					39 01 00 00 00 00 02 1E 0E
					39 01 00 00 00 00 02 1F 0E

					39 01 00 00 00 00 02 20 0E
					39 01 00 00 00 00 02 21 0E
					39 01 00 00 00 00 02 22 0E
					39 01 00 00 00 00 02 23 0E
					39 01 00 00 00 00 02 24 0E
					39 01 00 00 00 00 02 25 0E
					39 01 00 00 00 00 02 26 0E
					39 01 00 00 00 00 02 27 0E
					39 01 00 00 00 00 02 28 0E
					39 01 00 00 00 00 02 29 0E
					39 01 00 00 00 00 02 2A 0F
					39 01 00 00 00 00 02 2B 0F
					39 01 00 00 00 00 02 2C 0F
					39 01 00 00 00 00 02 2D 0F
					39 01 00 00 00 00 02 2E 0F
					39 01 00 00 00 00 02 2F 0F

					39 01 00 00 00 00 02 30 10
					39 01 00 00 00 00 02 31 10
					39 01 00 00 00 00 02 32 10
					39 01 00 00 00 00 02 33 10
					39 01 00 00 00 00 02 34 10
					39 01 00 00 00 00 02 35 10
					39 01 00 00 00 00 02 36 11
					39 01 00 00 00 00 02 37 11
					39 01 00 00 00 00 02 38 11
					39 01 00 00 00 00 02 39 11
					39 01 00 00 00 00 02 3A 12
					39 01 00 00 00 00 02 3B 12
					39 01 00 00 00 00 02 3C 12
					39 01 00 00 00 00 02 3D 12
					39 01 00 00 00 00 02 3E 12
					39 01 00 00 00 00 02 3F 12

					39 01 00 00 00 00 02 40 13
					39 01 00 00 00 00 02 41 13
					39 01 00 00 00 00 02 42 13
					39 01 00 00 00 00 02 43 13
					39 01 00 00 00 00 02 44 13
					39 01 00 00 00 00 02 45 13
					39 01 00 00 00 00 02 46 13
					39 01 00 00 00 00 02 47 13
					39 01 00 00 00 00 02 48 14
					39 01 00 00 00 00 02 49 14
					39 01 00 00 00 00 02 4A 14
					39 01 00 00 00 00 02 4B 14
					39 01 00 00 00 00 02 4C 14
					39 01 00 00 00 00 02 4D 14
					39 01 00 00 00 00 02 4E 14
					39 01 00 00 00 00 02 4F 14

					39 01 00 00 00 00 02 50 14
					39 01 00 00 00 00 02 51 14
					39 01 00 00 00 00 02 52 14
					39 01 00 00 00 00 02 53 14
					39 01 00 00 00 00 02 54 14
					39 01 00 00 00 00 02 55 14
					39 01 00 00 00 00 02 56 14
					39 01 00 00 00 00 02 57 14
					39 01 00 00 00 00 02 58 14
					39 01 00 00 00 00 02 59 14
					39 01 00 00 00 00 02 5A 14
					39 01 00 00 00 00 02 5B 14
					39 01 00 00 00 00 02 5C 14
					39 01 00 00 00 00 02 5D 14
					39 01 00 00 00 00 02 5E 14
					39 01 00 00 00 00 02 5F 14

					39 01 00 00 00 00 02 60 14
					39 01 00 00 00 00 02 61 14
					39 01 00 00 00 00 02 62 14
					39 01 00 00 00 00 02 63 14
					39 01 00 00 00 00 02 64 14
					39 01 00 00 00 00 02 65 14
					39 01 00 00 00 00 02 66 14
					39 01 00 00 00 00 02 67 14
					39 01 00 00 00 00 02 68 12
					39 01 00 00 00 00 02 69 12
					39 01 00 00 00 00 02 6A 12
					39 01 00 00 00 00 02 6B 12
					39 01 00 00 00 00 02 6C 12
					39 01 00 00 00 00 02 6D 12
					39 01 00 00 00 00 02 6E 12
					39 01 00 00 00 00 02 6F 12

					39 01 00 00 00 00 02 70 08
					39 01 00 00 00 00 02 71 08
					39 01 00 00 00 00 02 72 08
					39 01 00 00 00 00 02 73 08
					39 01 00 00 00 00 02 74 04
					39 01 00 00 00 00 02 75 04
					39 01 00 00 00 00 02 76 04
					39 01 00 00 00 00 02 77 04
					39 01 00 00 00 00 02 78 02
					39 01 00 00 00 00 02 79 02
					39 01 00 00 00 00 02 7A 02
					39 01 00 00 00 00 02 7B 02
					39 01 00 00 00 00 02 7C 02
					39 01 00 00 00 00 02 7D 02
					39 01 00 00 00 00 02 7E 06
					39 01 00 00 00 00 02 7F 06

					/* Initializing  Sequence Page 0 */
					39 01 00 00 00 00 04 FF 98 81 00
					39 01 00 00 05 00 02 53 2C
					39 01 00 00 05 00 02 55 03

					05 01 00 00 78 00 02 11 00  // Sleep Out  wait 120ms
					05 01 00 00 28 00 02 29 00  // Display On
					39 01 00 00 00 00 02 35 00  // TE on
		];
		qcom,mdss-dsi-on-command-state = "dsi_lp_mode";
		qcom,mdss-dsi-off-command-state = "dsi_hs_mode";
		qcom,mdss-dsi-off-command = [
					05 01 00 00 32 00 02 28 00	/* wait 50ms(0x32) */
					05 01 00 00 96 00 02 10 00	/* wait 150ms(0x96) */
					];
		samsung,mdss-dsi-bl-scale-low-level = <8>;
		samsung,mdss-dsi-bl-scale-dim-level = <8>;
		samsung,mdss-dsi-bl-scale-default-level = <89>;
		samsung,mdss-dsi-bl-scale-max-level = <188>;
		samsung,mdss-dsi-bl-pms-low-level = <1>;
		samsung,mdss-dsi-bl-pms-dim-level = <15>;
		samsung,mdss-dsi-bl-pms-default-level = <134>;
		samsung,mdss-dsi-bl-pms-max-level = <255>;
/*
 * ************************************************************************************************************************************
 *
 *
 *			Below  parameters are samsung dependent thigs
 *
 *
 * ************************************************************************************************************************************
 */
		samsung,tft-common-support;
		samsung,mdnie-tuning-enable-tft;
		samsung,lcd-display-format-bgr;
		samsung,level2_key_enable_tx_cmds_revA = [
			39 01 00 00 00 00 03 F0 5A 5A
		];
		samsung,level2_key_disable_tx_cmds_revA = [
			39 01 00 00 00 00 03 F0 A5 A5
		];
		samsung,packet_size_tx_cmds_revA = [
			37 01 00 00 00 00 02 07 00
		];
		/*
		 * First parameters can be changed
		 * by function of samsung_nv_read()
		 * because of that means offset of
		 * read position
		 */
		samsung,reg_read_pos_tx_cmds_revA = [
			15 01 00 00 00 00 02 B0 00
		];
		samsung,manufacture_id0_rx_cmds_revA = [06 01 00 00 00 00 01 da 03 00];
		samsung,manufacture_id1_rx_cmds_revA = [06 01 00 00 00 00 01 db 03 00];
		samsung,manufacture_id2_rx_cmds_revA = [06 01 00 00 00 00 01 dc 03 00];
/*
		* Command sets for CABC control
*/
		samsung,panel-vendor = "HSD";
		samsung,tft_pwm_tx_cmds_revA=[
			39 01 00 00 00 00 03 51 0F FF/*First command should be PWM duty change command*/
		];
		samsung,cabc_on_tx_cmds_revA = [
			39 01 00 00 00 00 02 55 03
		];
		samsung,cabc_off_tx_cmds_revA = [
			39 01 00 00 00 00 02 55 00
		];
		/*
		* ************************************************************************************************************************
		* Scaled level to index mappings
		* ************************************************************************************************************************
		*/
		
		samsung,scaled_level_map_table_revA = <
		/*<idx>	  <from>  <till> <scaled_level> */
			0		0		0		0
			1		1		7		1
			2		8		11		3
			3		12		14		6
			4		15		17		9
			5		18		19		10
			6		20		22		11
			7		23		24		13
			8		25		27		15
			9		28		29		17
			10		30		32		19
			11		33		34		20
			12		35		37		21
			13		38		39		22
			14		40		42		24
			15		43		44		25
			16		45		47		26
			17		48		49		27
			18		50		52		28
			19		53		54		29
			20		55		57		30
			21		58		59		32
			22		60		62		34
			23		63		64		36
			24		65		67		38
			25		68		70		40
			26		71		72		42
			27		73		75		44
			28		76		77		46
			29		78		80		48
			30		81		82		50
			31		83		85		52
			32		86		87		54
			33		88		90		56
			34		91		92		58
			35		93		95		60
			36		96		97		62
			37		98		100		64
			38		101		102		66
			39		103		105		68
			40		106		107		70
			41		108		110		72
			42		111		112		74
			43		113		115		76
			44		116		117		78
			45		118		120		80
			46		121		122		82
			47		123		125		84
			48		126		127		86
			49		128		130		88
			50		131		133		90
			51		134		135		92
			52		136		138		93
			53		139		140		94
			54		141		143		96
			55		144		145		98
			56		146		148		100
			57		149		150		102
			58		151		153		104
			59		154		155		106
			60		156		158		108
			61		159		160		110
			62		161		163		112
			63		164		165		114
			64		166		168		116
			65		169		170		118
			66		171		173		120
			67		174		175		122
			68		176		178		124
			69		179		180		126
			70		181		183		128
			71		184		185		130
			72		186		188		132
			72		189		190		134
			74		191		193		136
			75		194		196		138
			76		197		198		140
			77		199		201		142
			78		202		203		144
			79		204		206		146
			80		207		208		148
			81		209		211		150
			82		212		213		152
			83		214		216		154
			84		217		218		156
			85		219		221		158
			86		222		223		162
			87		224		226		166
			88		227		228		170
			89		229		231		174
			90		232		233		178
			91		234		236		182
			92		237		238		186
			93		239		241		190
			94		242		243		192
			95		244		246		196
			96		247		248		198
			97		249		251		200
			98		252		253		202
			99		254		255		204
		>;
	};
};
