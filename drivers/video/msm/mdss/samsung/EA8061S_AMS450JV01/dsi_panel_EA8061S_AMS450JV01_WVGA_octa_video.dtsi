/* Copyright (c) 2013-2014, The Linux Foundation. All rights reserved.
 *
 * This program is free software; you can redistribute it and/or modify
 * it under the terms of the GNU General Public License version 2 and
 * only version 2 as published by the Free Software Foundation.
 *
 * This program is distributed in the hope that it will be useful,
 * but WITHOUT ANY WARRANTY; without even the implied warranty of
 * MERCHANTABILITY or FITNESS FOR A PARTICULAR PURPOSE.  See the
 * GNU General Public License for more details.
 */

/*---------------------------------------------------------------------------
 * This file is autogenerated file using gcdb parser. Please do not edit it.
 * Update input XML file to add a new entry or update variable in this file
 * VERSION = "1.0"
 *--------------------------------------------------------------------------- */
&mdss_mdp {
	ss_dsi_panel_EA8061S_AMS450JV01_WVGA: ss_dsi_panel_EA8061S_AMS450JV01_WVGA {
		qcom,mdss-dsi-panel-name = "ss_dsi_panel_EA8061S_AMS450JV01_WVGA";
		label = "ss_dsi_panel_EA8061S_AMS450JV01_WVGA";
		qcom,mdss-dsi-panel-controller = <&mdss_dsi0>;

		qcom,mdss-dsi-panel-width = <480>;
		qcom,mdss-dsi-panel-height = <800>;
		qcom,mdss-dsi-bpp = <24>;
		qcom,mdss-dsi-panel-destination = "display_1";
		//qcom,mdss-dsi-panel-timings = [88 1C 12 00 48 48 22 24 16 03 04 00]; // 461 Mbps
		qcom,mdss-dsi-panel-timings = [6F 16 0E 00 38 3C 12 1A 13 03 04 00]; // 365 Mbps

		qcom,mdss-dsi-on-command = [
			39 01 00 00 00 00 03 F0 5A 5A			// 3.1 Common Setting
			39 01 00 00 00 00 02 BA 74			// Source Slew
			39 01 00 00 00 00 03 B8 19 00			// A_swire_off

			05 01 00 00 14 00 02 11 00			// sleep out & Wait 20 ms

			39 01 00 00 01 00 22 CA				// 350 nit / 2.2 Gamma
			01 00 01 00 01 00
			80 80 80
			80 80 80
			80 80 80
			80 80 80
			80 80 80
			80 80 80
			80 80 80
			80 80 80
			00 00 00
			39 01 00 00 01 00 05 B2 00 00 00 0A	// AOR 0%
			39 01 00 00 00 00 03 B6 CC 8B			// ELVSS SET
			39 01 00 00 00 00 02 F7 03			// Gamma, AID Update
			39 01 00 00 78 00 03 F0 A5 A5			// Wait 120 ms
		];

		qcom,mdss-dsi-off-command = [
			05 01 00 00 22 00 02 28 00
			05 01 00 00 96 00 02 10 00
		];

		qcom,cont-splash-enabled;
		qcom,mdss-dsi-h-back-porch = <40>;
		qcom,mdss-dsi-h-front-porch = <76>;
		qcom,mdss-dsi-h-pulse-width = <20>;
		qcom,mdss-dsi-h-sync-skew = <0>;
		qcom,mdss-dsi-v-back-porch = <8>;
		qcom,mdss-dsi-v-front-porch = <14>;
		qcom,mdss-dsi-v-pulse-width = <2>;

		qcom,mdss-dsi-h-left-border = <0>;
		qcom,mdss-dsi-h-right-border = <0>;
		qcom,mdss-dsi-v-top-border = <0>;
		qcom,mdss-dsi-v-bottom-border = <0>;

		qcom,mdss-dsi-underflow-color = <0xff>;
		qcom,mdss-dsi-border-color = <0>;

		qcom,mdss-dsi-bl-pmic-control-type = "bl_ctrl_dcs";
		qcom,mdss-dsi-bl-min-level = <1>;
		qcom,mdss-dsi-bl-max-level = <255>;
		qcom,mdss-brightness-max-level = <255>;
		qcom,mdss-dsi-panel-type = "dsi_video_mode";
		qcom,mdss-dsi-gamma-update = [39 01 00 00 00 00 02 F7 01];
		qcom,mdss-dsi-h-sync-pulse = <0>;
		qcom,mdss-dsi-bllp-eof-power-mode;
		qcom,mdss-dsi-bllp-power-mode;
		qcom,mdss-dsi-traffic-mode = "burst_mode";
		qcom,mdss-dsi-virtual-channel-id = <0>;
		qcom,mdss-dsi-lane-0-state;
		qcom,mdss-dsi-lane-1-state;
		/*qcom,mdss-dsi-lane-2-state;*/
		/*qcom,mdss-dsi-lane-3-state;*/

		qcom,mdss-dsi-t-clk-pre = <0x1B>;
		qcom,mdss-dsi-t-clk-post = <0x04>;

		qcom,mdss-dsi-stream = <0>;
		qcom,mdss-dsi-mdp-trigger = "none";
		qcom,mdss-dsi-dma-trigger = "trigger_sw";
		qcom,mdss-dsi-panel-framerate = <60>;
		qcom,mdss-dsi-on-command-state = "dsi_lp_mode";
		qcom,mdss-dsi-off-command-state = "dsi_hs_mode";
		qcom,mdss-pan-physical-width-dimension = <59>;
		qcom,mdss-pan-physical-height-dimension = <98>;
		qcom,mdss-dsi-force-clk-lane-hs = <1>;
		qcom,mdss-dsi-reset-sequence = <1 20>, <0 1>, <1 20>;

		qcom,mdss-dsi-lp11-init;
		qcom,mdss-dsi-init-delay-us = <2000>;
		qcom,mdss-power-off-delay-us = <12000>;
		samsung,mdss-power-on-reset-delay-us = <20000>;
/*
 * ************************************************************************************************************************************
 *
 *			Below  parameters are samsung dependent thigs
 *
 * ************************************************************************************************************************************
 */
		//samsung,dsi-lp11-init;
		samsung,packet_size_tx_cmds_revA  = [37 01 00 00 00 00 02 07 00];
		samsung,reg_read_pos_tx_cmds_revA = [15 01 00 00 00 00 02 B0 00];
		samsung,display_on_tx_cmds_revA   = [05 01 00 00 00 00 02 29 00];
		samsung,display_off_tx_cmds_revA  = [05 01 00 00 32 00 02 28 00];

		samsung,level1_key_enable_tx_cmds_revA  = [29 01 00 00 00 00 03 F0 5A 5A];
		samsung,level1_key_disable_tx_cmds_revA = [29 01 00 00 00 00 03 F0 A5 A5];
		samsung,level2_key_enable_tx_cmds_revA = [
			29 00 00 00 00 00 03 F0 5A 5A
			29 01 00 00 00 00 03 F1 5A 5A
		];
		samsung,level2_key_disable_tx_cmds_revA = [
			29 00 00 00 00 00 03 F0 A5 A5
			29 01 00 00 00 00 03 F1 A5 A5
		];

		/*
		 * ************************************************************************************************************************
		 *	 06 01 00 00 00 00 01 c8 07 21
		 *	READ 0xC8 SIZE 0x07 OFFSET 0x21
		 * ************************************************************************************************************************
		 *        SAMPLE :  samsung,hbm2_rx_cmds_revE = [ 06 01 00 00 00 00 01 FE 01 21];	 // read DB 34th , 33=0x21
		 * ************************************************************************************************************************
		 */
		samsung,panel-mtp-read-cmds = [ 39 01 00 00 00 00 03 FD DA 00];

		//=================================
		// REV. A
		//=================================
		samsung,smart_dimming_mtp_rx_cmds_revA = [ 06 01 00 00 00 00 01 C8 21 00];
		samsung,manufacture_read_pre_tx_cmds_revA = [
			05 01 00 00 78 00 02 11 00    /* sleep out */
			39 01 00 00 00 00 03 FD DA 00 /* mtp read  */
		];
		samsung,manufacture_id0_rx_cmds_revA   = [ 06 01 00 00 00 00 01 DA 01 00];
		samsung,manufacture_id1_rx_cmds_revA   = [ 06 01 00 00 00 00 01 DB 01 00];
		samsung,manufacture_id2_rx_cmds_revA   = [ 06 01 00 00 00 00 01 DC 01 00];
		samsung,manufacture_date_rx_cmds_revA  = [ 06 01 00 00 00 00 01 A1 02 04];	// read A1 5~6th
		samsung,cell_id_rx_cmds_revA           = [ 06 01 00 00 00 00 01 A1 0B 00];	// read A1 1~11th
		samsung,mtp_read_sysfs_rx_cmds_revA    = [ 06 01 00 00 00 00 01 01 01 01];
		samsung,elvss_rx_cmds_revA             = [ 06 01 00 00 00 00 01 C8 01 27];	// read C6 21th, 20=0x14
		samsung,mdnie_read_rx_cmds_revA        = [ 06 01 00 00 00 00 01 A1 04 00];
		samsung,ldi_debug0_rx_cmds_revA        = [ 06 01 00 00 00 00 01 0A 01 00];
		samsung,ldi_debug1_rx_cmds_revA        = [ 06 01 00 00 00 00 01 0E 01 00];
		samsung,ldi_debug2_rx_cmds_revA        = [ 06 01 00 00 00 00 01 EA 08 00];
		samsung,hbm_rx_cmds_revA               = [ 06 01 00 00 00 00 01 C8 06 21];	// read DB 1~21th, 00=0x00
		samsung,hbm2_rx_cmds_revA              = [ 06 01 00 00 00 00 01 C8 0F 2A];	// read DB 34th, 33=0x21

		/*
		 * ************************************************************************************************************************
		 *	 COMMON CMD LIST
		 * ************************************************************************************************************************
		 */
		samsung,elvss_lowtemp_tx_cmds_revA  = [29 01 00 00 00 00 02 B8 19 ];		/* Low Temperature Command */
		samsung,elvss_lowtemp2_tx_cmds_revA = [29 01 00 00 00 00 02 B6 00 ];		/* Low Temperature Command: default */

		//========================================
		// Gamma and HBM (REV. A)
		//========================================
		samsung,gamma_tx_cmds_revA = [
			39 01 00 00 01 00 22 CA				// 350 nit / 2.2 Gamma
			01 00 01 00 01 00
			80 80 80
			80 80 80
			80 80 80
			80 80 80
			80 80 80
			80 80 80
			80 80 80
			80 80 80
			00 00 00
			39 01 00 00 00 00 02 F7 03			// Gamma, AID Update
		];

		samsung,hbm_gamma_tx_cmds_revA = [
			39 01 00 00 00 00 03 F7 5A 5A
			39 01 00 00 00 00 21 CA 01
			00 01 00 01 00 80 80 80
			80 80 80 80 80 80 80 80
			80 80 80 80 80 80 80 80
			80 80 80 80 80 00 00
			39 01 00 00 00 00 03 F7 A5 A5
		];

		samsung,hbm_etc_tx_cmds_revA = [
			39 01 00 00 01 00 05 B2 00 00 00 0A
			39 00 00 00 00 00 03 B6 CC 8B
			39 01 00 00 00 00 02 53 C0
			39 01 00 00 00 00 02 F7 03
		];

		samsung,hbm_off_tx_cmds_revA = [
			39 01 00 00 01 00 05 B2 00 00 00 0A
			39 00 00 00 00 00 03 B6 CC 8B
			39 01 00 00 00 00 02 53 00
			39 01 00 00 00 00 02 F7 03
		];

		/*
		* ************************************************************************************************************************
		* AID command list and mappings
		* ************************************************************************************************************************
		*/
		samsung,aid_tx_cmds_revA = [
			39 01 00 00 00 00 05 B2 00 00 03 1A /*  0 samsung_brightness_aor_96p37 5*/
			39 01 00 00 00 00 05 B2 00 00 03 13 /*  1 samsung_brightness_aor_95p29 6*/
			39 01 00 00 00 00 05 B2 00 00 03 0C /*  2 samsung_brightness_aor_94p29 7*/
			39 01 00 00 00 00 05 B2 00 00 03 07 /*  3 samsung_brightness_aor_93p75 8*/
			39 01 00 00 00 00 05 B2 00 00 02 FE /*  4 samsung_brightness_aor_92p82 9*/
			39 01 00 00 00 00 05 B2 00 00 02 F9 /*  5 samsung_brightness_aor_91p82 10*/
			39 01 00 00 00 00 05 B2 00 00 02 F1 /*  6 samsung_brightness_aor_90p74 11*/
			39 01 00 00 00 00 05 B2 00 00 02 EF /*  7 samsung_brightness_aor_90p28 12*/
			39 01 00 00 00 00 05 B2 00 00 02 E8 /*  8 samsung_brightness_aor_89p20 13*/
			39 01 00 00 00 00 05 B2 00 00 02 E3 /*  9 samsung_brightness_aor_88p12 14*/
			39 01 00 00 00 00 05 B2 00 00 02 DB /* 10 samsung_brightness_aor_87p11 15*/
			39 01 00 00 00 00 05 B2 00 00 02 D4 /* 11 samsung_brightness_aor_86p57 16*/
			39 01 00 00 00 00 05 B2 00 00 02 CE /* 12 samsung_brightness_aor_85p57 17*/
			39 01 00 00 00 00 05 B2 00 00 02 C5 /* 13 samsung_brightness_aor_83p41 19*/
			39 01 00 00 00 00 05 B2 00 00 02 B2 /* 14 samsung_brightness_aor_82p87 20*/
			39 01 00 00 00 00 05 B2 00 00 02 AA /* 15 samsung_brightness_aor_81p87 21*/
			39 01 00 00 00 00 05 B2 00 00 02 A1 /* 16 samsung_brightness_aor_81p40 22*/
			39 01 00 00 00 00 05 B2 00 00 02 92 /* 17 samsung_brightness_aor_79p32 24*/
			39 01 00 00 00 00 05 B2 00 00 02 88 /* 18 samsung_brightness_aor_78p24 25*/
			39 01 00 00 00 00 05 B2 00 00 02 78 /* 19 samsung_brightness_aor_76p24 27*/
			39 01 00 00 00 00 05 B2 00 00 02 6A /* 20 samsung_brightness_aor_74p69 29*/
			39 01 00 00 00 00 05 B2 00 00 02 66 /* 21 samsung_brightness_aor_74p23 30*/
			39 01 00 00 00 00 05 B2 00 00 02 54 /* 22 samsung_brightness_aor_72p07 32*/
			39 01 00 00 00 00 05 B2 00 00 02 45 /* 23 samsung_brightness_aor_70p68 34*/
			39 01 00 00 00 00 05 B2 00 00 02 2F /* 24 samsung_brightness_aor_68p06 37*/
			39 01 00 00 00 00 05 B2 00 00 02 1F /* 25 samsung_brightness_aor_65p74 39*/
			39 01 00 00 00 00 05 B2 00 00 02 11 /* 26 samsung_brightness_aor_64p35 41*/
			39 01 00 00 00 00 05 B2 00 00 02 00 /* 27 samsung_brightness_aor_61p11 44*/
			39 01 00 00 00 00 05 B2 00 00 01 EA /* 28 samsung_brightness_aor_58p49 47*/
			39 01 00 00 00 00 05 B2 00 00 01 D0 /* 29 samsung_brightness_aor_55p71 50*/
			39 01 00 00 00 00 05 B2 00 00 01 B9 /* 30 samsung_brightness_aor_52p47 53*/
			39 01 00 00 00 00 05 B2 00 00 01 A9 /* 31 samsung_brightness_aor_49p69 56*/
			39 01 00 00 00 00 05 B2 00 00 01 85 /* 32 samsung_brightness_aor_45p99 60*/
			39 01 00 00 00 00 05 B2 00 00 01 67 /* 33 samsung_brightness_aor_42p52 64*/
			39 01 00 00 00 00 05 B2 00 00 01 46 /* 34 samsung_brightness_aor_39p89 68 ~ 111 */
			39 01 00 00 00 00 05 B2 00 00 01 20 /* 35 samsung_brightness_aor_39p89 119*/
			39 01 00 00 00 00 05 B2 00 00 00 FD /* 36 samsung_brightness_aor_33p95 126*/
			39 01 00 00 00 00 05 B2 00 00 00 D7 /* 37 samsung_brightness_aor_29p78 134*/
			39 01 00 00 00 00 05 B2 00 00 00 AD /* 38 samsung_brightness_aor_23p77 143*/
			39 01 00 00 00 00 05 B2 00 00 00 80 /* 39 samsung_brightness_aor_18p83 152*/
			39 01 00 00 00 00 05 B2 00 00 00 52 /* 40 samsung_brightness_aor_12p89 162*/
			39 01 00 00 00 00 05 B2 00 00 00 21 /* 41 samsung_brightness_aor_07p56 172*/
			39 01 00 00 00 00 05 B2 00 00 00 0A /* 42 samsung_brightness_aor_00p46 183 ~ 350*/
		];

		samsung,aid_map_table_revA = <
			5	0		6	1		7	2		8	3		9	4
			10	5		11	6		12	7		13	8		14	9
			15	10		16	11		17	12		19	13		20	14
			21	15		22	16		24	17		25	18		27	19
			29	20		30	21		32	22		34	23		37	24
			39	25		41	26		44	27		47	28		50	29
			53	30		56	31		60	32		64	33		68	34
			72	34		77	34		82	34		87	34		93	34
			98	34		105	34		111	34		119	35		126	36
			134	37		143	38		152	39		162	40		172	41
			183	42		195	42		207	42		220	42		234	42
			249	42		265	42		282	42		300	42		316	42
			333	42		350	42
		>;

		//========================================
		// ACL command list and mappings (REV. A)
		//========================================
		samsung,samsung_change_acl_by_brightness;
		samsung,acl_on_tx_cmds_revA  = [
			39 01 00 00 00 00 02 55 02	// ACL : 15 %
			39 01 00 00 00 00 02 F7 03
		];
		samsung,acl_off_tx_cmds_revA = [
			39 01 00 00 00 00 02 55 00	// ACL : OFF
			39 01 00 00 00 00 02 F7 03
		];

		samsung,acl_percent_tx_cmds_revA = [
			39 00 00 00 00 00 02 55 00	// 0x00 : ACL OFF
			39 00 00 00 00 00 02 55 01
			39 00 00 00 00 00 02 55 02	// 0x02 : ACL 15 %
			39 00 00 00 00 00 02 55 03
		];

		samsung,acl_map_table_revA =  <
			5    2	6    2	7    2	8    2	9    2
			10   2	11   2	12   2	13   2	14   2
			15   2	16   2	17   2	19   2	20   2
			21   2	22   2	24   2	25   2	27   2
			29   2	30   2	32   2	34   2	37   2
			39   2	41   2	44   2	47   2	50   2
			53   2	56   2	60   2	64   2	68   2
			72   2	77   2	82   2	87   2	93   2
			98   2	105  2	111  2	119  2	126  2
			134  2	143  2	152  2	162  2	172  2
			183  2	195  2	207  2	220  2	234  2
			249  2	265  2	282  2	300  2	316  2
			333  2	350  2
		>;

		/*
		 * ************************************************************************************************************************
		 * ELVSS(ACL Off) command list and mappings
		 * ************************************************************************************************************************
		 */
		samsung,elvss_tx_cmds_revA = [
			39 01 00 00 00 00 03 B6 CC 8B /* 0    5 nit */
			39 01 00 00 00 00 03 B6 CC 8B /* 1    6 nit */
			39 01 00 00 00 00 03 B6 CC 8B /* 2    7 nit */
			39 01 00 00 00 00 03 B6 CC 8B /* 3    8 nit */
			39 01 00 00 00 00 03 B6 CC 8B /* 4    9 nit */
			39 01 00 00 00 00 03 B6 CC 8B /* 5    10 nit */
			39 01 00 00 00 00 03 B6 CC 8B /* 6    11 nit */
			39 01 00 00 00 00 03 B6 CC 8B /* 7    12 nit */
			39 01 00 00 00 00 03 B6 CC 8B /* 8    13 nit */
			39 01 00 00 00 00 03 B6 CC 8B /* 9    14 nit */
			39 01 00 00 00 00 03 B6 CC 8B /* 10   15 nit */
			39 01 00 00 00 00 03 B6 CC 8B /* 11   16 ~ 19 nit */
			39 01 00 00 00 00 03 B6 CC 8D /* 12   20 nit */
			39 01 00 00 00 00 03 B6 CC 8F /* 13   21 nit */
			39 01 00 00 00 00 03 B6 CC 91 /* 14   22 nit */
			39 01 00 00 00 00 03 B6 CC 93 /* 15   24 nit */
			39 01 00 00 00 00 03 B6 CC 95 /* 16   25 nit */
			39 01 00 00 00 00 03 B6 CC 97 /* 17   27 nit */
			39 01 00 00 00 00 03 B6 CC 99 /* 18   29 nit */
			39 01 00 00 00 00 03 B6 CC 9A /* 19   30 ~ 93 nit */
			39 01 00 00 00 00 03 B6 CC 99 /* 20   98  nit */
			39 01 00 00 00 00 03 B6 CC 98 /* 21   105 nit */
			39 01 00 00 00 00 03 B6 CC 96 /* 22   111 nit */
			39 01 00 00 00 00 03 B6 CC 96 /* 23   119 nit */
			39 01 00 00 00 00 03 B6 CC 96 /* 24   126 nit */
			39 01 00 00 00 00 03 B6 CC 96 /* 25   134 nit */
			39 01 00 00 00 00 03 B6 CC 96 /* 26   143 nit */
			39 01 00 00 00 00 03 B6 CC 96 /* 27   152 nit */
			39 01 00 00 00 00 03 B6 CC 95 /* 28   162 nit */
			39 01 00 00 00 00 03 B6 CC 95 /* 29   172 nit */
			39 01 00 00 00 00 03 B6 CC 95 /* 30   183 nit */
			39 01 00 00 00 00 03 B6 CC 94 /* 31   195 nit */
			39 01 00 00 00 00 03 B6 CC 93 /* 32   207 nit */
			39 01 00 00 00 00 03 B6 CC 92 /* 33   220 nit */
			39 01 00 00 00 00 03 B6 CC 92 /* 34   234 nit */
			39 01 00 00 00 00 03 B6 CC 91 /* 35   249 nit */
			39 01 00 00 00 00 03 B6 CC 90 /* 36   265 nit */
			39 01 00 00 00 00 03 B6 CC 8F /* 37   282 nit */
			39 01 00 00 00 00 03 B6 CC 8E /* 38   300 nit */
			39 01 00 00 00 00 03 B6 CC 8D /* 39   316 nit */
			39 01 00 00 00 00 03 B6 CC 8C /* 40   333 nit */
			39 01 00 00 00 00 03 B6 CC 8B /* 41   350 nit */
		];

		/*
		 * ************************************************************************************************************************
		 * SMART ACL(ACL On) ELVSS command list and mappings
		 * ************************************************************************************************************************
		 */
		samsung,smart_acl_elvss_tx_cmds_revA = [
			39 01 00 00 00 00 03 B6 CC 8B /* 0    5 nit */
			39 01 00 00 00 00 03 B6 CC 8B /* 1    6 nit */
			39 01 00 00 00 00 03 B6 CC 8B /* 2    7 nit */
			39 01 00 00 00 00 03 B6 CC 8B /* 3    8 nit */
			39 01 00 00 00 00 03 B6 CC 8B /* 4    9 nit */
			39 01 00 00 00 00 03 B6 CC 8B /* 5    10 nit */
			39 01 00 00 00 00 03 B6 CC 8B /* 6    11 nit */
			39 01 00 00 00 00 03 B6 CC 8B /* 7    12 nit */
			39 01 00 00 00 00 03 B6 CC 8B /* 8    13 nit */
			39 01 00 00 00 00 03 B6 CC 8B /* 9    14 nit */
			39 01 00 00 00 00 03 B6 CC 8B /* 10   15 nit */
			39 01 00 00 00 00 03 B6 CC 8B /* 11   16 ~ 19 nit */
			39 01 00 00 00 00 03 B6 CC 8D /* 12   20 nit */
			39 01 00 00 00 00 03 B6 CC 8F /* 13   21 nit */
			39 01 00 00 00 00 03 B6 CC 91 /* 14   22 nit */
			39 01 00 00 00 00 03 B6 CC 93 /* 15   24 nit */
			39 01 00 00 00 00 03 B6 CC 95 /* 16   25 nit */
			39 01 00 00 00 00 03 B6 CC 97 /* 17   27 nit */
			39 01 00 00 00 00 03 B6 CC 99 /* 18   29 nit */
			39 01 00 00 00 00 03 B6 CC 9A /* 19   30 ~ 93 nit */
			39 01 00 00 00 00 03 B6 CC 99 /* 20   98  nit */
			39 01 00 00 00 00 03 B6 CC 98 /* 21   105 nit */
			39 01 00 00 00 00 03 B6 CC 96 /* 22   111 nit */
			39 01 00 00 00 00 03 B6 CC 96 /* 23   119 nit */
			39 01 00 00 00 00 03 B6 CC 96 /* 24   126 nit */
			39 01 00 00 00 00 03 B6 CC 96 /* 25   134 nit */
			39 01 00 00 00 00 03 B6 CC 96 /* 26   143 nit */
			39 01 00 00 00 00 03 B6 CC 96 /* 27   152 nit */
			39 01 00 00 00 00 03 B6 CC 95 /* 28   162 nit */
			39 01 00 00 00 00 03 B6 CC 95 /* 29   172 nit */
			39 01 00 00 00 00 03 B6 CC 95 /* 30   183 nit */
			39 01 00 00 00 00 03 B6 CC 94 /* 31   195 nit */
			39 01 00 00 00 00 03 B6 CC 93 /* 32   207 nit */
			39 01 00 00 00 00 03 B6 CC 92 /* 33   220 nit */
			39 01 00 00 00 00 03 B6 CC 92 /* 34   234 nit */
			39 01 00 00 00 00 03 B6 CC 91 /* 35   249 nit */
			39 01 00 00 00 00 03 B6 CC 90 /* 36   265 nit */
			39 01 00 00 00 00 03 B6 CC 8F /* 37   282 nit */
			39 01 00 00 00 00 03 B6 CC 8E /* 38   300 nit */
			39 01 00 00 00 00 03 B6 CC 8D /* 39   316 nit */
			39 01 00 00 00 00 03 B6 CC 8C /* 40   333 nit */
			39 01 00 00 00 00 03 B6 CC 8B /* 41   350 nit */
		];

		/* bl_level, Index in elvss command list */
		samsung,smart_acl_elvss_map_table_revA = <
					5	0		6	1		7	2		8	3		9	4
					10	5		11	6		12	7		13	8		14	9
					15	10		16	11		17	11		19	11		20	12
					21	13		22	14		24	15		25	16		27	17
					29	18		30	19		32	19		34	19		37	19
					39	19		41	19		44	19		47	19		50	19
					53	19		56	19		60	19		64	19		68	19
					72	19		77	19		82	19		87	19		93	19
					98	20		105	21		111	22		119	23		126	24
					134	25		143	26		152	27		162	28		172	29
					183	30		195	31		207	32		220	33		234	34
					249	35		265	36		282	37		300	38		316	39
					333	40		350	41
		>;

		/*
		* ************************************************************************************************************************
		* candela to index mappings
		* ************************************************************************************************************************
		*/
		samsung,candela_map_table_revA = <
		/*<idx>	  <from>  <till> <candella> */
				0		0		5		5
				1		6		6		6
				2		7		7		7
				3		8		8		8
				4		9		9		9
				5		10		10		10
				6		11		11		11
				7		12		12		12
				8		13		13		13
				9		14		14		14
				10		15		15		15
				11		16		16		16
				12		17		17		17
				13		18		18		19
				14		19		19		20
				15		20		20		21
				16		21		21		22
				17		22		22		24
				18		23		23		25
				19		24		24		27
				20		25		25		29
				21		26		26		30
				22		27		27		32
				23		28		28		34
				24		29		29		37
				25		30		30		39
				26		31		32		41
				27		33		34		44
				28		35		36		47
				29		37		38		50
				30		39		40		53
				31		41		43		56
				32		44		45		60
				33		46		48		64
				34		49		51		68
				35		52		55		72
				36		56		59		77
				37		60		63		82
				38		64		67		87
				39		68		71		93
				40		71		74		98
				41		75		79		105
				42		80		85		111
				43		86		91		119
				44		92		97		126
				45		97		103		134
				46		104		110		143
				47		111		117		152
				48		118		125		162
				49		126		133		172
				50		134		142		183
				51		143		151		195
				52		152		161		207
				53		162		171		220
				54		172		182		234
				55		183		194		249
				56		195		206		265
				57		207		218		282
				58		219		230		300
				59		231		242		316
				60		243		253		333
				61		254		255		350
		>;
	};
};

&soc {
	mdss_mdp: qcom,mdss_mdp@1a00000 {
			qcom,mdss-clk-factor = <130 100>;	/* 1.3 times */
	};
};
