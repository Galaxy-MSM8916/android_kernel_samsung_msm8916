/* Copyright (c) 2013-2014, The Linux Foundation. All rights reserved.
 *
 * This program is free software; you can redistribute it and/or modify
 * it under the terms of the GNU General Public License version 2 and
 * only version 2 as published by the Free Software Foundation.
 *
 * This program is distributed in the hope that it will be useful,
 * but WITHOUT ANY WARRANTY; without even the implied warranty of
 * MERCHANTABILITY or FITNESS FOR A PARTICULAR PURPOSE.  See the
 * GNU General Public License for more details.
 */

/*---------------------------------------------------------------------------
 * This file is autogenerated file using gcdb parser. Please do not edit it.
 * Update input XML file to add a new entry or update variable in this file
 * VERSION = "1.0"
 *---------------------------------------------------------------------------*/
&mdss_mdp {
	dsi_samsung_fhd: ss_dsi_panel_S6E3FA3_AMS520KG01_FHD {
		qcom,mdss-dsi-panel-name = "ss_dsi_panel_S6E3FA3_AMS520KG01_FHD";
		qcom,mdss-dsi-panel-controller = <&mdss_dsi0>;
		qcom,mdss-dsi-panel-width = <1080>;
		qcom,mdss-dsi-panel-height = <1920>;
		qcom,mdss-dsi-bpp = <24>;
		qcom,mdss-dsi-panel-destination = "display_1";

		qcom,mdss-dsi-panel-timings = [E6 38 26 00 68 6E 2A 46 2C 03 04 00];

		qcom,mdss-dsi-on-command= [
			05 01 00 00 14 00 02 11 00			/* Sleep out, wait 20ms(0x14) */

			/* TE Vsync On */
			29 01 00 00 00 00 02 35 00

			/* AVC setting */
			29 01 00 00 00 00 03 FC 5A 5A		/* TEST KEY Enable */
			29 01 00 00 00 00 02 B0 1E
			29 01 00 00 00 00 02 FD 94
			29 01 00 00 00 00 03 FC A5 A5

			/* PCD Setting */
			29 01 00 00 00 00 03 FC 5A 5A		/* TEST KEY Enable */
			29 01 00 00 00 00 02 CC 4C
			29 01 00 00 00 00 03 FC A5 A5

			/* ERR_FG Setting */
			29 01 00 00 00 00 03 FC 5A 5A		/* TEST KEY Enable */
			29 01 00 00 00 00 02 ED 44
			29 01 00 00 00 00 03 FC A5 A5

			/* Brightness condition set */
			29 01 00 00 00 00 03 F0 5A 5A		/* TEST KEY Enable */
			29 01 00 00 00 00 24 CA				/* 1) Gamma 2.2 Setting */
				01 00 01 00 01 00	/* V255 R,G,B */
				80 80 80			/* V203 R,G,B */
				80 80 80			/* V151 R,G,B */
				80 80 80			/* V87 R,G,B */
				80 80 80			/* V51 R,G,B */
				80 80 80			/* V35 R,G,B */
				80 80 80			/* V23 R,G,B */
				80 80 80			/* V11 R,G,B */
				80 80 80			/*  V3 R,G,B */
				00 00 00			/*  V0 R,G,B */
				00 00				/*  VT R,G,B */
			29 01 00 00 00 00 03 B2 00 10		/* AID set : AOR 0% */
			29 01 00 00 00 00 03 B6 BC 04		/* CAPS & ELVSS Set */
			29 01 00 00 00 00 02 F7 03			/* Gamma, LTPS(AID) update */
			29 01 00 00 00 00 02 F7 00			/* Gamma, LTPS(AID) Disable */
			29 01 00 00 50 00 03 F0 A5 A5		/* TEST KEY Disable */

			/* Memory Access */
			05 01 00 00 00 00 02 2C 00
			05 01 00 00 00 00 02 3C 00
		];

		qcom,mdss-dsi-off-command=[
			05 01 00 00 0A 00 02 28 00	/* wait 10ms(0x0A) */
			05 01 00 00 96 00 02 10 00	/* wait 150ms(0x96) */
		];

		qcom,cont-splash-enabled;
		qcom,mdss-dsi-force-clk-lane-hs;
		/*qcom,cmd-sync-wait-broadcast;*/
		/*qcom,cmd-sync-wait-trigger;*/
		/*qcom,mdss-dsi-fbc-enable=*/
		/*qcom,mdss-dsi-fbc-bpp=*/
		/*qcom,mdss-dsi-fbc-packing=*/
		/*qcom,mdss-dsi-fbc-quant-error=*/
		/*qcom,mdss-dsi-fbc-bias=*/
		/*qcom,mdss-dsi-fbc-pat-mode=*/
		/*qcom,mdss-dsi-fbc-vlc-mode=*/
		/*qcom,mdss-dsi-fbc-bflc-mode=*/
		/*qcom,mdss-dsi-fbc-h-line-budget=*/
		/*qcom,mdss-dsi-fbc-budget-ctrl=*/
		/*qcom,mdss-dsi-fbc-block-budget=*/
		/*qcom,mdss-dsi-fbc-lossless-threshold=*/
		/*qcom,mdss-dsi-fbc-lossy-threshold=*/
		/*qcom,mdss-dsi-fbc-rgb-threshold=*/
		/*qcom,mdss-dsi-fbc-lossy-mode-idx=*/

		qcom,mdss-dsi-h-back-porch = <36>;
		qcom,mdss-dsi-h-front-porch = <160>;
		qcom,mdss-dsi-h-pulse-width = <12>;
		qcom,mdss-dsi-h-sync-skew = <0>;
		qcom,mdss-dsi-v-back-porch = <7>;
		qcom,mdss-dsi-v-front-porch = <7>;
		qcom,mdss-dsi-v-pulse-width = <2>;

		qcom,mdss-dsi-h-left-border = <0>;
		qcom,mdss-dsi-h-right-border = <0>;
		qcom,mdss-dsi-v-top-border = <0>;
		qcom,mdss-dsi-v-bottom-border = <0>;

		qcom,mdss-dsi-underflow-color = <0xFF>;
		qcom,mdss-dsi-border-color = <0>;

		/*qcom,mdss-dsi-pan-enable-dynamic-fps=*/
		/*qcom,mdss-dsi-pan-fps-update=*/

		qcom,mdss-dsi-bl-pmic-control-type = "bl_ctrl_dcs";
		/*qcom,mdss-dsi-bl-pmic-bank-select=*/
		/*qcom,mdss-dsi-bl-pmic-pwm-frequency=*/
		/*qcom,mdss-dsi-pwm-gpio=*/

		qcom,mdss-dsi-bl-min-level = <1>;
		qcom,mdss-dsi-bl-max-level = <255>;
		qcom,mdss-brightness-max-level = <255>;
		qcom,mdss-dsi-interleave-mode = <0>;
		qcom,mdss-dsi-panel-type = "dsi_cmd_mode";

		qcom,mdss-dsi-te-check-enable;
		qcom,mdss-dsi-te-using-te-pin;
		qcom,mdss-dsi-te-pin-select = <1>;

		qcom,mdss-dsi-te-dcs-command = <1>;
		qcom,mdss-dsi-wr-mem-start = <0x2C>;
		qcom,mdss-dsi-wr-mem-continue = <0x3C>;

		/* CMD mode panel doesn't need below stuff */
		qcom,mdss-dsi-h-sync-pulse= <0>;
		/*qcom,mdss-dsi-hfp-power-mode=*/
		/*qcom,mdss-dsi-hbp-power-mode=*/
		/*qcom,mdss-dsi-hsa-power-mode=*/
		/*qcom,mdss-dsi-last-line-interleave=*/
		qcom,mdss-dsi-bllp-eof-power-mode;
		qcom,mdss-dsi-bllp-power-mode;
		qcom,mdss-dsi-traffic-mode= "burst_mode";

		qcom,mdss-dsi-pixel-packing = "loose";

		qcom,mdss-dsi-virtual-channel-id = <0>;
		qcom,mdss-dsi-color-order = "rgb_swap_rgb";
		qcom,mdss-dsi-lane-0-state;
		qcom,mdss-dsi-lane-1-state;
		qcom,mdss-dsi-lane-2-state;
		qcom,mdss-dsi-lane-3-state;
		qcom,mdss-dsi-lane-map = "lane_map_0123";

		qcom,mdss-dsi-t-clk-pre = <0x2B>;
		qcom,mdss-dsi-t-clk-post = <0x02>;

		qcom,mdss-dsi-stream = <0>;
		qcom,mdss-dsi-mdp-trigger = "none";
		qcom,mdss-dsi-dma-trigger = "trigger_sw";
		qcom,mdss-dsi-panel-framerate = <60>;
		qcom,mdss-dsi-panel-clockrate = <850000000>;
		qcom,mdss-dsi-on-command-state = "dsi_lp_mode";
		qcom,mdss-dsi-off-command-state = "dsi_hs_mode";

		qcom,mdss-pan-physical-width-dimension = <69>;
		qcom,mdss-pan-physical-height-dimension = <122>;

		qcom,mdss-dsi-panel-mode-gpio-state = "invalid";

		qcom,mdss-dsi-reset-sequence = <1 20>, <0 20>, <1 20>;

		/* S6E3FA3(LDI) Does not support Partial Update */
		/*qcom,partial-update-enabled;*/
		/*qcom,panel-roi-alignment=<8 8 1 1 1 1>;*/
		/*qcom,mdss-dsi-horizontal-line-idle*/

		qcom,mdss-dsi-lp11-init;
		qcom,mdss-dsi-init-delay-us = <1000>;

		qcom,mdss-dsi-rx-eot-ignore;
		qcom,mdss-dsi-tx-eot-append;

		/*qcom,ulps-enabled*/
		/*qcom,mdss-dsi-panel-status-command=*/
		/*qcom,mdss-dsi-panel-status-command-mode="dsi_lp_mode";*/
		/*qcom,esd-check-enabled;*/
		qcom,mdss-dsi-panel-status-check-mode="reg_read_irq";
		qcom,mdss-dsi-panel-status-value = <1>;
		qcom,mdss-dsi-panel-status-irq-trigger="rising";
		/*qcom,dynamic-mode-switch-enabled*/
		/*qcom,video-to-cmd-mode-switch-commands=*/
		/*qcom,cmd-to-video-mode-switch-commands=*/
/*
 * ************************************************************************************************************************************
 *
 *
 *			Below  parameters are samsung dependent thigs
 *
 *
 * ************************************************************************************************************************************
 */
		samsung,dsi-lp11-init;

		samsung,display_on_tx_cmds_revA = [05 01 00 00 32 00 02 29 00];
		samsung,display_off_tx_cmds_revA = [05 01 00 00 32 00 02 28 00];

		samsung,level1_key_enable_tx_cmds_revA = [
			29 01 00 00 00 00 03 F0 5A 5A
		];
		samsung,level1_key_disable_tx_cmds_revA = [
			29 01 00 00 00 00 03 F0 A5 A5
		];
		samsung,level2_key_enable_tx_cmds_revA = [
			29 00 00 00 00 00 03 F0 5A 5A
			29 01 00 00 00 00 03 FC 5A 5A
		];
		samsung,level2_key_disable_tx_cmds_revA = [
			29 00 00 00 00 00 03 F0 A5 A5
			29 01 00 00 00 00 03 FC A5 A5
		];

		samsung,packet_size_tx_cmds_revA = [
			37 01 00 00 00 00 02 07 00
		];

		/*
		 * First parameters can be changed
		 * by function of samsung_nv_read()
		 * because of that means offset of
		 * read position
		 */
		samsung,reg_read_pos_tx_cmds_revA = [
			15 01 00 00 00 00 02 B0 00
		];


		/*
		 * ************************************************************************************************************************
		 *	 06 01 00 00 00 00 01 c8 07 21
		 *	READ 0xC8 SIZE 0x07 OFFSET 0x21
		 * ************************************************************************************************************************
		 */
		samsung,smart_dimming_mtp_rx_cmds_revA = [ 06 01 00 00 00 00 01 c8 23 00];
		/* the last byte in all read commands will represent READ LENGH */
		samsung,manufacture_id0_rx_cmds_revA = [ 06 01 00 00 00 00 01 da 01 00];
		samsung,manufacture_id1_rx_cmds_revA = [ 06 01 00 00 00 00 01 db 01 00];
		samsung,manufacture_id2_rx_cmds_revA = [ 06 01 00 00 00 00 01 dc 01 00];

		samsung,manufacture_date_rx_cmds_revA = [ 06 01 00 00 00 00 01 c8 02 28];	/* read C8 41~42th , 40=0x28*/
		samsung,ddi_id_rx_cmds_revA = [ 06 01 00 00 00 00 01 d6 05 00];	/* read D6 1~5th */
		samsung,cell_id_rx_cmds_revA = [ 06 01 00 00 00 00 01 C8 0B 28];	/* read C8 41~51th, 40=0x28 */
		samsung,mtp_read_sysfs_rx_cmds_revA = [ 06 01 00 00 00 00 01 01 01 01];

		samsung,elvss_rx_cmds_revA = [ 06 01 00 00 00 00 01 b6 01 15];	/* read B6 22th , 21=0x15*/
		samsung,mdnie_read_rx_cmds_revA	= [ 06 01 00 00 00 00 01 A1 04 00];

		samsung,ldi_debug0_rx_cmds_revA = [06 01 00 00 00 00 01 0A 01 00];
		samsung,ldi_debug1_rx_cmds_revA = [06 01 00 00 00 00 01 0E 01 00];
		samsung,ldi_debug2_rx_cmds_revA = [06 01 00 00 00 00 01 EA 08 00];

		/*
		 * ************************************************************************************************************************
		 *	 COMMON CMD LIST
		 * ************************************************************************************************************************
		 */

		samsung,elvss_lowtemp_tx_cmds_revA = [
			29 01 00 00 00 00 02 B8 19
		];	/* Low Temperature Command */

		samsung,elvss_lowtemp2_tx_cmds_revA = [
			29 01 00 00 00 00 02 B0 15
			29 01 00 00 00 00 02 B6 00
		];	/* Low Temperature Command: default */


		samsung,gamma_tx_cmds_revA = [
			29 01 00 00 00 00 24 CA				/* 1) Gamma 2.2 Setting */
				01 00 01 00 01 00	/* V255 R,G,B */
				80 80 80			/* V203 R,G,B */
				80 80 80			/* V151 R,G,B */
				80 80 80			/* V87 R,G,B */
				80 80 80			/* V51 R,G,B */
				80 80 80			/* V35 R,G,B */
				80 80 80			/* V23 R,G,B */
				80 80 80			/* V11 R,G,B */
				80 80 80			/*  V3 R,G,B */
				00 00 00			/*  V0 R,G,B */
				00 00				/*  VT R,G,B */
			29 01 00 00 00 00 02 F7 03	/* Gamma, LTPS(AID) update */

			29 01 00 00 00 00 3C		/* dummy for single transmission more 100ns delay */
			00 00 00 00 00 00 00 00 00 00
			00 00 00 00 00 00 00 00 00 00
			00 00 00 00 00 00 00 00 00 00
			00 00 00 00 00 00 00 00 00 00
			00 00 00 00 00 00 00 00 00 00
			00 00 00 00 00 00 00 00 00 00

			29 01 00 00 00 00 02 F7 00
		];

		samsung,hbm_etc_tx_cmds_revA = [
			29 01 00 00 00 00 03 B6 BC 0A 	/* HBM ELVSS */
			29 01 00 00 00 00 02 B5 50		/* ACL OPR 32 Frame Average */
			29 01 00 00 00 00 02 53 C0		/* HBM On */
		];

		samsung,hbm_off_tx_cmds_revA = [
			29 01 00 00 00 00 02 53 00		/* HBM Off */
		];


		/*
		 * ************************************************************************************************************************
		 * AID command list and mappings
		 * ************************************************************************************************************************
		 */

		samsung,aid_tx_cmds_revA = [
			/*	0	*/29 01 00 00 00 00 03 B2 70 75 /* 2 CD */
			/*	1	*/29 01 00 00 00 00 03 B2 70 66 /* 3 CD */
			/*	2	*/29 01 00 00 00 00 03 B2 70 5F /* 4 CD */
			/*	3	*/29 01 00 00 00 00 03 B2 70 4F /* 5 CD */
			/*	4	*/29 01 00 00 00 00 03 B2 70 41 /* 6 CD */
			/*	5	*/29 01 00 00 00 00 03 B2 70 32 /* 7 CD */
			/*	6	*/29 01 00 00 00 00 03 B2 70 22 /* 8 CD */
			/*	7	*/29 01 00 00 00 00 03 B2 70 13 /* 9 CD */
			/*	8	*/29 01 00 00 00 00 03 B2 70 03 /* 10 CD */
			/*	9	*/29 01 00 00 00 00 03 B2 60 F4 /* 11 CD */
			/*	10	*/29 01 00 00 00 00 03 B2 60 E2 /* 12 CD */
			/*	11	*/29 01 00 00 00 00 03 B2 60 D2 /* 13 CD */
			/*	12	*/29 01 00 00 00 00 03 B2 60 C0 /* 14 CD */
			/*	13	*/29 01 00 00 00 00 03 B2 60 B3 /* 15 CD */
			/*	14	*/29 01 00 00 00 00 03 B2 60 A2 /* 16 CD */
			/*	15	*/29 01 00 00 00 00 03 B2 60 92 /* 17 CD */
			/*	16	*/29 01 00 00 00 00 03 B2 60 72 /* 19 CD */
			/*	17	*/29 01 00 00 00 00 03 B2 60 65 /* 20 CD */
			/*	18	*/29 01 00 00 00 00 03 B2 60 53 /* 21 CD */
			/*	19	*/29 01 00 00 00 00 03 B2 60 44 /* 22 CD */
			/*	20	*/29 01 00 00 00 00 03 B2 60 24 /* 24 CD */
			/*	21	*/29 01 00 00 00 00 03 B2 60 14 /* 25 CD */
			/*	22	*/29 01 00 00 00 00 03 B2 50 F4 /* 27 CD */
			/*	23	*/29 01 00 00 00 00 03 B2 50 D5 /* 29 CD */
			/*	24	*/29 01 00 00 00 00 03 B2 50 C5 /* 30 CD */
			/*	25	*/29 01 00 00 00 00 03 B2 50 A5 /* 32 CD */
			/*	26	*/29 01 00 00 00 00 03 B2 50 86 /* 34 CD */
			/*	27	*/29 01 00 00 00 00 03 B2 50 55 /* 37 CD */
			/*	28	*/29 01 00 00 00 00 03 B2 50 35 /* 39 CD */
			/*	29	*/29 01 00 00 00 00 03 B2 50 1C /* 41 CD */
			/*	30	*/29 01 00 00 00 00 03 B2 40 E6 /* 44 CD */
			/*	31	*/29 01 00 00 00 00 03 B2 40 B7 /* 47 CD */
			/*	32	*/29 01 00 00 00 00 03 B2 40 86 /* 50 CD */
			/*	33	*/29 01 00 00 00 00 03 B2 40 57 /* 53 CD */
			/*	34	*/29 01 00 00 00 00 03 B2 40 24 /* 56 CD */
			/*	35	*/29 01 00 00 00 00 03 B2 30 EB /* 60 CD */
			/*	36	*/29 01 00 00 00 00 03 B2 30 A4 /* 64 CD */
			/*	37	*/29 01 00 00 00 00 03 B2 30 56 /* 68 CD */
			/*	38	*/29 01 00 00 00 00 03 B2 30 17 /* 72 CD */
			/*	39	*/29 01 00 00 00 00 03 B2 20 D7 /* 77 CD */
			/*	40	*/29 01 00 00 00 00 03 B2 20 D7 /* 82 CD */
			/*	41	*/29 01 00 00 00 00 03 B2 20 D7 /* 87 CD */
			/*	42	*/29 01 00 00 00 00 03 B2 20 D7 /* 93 CD */
			/*	43	*/29 01 00 00 00 00 03 B2 20 D7 /* 98 CD */
			/*	44	*/29 01 00 00 00 00 03 B2 20 D7 /* 105 CD */
			/*	45	*/29 01 00 00 00 00 03 B2 20 D7 /* 111 CD */
			/*	46	*/29 01 00 00 00 00 03 B2 20 D7 /* 119 CD */
			/*	47	*/29 01 00 00 00 00 03 B2 20 D7 /* 126 CD */
			/*	48	*/29 01 00 00 00 00 03 B2 20 D7 /* 134 CD */
			/*	49	*/29 01 00 00 00 00 03 B2 20 D7 /* 143 CD */
			/*	50	*/29 01 00 00 00 00 03 B2 20 D7 /* 152 CD */
			/*	51	*/29 01 00 00 00 00 03 B2 20 D7 /* 162 CD */
			/*	52	*/29 01 00 00 00 00 03 B2 20 D7 /* 172 CD */
			/*	53	*/29 01 00 00 00 00 03 B2 20 A7 /* 183 CD */
			/*	54	*/29 01 00 00 00 00 03 B2 20 71 /* 195 CD */
			/*	55	*/29 01 00 00 00 00 03 B2 20 10 /* 207 CD */
			/*	56	*/29 01 00 00 00 00 03 B2 10 A4 /* 220 CD */
			/*	57	*/29 01 00 00 00 00 03 B2 10 46 /* 234 CD */
			/*	58	*/29 01 00 00 00 00 03 B2 00 C4 /* 249 CD */
			/*	59	*/29 01 00 00 00 00 03 B2 00 C4 /* 265 CD */
			/*	60	*/29 01 00 00 00 00 03 B2 00 C4 /* 282 CD */
			/*	61	*/29 01 00 00 00 00 03 B2 00 C4 /* 300 CD */
			/*	62	*/29 01 00 00 00 00 03 B2 00 C4 /* 316 CD */
			/*	63	*/29 01 00 00 00 00 03 B2 00 C4 /* 333 CD */
			/*	64	*/29 01 00 00 00 00 03 B2 00 C4 /* 350 CD */
			/*	65	*/29 01 00 00 00 00 03 B2 00 C4 /* 357 CD */
			/*	66	*/29 01 00 00 00 00 03 B2 00 C4 /* 365 CD */
			/*	67	*/29 01 00 00 00 00 03 B2 00 B4 /* 372 CD */
			/*	68	*/29 01 00 00 00 00 03 B2 00 82 /* 380 CD */
			/*	69	*/29 01 00 00 00 00 03 B2 00 61 /* 387 CD */
			/*	70	*/29 01 00 00 00 00 03 B2 00 2D /* 395 CD */
			/*	71	*/29 01 00 00 00 00 03 B2 00 26 /* 403 CD */
			/*	72	*/29 01 00 00 00 00 03 B2 00 18 /* 412 CD */
			/*	73	*/29 01 00 00 00 00 03 B2 00 10 /* 420 CD */
		];


		/* bl_level, Index in acl command list */
		samsung,aid_map_table_revA = <
			2	0		3	1		4	2		5	3		6	4
			7	5		8	6		9	7		10	8		11	9
			12	10		13	11		14	12		15	13		16	14
			17	15		19	16		20	17		21	18		22	19
			24	20		25	21		27	22		29	23		30	24
			32	25		34	26		37	27		39	28		41	29
			44	30		47	31		50	32		53	33		56	34
			60	35		64	36		68	37		72	38		77	39
			82	40		87	41		93	42		98	43		105	44
			111	45		119	46		126	47		134	48		143	49
			152	50		162	51		172	52		183	53		195	54
			207	55		220	56		234	57		249	58		265	59
			282	60		300	61		316	62		333	63		350	64
			357	65		365	66		372	67		380	68		387	69
			395	70		403	71		412	72		420	73
		>;

		/*
		 * ************************************************************************************************************************
		 * ACL command list and mappings
		 * ************************************************************************************************************************
		 */

		samsung,acl_on_tx_cmds_revA = [
			29 01 00 00 00 00 02 B5 50	/* ACL 32Frame Averaging */
			29 01 00 00 00 00 02 55 02	/* ACL ON */
		];

		samsung,acl_percent_tx_cmds_revA = [
			29 01 00 00 00 00 02 55 00	/* ACL OFF */
			29 01 00 00 00 00 02 55 01
			29 01 00 00 00 00 02 55 02	/* Default ACL */
			29 01 00 00 00 00 02 55 03

		];

		samsung,acl_off_tx_cmds_revA = [
			29 01 00 00 00 00 02 B5 40	/* 16 Frame Avg. */
			29 01 00 00 00 00 02 55 00	/* ACL OFF */
		];

		/* bl_level , Index in acl command list */
		samsung,acl_map_table_revA =  <
			2	2		3	2		4	2		5	2		6	2
			7	2		8	2		9	2		10	2		11	2
			12	2		13	2		14	2		15	2		16	2
			17	2		19	2		20	2		21	2		22	2
			24	2		25	2		27	2		29	2		30	2
			32	2		34	2		37	2		39	2		41	2
			44	2		47	2		50	2		53	2		56	2
			60	2		64	2		68	2		72	2		77	2
			82	2		87	2		93	2		98	2		105	2
			111	2		119	2		126	2		134	2		143	2
			152	2		162	2		172	2		183	2		195	2
			207	2		220	2		234	2		249	2		265	2
			282	2		300	2		316	2		333	2		350	2
			357	2		365	2		372	2		380	2		387	2
			395	2		403	2		412	2		420	2
		>;


		/*
		 * ************************************************************************************************************************
		 * SMART ACL(ACL On) ELVSS command list and mappings
		 * ************************************************************************************************************************
		 */

		samsung,smart_acl_elvss_tx_cmds_revA = [
			29 01 00 00 00 00 03 B6 AC 0B /* 0 */
			29 01 00 00 00 00 03 B6 AC 0C /* 1 */
			29 01 00 00 00 00 03 B6 AC 0D /* 2 */
			29 01 00 00 00 00 03 B6 AC 0E /* 3 */
			29 01 00 00 00 00 03 B6 AC 0F /* 4 */
			29 01 00 00 00 00 03 B6 AC 10 /* 5 */
			29 01 00 00 00 00 03 B6 AC 11 /* 6 */
			29 01 00 00 00 00 03 B6 AC 12 /* 7 */
			29 01 00 00 00 00 03 B6 AC 13 /* 8 */
			29 01 00 00 00 00 03 B6 AC 14 /* 9 */
			29 01 00 00 00 00 03 B6 AC 15 /* 10 */
			29 01 00 00 00 00 03 B6 BC 15 /* 11 */
			29 01 00 00 00 00 03 B6 BC 14 /* 12 */
			29 01 00 00 00 00 03 B6 BC 13 /* 13 */
			29 01 00 00 00 00 03 B6 BC 12 /* 14 */
			29 01 00 00 00 00 03 B6 BC 11 /* 15 */
			29 01 00 00 00 00 03 B6 BC 10 /* 16 */
			29 01 00 00 00 00 03 B6 BC 0F /* 17 */
			29 01 00 00 00 00 03 B6 BC 0E /* 18 */
			29 01 00 00 00 00 03 B6 BC 0D /* 19 */
			29 01 00 00 00 00 03 B6 BC 0C /* 20 */
			29 01 00 00 00 00 03 B6 BC 0B /* 21 */
			29 01 00 00 00 00 03 B6 BC 0A /* 22 */
		];

		/* bl_level, Index in elvss command list */
		samsung,smart_acl_elvss_map_table_revA = <
			2	0		3	0		4	0		5	0		6	1
			7	2		8	3		9	4		10	5		11	6
			12	7		13	8		14	9		15	10		16	10
			17	10		19	10		20	10		21	10		22	10
			24	10		25	10		27	10		29	10		30	10
			32	10		34	10		37	10		39	10		41	11
			44	11		47	11		50	11		53	11		56	11
			60	11		64	11		68	11		72	11		77	11
			82	11		87	12		93	12		98	12		105	13
			111	13		119	13		126	14		134	14		143	14
			152	14		162	14		172	14		183	14		195	14
			207	14		220	15		234	15		249	15		265	16
			282	17		300	17		316	18		333	19		350	19
			357	20		365	20		372	20		380	20		387	21
			395	21		403	21		412	22		420	22
		>;


		/*
		 * ************************************************************************************************************************
		 * candela to index mappings
		 * ************************************************************************************************************************
		 */
		samsung,candela_map_table_revA = <
		/*<idx><PMSL range> <candella> *//*linear map*/
			0	0	1	2
			1	2	2	3
			2	3	3	4
			3	4	4	5
			4	5	5	6
			5	6	6	7
			6	7	7	8
			7	8	8	9
			8	9	9	10
			9	10	10	11
			10	11	11	12
			11	12	12	13
			12	13	13	14
			13	14	14	15
			14	15	15	16
			15	16	16	17
			16	17	18	19
			17	19	19	20
			18	20	20	21
			19	21	21	22
			20	22	22	24
			21	23	23	25
			22	24	25	27
			23	26	26	29
			24	27	27	30
			25	28	29	32
			26	30	31	34
			27	32	33	37
			28	34	34	39
			29	35	36	41
			30	37	38	44
			31	39	41	47
			32	42	43	50
			33	44	45	53
			34	46	47	56
			35	48	50	60
			36	51	53	64
			37	54	56	68
			38	57	58	72
			39	59	62	77
			40	63	65	82
			41	66	69	87
			42	70	73	93
			43	74	76	98
			44	77	80	105
			45	81	84	111
			46	85	89	119
			47	90	94	126
			48	95	99	134
			49	100	104	143
			50	105	110	152
			51	111	116	162
			52	117	121	172
			53	122	128	183 /* Default Brightness */
			54	129	135	195
			55	136	142	207
			56	143	149	220
			57	150	157	234
			58	158	165	249
			59	166	174	265
			60	175	183	282
			61	184	193	300
			62	194	201	316
			63	202	210	333
			64	211	219	350
			65	220	223	357
			66	224	227	365
			67	228	230	372
			68	231	234	380
			69	235	238	387
			70	239	242	395
			71	243	246	403
			72	247	250	412
			73	251	255	420
		>;
	};
};
