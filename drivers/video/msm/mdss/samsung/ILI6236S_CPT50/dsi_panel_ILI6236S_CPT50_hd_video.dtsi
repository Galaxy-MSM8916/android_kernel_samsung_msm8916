/* Copyright (c) 2013-14, Samsung Electronics Corporation. All rights reserved.
 *
 * This program is free software; you can redistribute it and/or modify
 * it under the terms of the GNU General Public License version 2 and
 * only version 2 as published by the Free Software Foundation.
 *
 * This program is distributed in the hope that it will be useful,
 * but WITHOUT ANY WARRANTY; without even the implied warranty of
 * MERCHANTABILITY or FITNESS FOR A PARTICULAR PURPOSE.  See the
 * GNU General Public License for more details.
 */

/*---------------------------------------------------------------------------
 * This file is autogenerated file using gcdb parser. Please do not edit it.
 * Update input XML file to add a new entry or update variable in this file
 * VERSION = "1.0"
 *---------------------------------------------------------------------------*/
&mdss_mdp {
	ss_dsi_panel_ILI6236S_CPT50_HD: ss_dsi_panel_ILI6236S_CPT50_HD {
		qcom,mdss-dsi-panel-name = "ss_dsi_panel_ILI6236S_CPT50_HD";
		label = "ss_dsi_panel_ILI6236S_CPT50_HD";
		qcom,mdss-dsi-panel-controller = <&mdss_dsi0>;
		qcom,mdss-dsi-panel-type = "dsi_video_mode";
		qcom,mdss-dsi-panel-destination = "display_1";
		qcom,cont-splash-enabled;
		qcom,mdss-dsi-panel-framerate = <60>;
		qcom,mdss-dsi-virtual-channel-id = <0>;
		qcom,mdss-dsi-stream = <0>;
		qcom,mdss-dsi-panel-width = <720>;
		qcom,mdss-dsi-panel-height = <1280>;
		qcom,mdss-pan-physical-width-dimension = <62>; /* <Width> real size of panel in mm */
		qcom,mdss-pan-physical-height-dimension = <106>; /*<Height> real size of panel in mm */
		qcom,mdss-dsi-lp11-init;
		qcom,mdss-dsi-init-delay-us = <100>;
		qcom,mdss-dsi-h-front-porch = <18>;//
		qcom,mdss-dsi-h-back-porch = <80>;//
		qcom,mdss-dsi-h-pulse-width = <10>;//
		qcom,mdss-dsi-h-sync-skew = <0>;
		qcom,mdss-dsi-v-back-porch = <18>;//
		qcom,mdss-dsi-v-front-porch = <16>;//
		qcom,mdss-dsi-v-pulse-width = <4>;//
		qcom,mdss-dsi-h-left-border = <0>;
		qcom,mdss-dsi-h-right-border = <0>;
		qcom,mdss-dsi-v-top-border = <0>;
		qcom,mdss-dsi-v-bottom-border = <0>;
		qcom,mdss-dsi-bpp = <24>;
		qcom,mdss-dsi-color-order = <0>;
		qcom,mdss-dsi-underflow-color = <0xff>;
		qcom,mdss-dsi-border-color = <0>;
		qcom,mdss-dsi-dma-trigger = "trigger_sw";
		qcom,mdss-dsi-mdp-trigger = "none";
		qcom,mdss-dsi-bl-min-level = <1>;
		qcom,mdss-dsi-bl-max-level = <255>;
		qcom,mdss-dsi-bl-pmic-control-type = "bl_ctrl_dcs";
		qcom,mdss-dsi-lane-0-state;
		qcom,mdss-dsi-lane-1-state;
		qcom,mdss-dsi-lane-2-state;
		qcom,mdss-dsi-lane-3-state;
		qcom,mdss-dsi-bllp-eof-power-mode;
		qcom,mdss-dsi-bllp-power-mode;
/*		qcom,mdss-dsi-traffic-mode = "burst_mode";*/
		qcom,mdss-dsi-force-clk-lane-hs;
		qcom,mdss-dsi-reset-sequence = <1 20>, <0 1>, <1 20>;
		qcom,mdss-dsi-h-sync-pulse = <0>;
/*		qcom,mdss-dsi-hfp-power-mode;*/
/*		qcom,mdss-dsi-hbp-power-mode;*/
/*		qcom,mdss-dsi-hsa-power-mode;*/

		qcom,mdss-dsi-panel-timings = [76 18 10 00 3C 3E 14 1C 12 03 04 00];
		qcom,mdss-dsi-t-clk-pre = <0x1C>;
		qcom,mdss-dsi-t-clk-post = <0x04>;
		qcom,mdss-dsi-on-command = [
					/* Power Setting Sequence (1) */
					39 01 00 00 01 00 04 FF 61 36 01
					39 01 00 00 00 00 02 22 08
					39 01 00 00 00 00 02 30 02
					39 01 00 00 00 00 02 31 00
					39 01 00 00 00 00 02 42 23
					39 01 00 00 00 00 02 50 AE
					39 01 00 00 00 00 02 51 AE
					39 01 00 00 01 00 04 FF 61 36 08
					39 01 00 00 00 00 02 1C A0
					39 01 00 00 00 00 02 93 05
					39 01 00 00 00 00 02 8E 10
					39 01 00 00 00 00 02 76 D4
					39 01 00 00 00 00 02 78 04
					39 01 00 00 00 00 02 4C 00
					39 01 00 00 00 00 02 AB 24
					39 01 00 00 00 00 02 37 05
					39 01 00 00 00 00 02 2F 00
					39 01 00 00 00 00 02 48 40
					39 01 00 00 00 00 02 E7 50
					39 01 00 00 00 00 04 FF 61 36 00 
					39 01 00 00 00 00 02 36 10

					/* Initializing  Sequence(2) */
					39 01 00 00 01 00 04 FF 61 36 07
					39 01 00 00 00 00 02 03 29
					39 01 00 00 00 00 02 04 05
					39 01 00 00 00 00 02 05 00
					39 01 00 00 00 00 02 06 01
					39 01 00 00 00 00 02 07 00
					39 01 00 00 00 00 02 08 00
					39 01 00 00 00 00 02 09 00
					39 01 00 00 00 00 02 0A 01
					39 01 00 00 00 00 02 0B 01
					39 01 00 00 00 00 02 0C 00
					39 01 00 00 00 00 02 0D A4
					39 01 00 00 00 00 02 0E 00
					39 01 00 00 00 00 02 0F 00
					39 01 00 00 00 00 02 10 40
					39 01 00 00 00 00 02 11 02
					39 01 00 00 00 00 02 12 0D
					39 01 00 00 00 00 02 13 00
					39 01 00 00 00 00 02 14 09
					39 01 00 00 00 00 02 15 05
					39 01 00 00 00 00 02 16 34
					39 01 00 00 00 00 02 17 34
					39 01 00 00 00 00 02 18 00
					39 01 00 00 00 00 02 19 00
					39 01 00 00 00 00 02 1A 00
					39 01 00 00 00 00 02 1B 50
					39 01 00 00 00 00 02 1C DB
					39 01 00 00 00 00 02 1D 0C
					39 01 00 00 00 00 02 1E 00
					39 01 00 00 00 00 02 1F 00
					39 01 00 00 00 00 02 20 00
					39 01 00 00 00 00 02 21 00
					39 01 00 00 00 00 02 22 00
					39 01 00 00 00 00 02 23 C0
					39 01 00 00 00 00 02 24 30
					39 01 00 00 00 00 02 25 00
					39 01 00 00 00 00 02 26 00
					39 01 00 00 00 00 02 27 03
					39 01 00 00 00 00 02 30 01
					39 01 00 00 00 00 02 31 23
					39 01 00 00 00 00 02 32 45
					39 01 00 00 00 00 02 33 67
					39 01 00 00 00 00 02 34 89
					39 01 00 00 00 00 02 35 AB
					39 01 00 00 00 00 02 36 01
					39 01 00 00 00 00 02 37 23
					39 01 00 00 00 00 02 38 45
					39 01 00 00 00 00 02 39 67
					39 01 00 00 00 00 02 3A 89
					39 01 00 00 00 00 02 3B AB
					39 01 00 00 00 00 02 3C CD
					39 01 00 00 00 00 02 3D EF
					39 01 00 00 00 00 02 50 11
					39 01 00 00 00 00 02 51 06
					39 01 00 00 00 00 02 52 0C
					39 01 00 00 00 00 02 53 0D
					39 01 00 00 00 00 02 54 0E
					39 01 00 00 00 00 02 55 0F
					39 01 00 00 00 00 02 56 02
					39 01 00 00 00 00 02 57 02
					39 01 00 00 00 00 02 58 03
					39 01 00 00 00 00 02 59 03
					39 01 00 00 00 00 02 5A 02
					39 01 00 00 00 00 02 5B 02
					39 01 00 00 00 00 02 5C 02
					39 01 00 00 00 00 02 5D 02
					39 01 00 00 00 00 02 5E 01
					39 01 00 00 00 00 02 5F 00
					39 01 00 00 00 00 02 60 08
					39 01 00 00 00 00 02 67 08
					39 01 00 00 00 00 02 68 0C
					39 01 00 00 00 00 02 69 0D
					39 01 00 00 00 00 02 6A 0E
					39 01 00 00 00 00 02 6B 0F
					39 01 00 00 00 00 02 6C 02
					39 01 00 00 00 00 02 6D 02
					39 01 00 00 00 00 02 6E 02
					39 01 00 00 00 00 02 6F 02
					39 01 00 00 00 00 02 70 02
					39 01 00 00 00 00 02 71 02
					39 01 00 00 00 00 02 72 02
					39 01 00 00 00 00 02 73 02
					39 01 00 00 00 00 02 74 01
					39 01 00 00 00 00 02 75 00
					39 01 00 00 00 00 02 76 06

					/* Gamma Setting Sequence (3) */
					39 01 00 00 01 00 04 FF 61 36 01
					39 01 00 00 00 00 02 A0 07
					39 01 00 00 00 00 02 A1 0A
					39 01 00 00 00 00 02 A2 08
					39 01 00 00 00 00 02 A3 1B
					39 01 00 00 00 00 02 A4 14
					39 01 00 00 00 00 02 A5 19
					39 01 00 00 00 00 02 A6 1E
					39 01 00 00 00 00 02 A7 1E
					39 01 00 00 00 00 02 A8 27
					39 01 00 00 00 00 02 A9 2D
					39 01 00 00 00 00 02 AA 31
					39 01 00 00 00 00 02 AB 38
					39 01 00 00 00 00 02 AC 39
					39 01 00 00 00 00 02 AD 32
					39 01 00 00 00 00 02 AE 39
					39 01 00 00 00 00 02 AF 2E
					39 01 00 00 00 00 02 B0 30
					39 01 00 00 00 00 02 C0 03
					39 01 00 00 00 00 02 C1 0B
					39 01 00 00 00 00 02 C2 15
					39 01 00 00 00 00 02 C3 27
					39 01 00 00 00 00 02 C4 19
					39 01 00 00 00 00 02 C5 1D
					39 01 00 00 00 00 02 C6 1F
					39 01 00 00 00 00 02 C7 20
					39 01 00 00 00 00 02 C8 28
					39 01 00 00 00 00 02 C9 31
					39 01 00 00 00 00 02 CA 35
					39 01 00 00 00 00 02 CB 3F
					39 01 00 00 00 00 02 CC 3E
					39 01 00 00 00 00 02 CD 35
					39 01 00 00 00 00 02 CE 3B
					39 01 00 00 00 00 02 CF 30
					39 01 00 00 00 00 02 D0 30

					/* Digatal gamma Setting Sequence (4) */
					39 01 00 00 01 00 04 FF 61 36 02
					39 01 00 00 00 00 02 80 01
					39 01 00 00 00 00 02 00 00
					39 01 00 00 00 00 02 01 04
					39 01 00 00 00 00 02 02 0C
					39 01 00 00 00 00 02 03 1C
					39 01 00 00 00 00 02 04 3C
					39 01 00 00 00 00 02 05 5C
					39 01 00 00 00 00 02 06 9C
					39 01 00 00 00 00 02 07 1C
					39 01 00 00 00 00 02 08 FC
					39 01 00 00 00 00 02 09 DC
					39 01 00 00 00 00 02 0A 5C
					39 01 00 00 00 00 02 0B 9C
					39 01 00 00 00 00 02 0C BC
					39 01 00 00 00 00 02 0D E0
					39 01 00 00 00 00 02 0E F0
					39 01 00 00 00 00 02 0F F8
					39 01 00 00 00 00 02 10 FC
					39 01 00 00 00 00 02 22 00
					39 01 00 00 00 00 02 23 04
					39 01 00 00 00 00 02 24 0C
					39 01 00 00 00 00 02 25 1C
					39 01 00 00 00 00 02 26 3C
					39 01 00 00 00 00 02 27 5C
					39 01 00 00 00 00 02 28 9C
					39 01 00 00 00 00 02 29 1C
					39 01 00 00 00 00 02 2A FC
					39 01 00 00 00 00 02 2B DC
					39 01 00 00 00 00 02 2C 5C
					39 01 00 00 00 00 02 2D 9C
					39 01 00 00 00 00 02 2E BC
					39 01 00 00 00 00 02 2F E0
					39 01 00 00 00 00 02 30 E4
					39 01 00 00 00 00 02 31 E8
					39 01 00 00 00 00 02 32 EC
					39 01 00 00 00 00 02 44 00
					39 01 00 00 00 00 02 45 04
					39 01 00 00 00 00 02 46 0C
					39 01 00 00 00 00 02 47 1C
					39 01 00 00 00 00 02 48 3C
					39 01 00 00 00 00 02 49 5C
					39 01 00 00 00 00 02 4A 9C
					39 01 00 00 00 00 02 4B 1C
					39 01 00 00 00 00 02 4C FC
					39 01 00 00 00 00 02 4D DC
					39 01 00 00 00 00 02 4E 5C
					39 01 00 00 00 00 02 4F 9C
					39 01 00 00 00 00 02 50 BC
					39 01 00 00 00 00 02 51 CC
					39 01 00 00 00 00 02 52 D0
					39 01 00 00 00 00 02 53 D8
					39 01 00 00 00 00 02 54 DC
					39 01 00 00 00 00 02 66 00
					39 01 00 00 00 00 02 67 40
					39 01 00 00 00 00 02 68 F9
					39 01 00 00 00 00 02 69 FF
					39 01 00 00 00 00 02 6A 03
					39 01 00 00 00 00 02 6E 0F
					39 01 00 00 00 00 02 6F 00
					39 01 00 00 00 00 02 70 94
					39 01 00 00 00 00 02 71 FF
					39 01 00 00 00 00 02 72 3F
					39 01 00 00 00 00 02 77 00
					39 01 00 00 00 00 02 78 40
					39 01 00 00 00 00 02 79 F9
					39 01 00 00 00 00 02 7A FF
					39 01 00 00 00 00 02 7B 03

					/* Display on Sequence(4) */
					39 01 00 00 01 00 04 FF 61 36 00
					05 01 00 00 78 00 02 11 00	/* Sleep Out & 120ms(0x78) Delay */
					05 01 00 00 14 00 02 29 00	/* Display On & 20ms(0x14) Delay */
					];
		qcom,mdss-dsi-on-command-state = "dsi_lp_mode";
		qcom,mdss-dsi-off-command-state = "dsi_hs_mode";
		qcom,mdss-dsi-off-command = [
					05 01 00 00 32 00 02 28 00	/* wait 50ms(0x32) */
					05 01 00 00 96 00 02 10 00	/* wait 150ms(0x96) */
					];
		samsung,mdss-dsi-bl-scale-low-level = <8>;
		samsung,mdss-dsi-bl-scale-dim-level = <8>;
		samsung,mdss-dsi-bl-scale-default-level = <89>;
		samsung,mdss-dsi-bl-scale-max-level = <188>;
		samsung,mdss-dsi-bl-pms-low-level = <7>;
		samsung,mdss-dsi-bl-pms-dim-level = <7>;
		samsung,mdss-dsi-bl-pms-default-level = <158>;
		samsung,mdss-dsi-bl-pms-max-level = <255>;
/*
 * ************************************************************************************************************************************
 *
 *
 *			Below  parameters are samsung dependent thigs
 *
 *
 * ************************************************************************************************************************************
 */
		samsung,mdnie-tuning-enable-tft;
		samsung,lcd-display-format-bgr;
		samsung,level2_key_enable_tx_cmds_revA = [
			39 01 00 00 00 00 03 F0 5A 5A
		];
		samsung,level2_key_disable_tx_cmds_revA = [
			39 01 00 00 00 00 03 F0 A5 A5
		];
		samsung,packet_size_tx_cmds_revA = [
			37 01 00 00 00 00 02 07 00
		];
		/*
		 * First parameters can be changed
		 * by function of samsung_nv_read()
		 * because of that means offset of
		 * read position
		 */
		samsung,reg_read_pos_tx_cmds_revA = [
			15 01 00 00 00 00 02 B0 00
		];
		samsung,manufacture_id0_rx_cmds_revA = [06 01 00 00 00 00 01 da 03 00];
		samsung,manufacture_id1_rx_cmds_revA = [06 01 00 00 00 00 01 db 03 00];
		samsung,manufacture_id2_rx_cmds_revA = [06 01 00 00 00 00 01 dc 03 00];
/*
		* Command sets for CABC control
*/
		samsung,panel-vendor = "BOE";
		samsung,tft_pwm_tx_cmds_revA=[
			39 01 00 00 00 00 02 51 FF/*First command should be PWM duty change command*/
		];
		samsung,cabc_on_tx_cmds_revA = [
			39 01 00 00 00 00 02 55 01
		];
		samsung,cabc_off_tx_cmds_revA = [
			39 01 00 00 00 00 02 55 00
		];
		/*
		* ************************************************************************************************************************
		* Scaled level to index mappings
		* ************************************************************************************************************************
		*/
	samsung,scaled_level_map_table_revA = <
		/*<idx>	  <from>  <till> <scaled_level> */
			0		0		7		2
			1		8		9		4
			2		10		12		6
			3		13		14		8
			4		15		17		9
			5		18		19		11
			6		20		22		13
			7		23		24		15
			8		25		27		17
			9		28		29		19
			10		30		32		20
			11		33		34		21
			12		35		37		22
			13		38		39		23
			14		40		42		24
			15		43		44		25
			16		45		47		26
			17		48		49		27
			18		50		52		28
			19		53		54		29
			20		55		57		30
			21		58		59		31
			22		60		62		32
			23		63		64		33
			24		65		67		34
			25		68		70		35
			26		71		72		36
			27		73		75		37
			28		76		77		38
			29		78		80		39
			30		81		82		40
			31		83		85		41
			32		86		87		42
			33		88		90		43
			34		91		92		44
			35		93		95		45
			36		96		97		46
			37		98		100		48
			38		101		102		50
			39		103		105		52
			40		106		107		54
			41		108		110		56
			42		111		112		58
			43		113		115		60
			44		116		117		62
			45		118		120		64
			46		121		122		66
			47		123		125		68
			48		126		127		70
			49		128		130		72
			50		131		133		74
			51		134		135		76
			52		136		138		78
			53		139		140		80
			54		141		143		82
			55		144		145		84
			56		146		148		86
			57		149		150		88
			58		151		153		90
			59		154		155		92
			60		156		158		94
			61		159		160		96
			62		161		163		98
			63		164		165		100
			64		166		168		103
			65		169		170		106
			66		171		173		109
			67		174		175		112
			68		176		178		115
			69		179		180		118
			70		182		183		121
			71		184		185		124
			72		186		188		127
			72		189		190		130
			74		191		193		133
			75		194		196		136
			76		197		198		139
			77		199		201		142
			78		202		203		145
			79		204		206		148
			80		207		208		151
			81		209		211		154
			82		212		213		157
			83		214		216		160
			84		217		218		163
			85		219		221		166
			86		222		223		169
			87		224		226		172
			88		227		228		175
			89		229		231		178
			90		232		233		181
			91		234		236		184
			92		237		238		187
			93		239		241		189
			94		242		243		191
			95		244		246		193
			96		247		248		195
			97		249		251		197
			98		252		253		199
			99		254		255		201
		>;
	};
};

