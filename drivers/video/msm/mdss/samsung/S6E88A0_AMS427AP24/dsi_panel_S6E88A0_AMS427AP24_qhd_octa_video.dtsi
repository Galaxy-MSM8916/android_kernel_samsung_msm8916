/* Copyright (c) 2013-2014, The Linux Foundation. All rights reserved.
 *
 * This program is free software; you can redistribute it and/or modify
 * it under the terms of the GNU General Public License version 2 and
 * only version 2 as published by the Free Software Foundation.
 *
 * This program is distributed in the hope that it will be useful,
 * but WITHOUT ANY WARRANTY; without even the implied warranty of
 * MERCHANTABILITY or FITNESS FOR A PARTICULAR PURPOSE.  See the
 * GNU General Public License for more details.
 */

/*---------------------------------------------------------------------------
 * This file is autogenerated file using gcdb parser. Please do not edit it.
 * Update input XML file to add a new entry or update variable in this file
 * VERSION = "1.0"
 *---------------------------------------------------------------------------

 */
&mdss_mdp {
	dsi_samsung_qHD_vid: ss_dsi_panel_S6E88A0_AMS427AP24_QHD {
		qcom,mdss-dsi-panel-name = "ss_dsi_panel_S6E88A0_AMS427AP24_QHD";
		qcom,mdss-dsi-panel-controller = <&mdss_dsi0>;
		qcom,mdss-dsi-panel-width = <540>;
		qcom,mdss-dsi-panel-height = <960>;
		qcom,mdss-dsi-bpp = <24>;
		qcom,mdss-dsi-panel-destination = "display_1";

		qcom,mdss-dsi-panel-timings = [87 1C 12 00 42 44 18 20 17 03 04 00];
		qcom,mdss-dsi-on-command = [
			39 00 00 00 00 00 03 F0 5a 5a /* Tesk key ON */
			39 00 00 00 00 00 03 FC 5a 5a /* Tesk key ON */
			/* 5. SRC_LATCH Set*/
			39 00 00 00 00 00 02 B0 11
			39 00 00 00 00 00 02 FD 11
			39 00 00 00 00 00 02 B0 13
			39 00 00 00 00 00 02 FD 18
			/* 7. AVDD Set*/
			39 00 00 00 00 00 02 B0 02
			39 00 00 00 00 00 02 B8 30
			/* Sleep out  wait 20ms */
			05 01 00 00 14 00 02 11 00

			/* PCD */
			39 00 00 00 00 00 02 CC 4C

			/* 1. Brightness condition set */
			39 00 00 00 00 00 22 /* Brightness gamma */
				ca 01 00 01 00 01 00 80
				80 80 80 80 80 80 80 80
				80 80 80 80 80 80 80 80
				80 80 80 80 80 80 80 00
				00 00

			39 00 00 00 00 00 06 B2 40 08 20 00 08 /* AID set */
			/* 2. ELVSS Condition set */
			39 00 00 00 00 00 03 B6 28 0B /* ELVSS */
			39 00 00 00 00 00 02 F7 03 /* Gamma/AID update */



			/* 3. ETC Condition set */
			39 00 00 00 00 00 02 55 00 /* ACL set */
			39 00 00 00 00 00 03 F0 A5 A5
			39 01 00 00 00 00 03 FC A5 A5
		];

		qcom,mdss-dsi-off-command = [05 01 00 00 00 00 02 28 00
				 05 01 00 00 78 00 02 10 00];
		qcom,cont-splash-enabled;
		qcom,mdss-dsi-h-pulse-width = <4>;
		qcom,mdss-dsi-h-back-porch = <18>;
		qcom,mdss-dsi-h-front-porch = <94>;
		qcom,mdss-dsi-h-sync-skew = <0>;
		qcom,mdss-dsi-v-pulse-width = <1>;
		qcom,mdss-dsi-v-back-porch = <3>;
		qcom,mdss-dsi-v-front-porch = <12>;
		qcom,mdss-dsi-h-left-border = <0>;
		qcom,mdss-dsi-h-right-border = <0>;
		qcom,mdss-dsi-v-top-border = <0>;
		qcom,mdss-dsi-v-bottom-border = <0>;
		qcom,mdss-dsi-underflow-color = <0xff>;
		qcom,mdss-dsi-border-color = <0>;
		qcom,mdss-dsi-bl-pmic-control-type = "bl_ctrl_dcs";
		qcom,mdss-dsi-bl-min-level = <1>;
		qcom,mdss-dsi-bl-max-level = <255>;
		qcom,mdss-dsi-panel-type = "dsi_video_mode";
		qcom,mdss-dsi-h-sync-pulse = <0>;
		qcom,mdss-dsi-bllp-eof-power-mode;
		qcom,mdss-dsi-bllp-power-mode;
		qcom,mdss-dsi-traffic-mode = "burst_mode";
		  qcom,mdss-dsi-pixel-packing = "loose";
		qcom,mdss-dsi-virtual-channel-id = <0>;
		  qcom,mdss-dsi-color-order = "rgb_swap_rgb";
		qcom,mdss-dsi-lane-0-state;
		qcom,mdss-dsi-lane-1-state;
		qcom,mdss-dsi-lane-map = "lane_map_0123";
		qcom,mdss-dsi-t-clk-post = <0x04>;
		qcom,mdss-dsi-t-clk-pre = <0x27>;
		qcom,mdss-dsi-stream = <0>;
		qcom,mdss-dsi-mdp-trigger = "none";
		qcom,mdss-dsi-dma-trigger = "trigger_sw";
		qcom,mdss-dsi-panel-framerate = <60>;
		qcom,mdss-dsi-on-command-state = "dsi_lp_mode";
		qcom,mdss-dsi-off-command-state = "dsi_hs_mode";
		qcom,mdss-pan-physical-width-dimension = <55>;
		qcom,mdss-pan-physical-height-dimension = <95>;
		qcom,mdss-dsi-reset-sequence = <1 5>, <0 1>, <1 10>;
		qcom,mdss-dsi-lp11-init;
		qcom,mdss-dsi-init-delay-us = <2000>;
		qcom,mdss-dsi-rx-eot-ignore;
		qcom,mdss-dsi-tx-eot-append;
		qcom,mdss-dsi-force-clk-lane-hs;
		qcom,mdss-dsi-panel-orientation = "hflip";


		//qcom,esd-irq-gpio = <&msm_gpio 108 0>;
		//qcom,mdss-dsi-gamma-update = [39 01 00 00 00 00 02 F7 03];
		//qcom,mdss-dsi-panel-status-check-mode="reg_read_irq";
		//qcom,mdss-dsi-panel-status-value = <1>;
		//qcom,mdss-dsi-panel-status-irq-trigger="high";



		samsung,manufacture_id0_rx_cmds_revA = [ 06 01 00 00 00 00 01 DA 01 00];
		samsung,manufacture_id1_rx_cmds_revA = [ 06 01 00 00 00 00 01 DB 01 00];
		samsung,manufacture_id2_rx_cmds_revA = [ 06 01 00 00 00 00 01 DC 01 00];

		samsung,smart_dimming_mtp_rx_cmds_revA = [ 06 01 00 00 00 00 01 c8 21 00];

		samsung,ddi_id_rx_cmds_revA = [06 01 00 00 00 00 01 D5 05 00];

		samsung,mdnie_read_rx_cmds_revA = [ 06 01 00 00 00 00 01 B5 04 13];

		samsung,manufacture_date_rx_cmds_revA = [ 06 01 00 00 00 00 01 B5 02 23];	/* read C8 41~44th , 40=0x28*/

		samsung,hbm_rx_cmds_revA = [ 06 01 00 00 00 00 01 B5 10 0C ];	// B5h 13th para ~ 28th para. 16(0x10) ea
		samsung,hbm2_rx_cmds_revA = [ 06 01 00 00 00 00 01 B6 0F 02 ];	// B6h 3rd para ~ 17th para. 15(0x0F) ea

		/**************************************************
		*			TX CMDS
		***************************************************/

		samsung,display_on_tx_cmds_revA = [05 01 00 00 00 00 02 29 00];

		samsung,packet_size_tx_cmds_revA = [37 01 00 00 00 00 02 07 00];

		samsung,reg_read_pos_tx_cmds_revA = [15 01 00 00 00 00 02 B0 00];

		samsung,level1_key_enable_tx_cmds_revA = [
			39 01 00 00 00 00 03 F0 5A 5A
		];
		samsung,level1_key_disable_tx_cmds_revA = [
			39 01 00 00 00 00 03 F0 A5 A5
		];
		samsung,level2_key_enable_tx_cmds_revA = [
			39 00 00 00 00 00 03 F0 5A 5A
			39 01 00 00 00 00 03 fc 5a 5a
		];
		samsung,level2_key_disable_tx_cmds_revA = [
			39 00 00 00 00 00 03 F0 A5 A5
			39 01 00 00 00 00 03 fc A5 A5
		];

		samsung,gamma_tx_cmds_revA = [
			39 00 00 00 00 00 22 CA 01		/* Brightness Condition Set - Gamma 2.2 Setting*/
			00 01 00 01 00 80 80 80
			80 80 80 80 80 80 80 80
			80 80 80 80 80 80 80 80
			80 80 80 80 80 00 00 00
			39 00 00 00 00 00 02 B0 10
			39 00 00 00 00 00 02 B6 00
			39 00 00 00 00 00 02 F7 03
		];

		samsung,hbm_gamma_tx_cmds_revA = [
			39 00 00 00 00 00 22
				CA 01 00 01 00 01 00 80
				80 80 80 80 80 80 80 80
				80 80 80 80 80 80 80 80
				80 80 80 80 80 80 80 00
				00 00 ];

		samsung,hbm_etc_tx_cmds_revA = [
			39 00 00 00 00 00 02 B0 10
			39 00 00 00 00 00 02 B6 00
			39 00 00 00 00 00 02 F7 03	/* Gamma, LTPS(AID) update */
			39 00 00 00 00 00 02 55 02	/* power saving Set */
		];


		samsung,hbm_off_tx_cmds_revA = [
			39 00 00 00 00 00 02 B0 10
			39 00 00 00 00 00 02 B6 00
			39 01 00 00 00 00 02 F7 03		/* Gamma, LTPS(AID) update */
		];

		/*
		* ************************************************************************************************************************
		* AID command list and mappings
		* ************************************************************************************************************************
		*/


		samsung,aid_tx_cmds_revA = [
			39 00 00 00 00 00 06 B2 40 08 20 03 77	/* 00 AOR 90.9% */
			39 00 00 00 00 00 06 B2 40 08 20 03 73	/* 01 AOR 90.5% */
			39 00 00 00 00 00 06 B2 40 08 20 03 69	/* 02 AOR 89.4% 181*/
			39 00 00 00 00 00 06 B2 40 08 20 03 65	/* 03 AOR 89.0% 179*/
			39 00 00 00 00 00 06 B2 40 08 20 03 61	/* 04 AOR 88.6% 177*/
			39 00 00 00 00 00 06 B2 40 08 20 03 55	/* 05 AOR 87.4% 175*/
			39 00 00 00 00 00 06 B2 40 08 20 03 50	/* 06 AOR 86.9% 173*/
			39 00 00 00 00 00 06 B2 40 08 20 03 45	/* 07 AOR 85.8% 110*/
			39 00 00 00 00 00 06 B2 40 08 20 03 35	/* 08 AOR 84.1% 109*/
			39 00 00 00 00 00 06 B2 40 08 20 03 27	/* 09 AOR 82.7% 108*/
			39 00 00 00 00 00 06 B2 40 08 20 03 23	/* 10 AOR 82.3% */
			39 00 00 00 00 00 06 B2 40 08 20 03 17	/* 11 AOR 81.0% 108*/
			39 00 00 00 00 00 06 B2 40 08 20 03 11	/* 12 AOR 80.4% */
			39 00 00 00 00 00 06 B2 40 08 20 03 04	/* 13 AOR 79.1% */
			39 00 00 00 00 00 06 B2 40 08 20 02 F4	/* 14 AOR 77.5% */
			39 00 00 00 00 00 06 B2 40 08 20 02 E3	/* 15 AOR 75.7% */
			39 00 00 00 00 00 06 B2 40 08 20 02 D7	/* 16 AOR 74.5% */
			39 00 00 00 00 00 06 B2 40 08 20 02 C6	/* 17 AOR 72.7% */
			39 00 00 00 00 00 06 B2 40 08 20 02 B7	/* 18 AOR 71.2% */
			39 00 00 00 00 00 06 B2 40 08 20 02 A1	/* 19 AOR 69.0% */
			39 00 00 00 00 00 06 B2 40 08 20 02 91	/* 20 AOR 67.3% */
			39 00 00 00 00 00 06 B2 40 08 20 02 78	/* 21 AOR 64.8% */
			39 00 00 00 00 00 06 B2 40 08 20 02 62	/* 22 AOR 62.5% */
			39 00 00 00 00 00 06 B2 40 08 20 02 45	/* 23 AOR 59.5% */
			39 00 00 00 00 00 06 B2 40 08 20 02 30	/* 24 AOR 57.4% */
			39 00 00 00 00 00 06 B2 40 08 20 02 13	/* 25 AOR 54.4% */
			39 00 00 00 00 00 06 B2 40 08 20 01 F5	/* 26 AOR 51.3% */
			39 00 00 00 00 00 06 B2 40 08 20 01 D3	/* 27 AOR 47.8% */
			39 00 00 00 00 00 06 B2 40 08 20 01 B1	/* 28 AOR 44.4% */
			39 00 00 00 00 00 06 B2 40 08 20 01 87	/* 29 AOR 40.1% */
			39 00 00 00 00 00 06 B2 40 08 20 01 63	/* 30 AOR 36.6% */
			39 00 00 00 00 00 06 B2 40 08 20 01 35	/* 31 AOR 31.7% */
			39 00 00 00 00 00 06 B2 40 08 20 01 05	/* 32 AOR 26.9% */
			39 00 00 00 00 00 06 B2 40 08 20 00 D5	/* 33 AOR 21.8% */
			39 00 00 00 00 00 06 B2 40 08 20 00 A1	/* 34 AOR 16.5% */
			39 00 00 00 00 00 06 B2 40 08 20 00 6F	/* 35 AOR 11.4% */
			39 00 00 00 00 00 06 B2 40 08 20 00 31	/* 36 AOR 5.0% */
			39 00 00 00 00 00 06 B2 40 08 20 01 86	/* 37 AOR 40% */
			39 00 00 00 00 00 06 B2 40 08 20 00 08	/* 38 AOR 0.6% */
		];

		samsung,aid_map_table_revA = <
			10 0		11 1		12 2		13 3		14 4
			15 5		16 6		17 7		19 8		20 9
			21 10		22 11		24 12		25 13		27 14
			29 15		30 16		32 17		34 18		37 19
			39 20		41 21		44 22		47 23		50 24
			53 25		56 26		60 27		64 28		68 29
			72 30		77 31		82 32		87 33		93 34
			98 35		105 36		111 37		119 37		126 37
			134 37		143 37		152 37		162 37		172 37
			183 38		195 38		207 38		220 38		234 38
			249 38		265 38		282 38		300 38
		>;

		/*
		* ************************************************************************************************************************
		* ACL command list and mappings
		* ************************************************************************************************************************
		*/

		samsung,acl_on_tx_cmds_revA = [39 01 00 00 00 00 02 55 02 ];

		samsung,acl_percent_tx_cmds_revA = [
					39 01 00 00 00 00 02 55 00
					39 01 00 00 00 00 02 55 01	/* default ACL 15% */
					39 01 00 00 00 00 02 55 02	/*		 ACL 30% */
					39 01 00 00 00 00 02 55 03
		];

		samsung,acl_off_tx_cmds_revA = [39 01 00 00 72 00 02 55 00 ];

		samsung,acl_map_table_revA =  <
			10	1		11	1		12	1		13	1		14	1
			15	1		16	1		17	1		19	1		20	1
			21	1		22	1		24	1		25	1		27	1
			29	1		30	1		32	1		34	1		37	1
			39	1		41	1		44	1		47	1		50	1
			53	1		56	1		60	1		64	1		68	1
			72	1		77	1		82	1		87	1		93	1
			98	1		105	1		111	1		119	1		126	1
			134	1		143	1		152	1		162	1		172	1
			183	1		195	1		207	1		220	1		234	1
			249	1		265	1		282	1		300	1
		>;

		/*
		* ************************************************************************************************************************
		* ELVSS(ACL Off) command list and mappings
		* ************************************************************************************************************************
		*/

		samsung,smart_acl_elvss_map_table_revA = <
			10	0		11	0		12	0		13	0		14	0
			15	0		16	0		17	0		19	0		20	0
			21	0		22	0		24	0		25	0		27	0
			29	0		30	0		32	0		34	0		37	0
			39	0		41	0		44	0		47	0		50	0
			53	0		56	0		60	0		64	0		68	0
			72	0		77	0		82	0		87	0		93	0
			98	0		105	0		111	1		119	2		126	3
			134	4		143	5		152	6		162	7		172	8
			183	9		195	10		207	11		220	12		234	13
			249	14		265	15		282	16		300	17
			>;

		/*
		* ************************************************************************************************************************
		* candela to index mappings
		* ************************************************************************************************************************
		*/

		samsung,candela_map_table_revA = <
		/*<idx>	  <from>  <till> <candella> */
			0		0		10		10
			1		11		11		11
			2		12		12		12
			3		13		13		13
			4		14		14		14
			5		15		15		15
			6		16		16		16
			7		17		17		17
			8		18		18		19
			9		19		19		20
			10		20		20		21
			11		21		21		22
			12		22		22		24
			13		23		23		25
			14		24		24		27
			15		25		25		29
			16		26		26		30
			17		27		27		32
			18		28		28		34
			19		29		29		37
			20		30		30		39
			21		31		32		41
			22		33		34		44
			23		35		36		47
			24		37		38		50
			25		39		40		53
			26		41		43		56
			27		44		46		60
			28		47		49		64
			29		50		52		68
			30		53		56		72
			31		57		59		77
			32		60		63		82
			33		64		67		87
			34		68		71		93
			35		72		76		98
			36		77		80		105
			37		81		86		111
			38		87		91		119
			39		92		97		126
			40		98		104		134
			41		105		110		143
			42		111		118		152
			43		119		125		162
			44		126		133		172
			45		134		142		183
			46		143		150		195
			47		151		160		207
			48		161		170		220
			49		171		181		234
			50		182		205		249
			51		206		234		265
			52		235		254		282
			53		255		255		300
		>;
















		//samsung,mtp_read_sysfs_rx_cmds_revA = [ 06 01 00 00 00 00 01 01 01 01];

		samsung,elvss_rx_cmds_revA = [ 06 01 00 00 00 00 01 B6 01 10];	/* read C6 21th , 20=0x14*/

		samsung,avc_on_revA = [			/* 4. AVC set */
			39 00 00 00 00 00 03 F0 5a 5a /* Tesk key ON */
			39 00 00 00 00 00 03 FC 5a 5a /* Tesk key ON */
			39 00 00 00 00 00 02 B0 03
			39 00 00 00 00 00 02 F4 02 /* AVC On */
			39 00 00 00 00 00 03 F2 04 0C
			39 00 00 00 00 00 03 F0 A5 A5
			39 00 00 00 20 00 03 FC A5 A5
			05 01 00 00 00 00 02 29 00 /* Display on */
		];
		//samsung,dsi-lp11-init;

		
		
		samsung,smart_acl_elvss_tx_cmds_revA = [
			39 00 00 00 00 00 03 B6 28 14		/* 0 105cd/m2 ~ 10cd/m2 */
			39 00 00 00 00 00 03 B6 28 14		/* 1 111cd/m2 */
			39 00 00 00 00 00 03 B6 28 13		/* 2 119cd/m2 */
			39 00 00 00 00 00 03 B6 28 12		/* 3 126cd/m2 */
			39 00 00 00 00 00 03 B6 28 12		/* 4 134cd/m2 */
			39 00 00 00 00 00 03 B6 28 11		/* 5 143cd/m2 */
			39 00 00 00 00 00 03 B6 28 10		/* 6 152cd/m2 */
			39 00 00 00 00 00 03 B6 28 0F		/* 7 162cd/m2 */
			39 00 00 00 00 00 03 B6 28 0E		/* 8 172cd/m2 */
			39 00 00 00 00 00 03 B6 28 11		/* 9 183cd/m2 */
			39 00 00 00 00 00 03 B6 28 11		/* 10 195cd/m2 */
			39 00 00 00 00 00 03 B6 28 10		/* 11 207cd/m2 */
			39 00 00 00 00 00 03 B6 28 0F		/* 12 220cd/m2 */
			39 00 00 00 00 00 03 B6 28 0F		/* 13 234cd/m2 */
			39 00 00 00 00 00 03 B6 28 0E		/* 14 249cd/m2 */
			39 00 00 00 00 00 03 B6 28 0D		/* 15 265cd/m2 */
			39 00 00 00 00 00 03 B6 28 0C		/* 16 282cd/m2 */
			39 00 00 00 00 00 03 B6 28 0B		/* 17 300cd/m2 */
		];
		
	};
};
