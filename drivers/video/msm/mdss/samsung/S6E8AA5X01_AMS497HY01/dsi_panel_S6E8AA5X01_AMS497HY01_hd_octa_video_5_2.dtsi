/* Copyright (c) 2013-2014, The Linux Foundation. All rights reserved.
 *
 * This program is free software; you can redistribute it and/or modify
 * it under the terms of the GNU General Public License version 2 and
 * only version 2 as published by the Free Software Foundation.
 *
 * This program is distributed in the hope that it will be useful,
 * but WITHOUT ANY WARRANTY; without even the implied warranty of
 * MERCHANTABILITY or FITNESS FOR A PARTICULAR PURPOSE.  See the
 * GNU General Public License for more details.
 */

/*---------------------------------------------------------------------------
 * This file is autogenerated file using gcdb parser. Please do not edit it.
 * Update input XML file to add a new entry or update variable in this file
 * VERSION = "1.0"
 *---------------------------------------------------------------------------

 */
&mdss_mdp {
	ss_dsi_panel_S6E8AA5X01_AMS497HY01_HD: ss_dsi_panel_S6E8AA5X01_AMS497HY01_HD {
		qcom,mdss-dsi-panel-name = "ss_dsi_panel_S6E8AA5X01_AMS497HY01_HD";
		qcom,mdss-dsi-panel-controller = <&mdss_dsi0>;
		qcom,mdss-dsi-panel-type = "dsi_video_mode";
		qcom,mdss-dsi-panel-destination = "display_1";
		qcom,cont-splash-enabled;
		qcom,mdss-dsi-panel-framerate = <60>;
		qcom,mdss-dsi-virtual-channel-id = <0>;
		qcom,mdss-dsi-stream = <0>;
		qcom,mdss-dsi-panel-width = <720>;
		qcom,mdss-dsi-panel-height = <1280>;
		qcom,mdss-pan-physical-width-dimension = <64>; /* <Width> real size of panel in mm */
		qcom,mdss-pan-physical-height-dimension = <114>; /*<Height> real size of panel in mm */
		qcom,mdss-dsi-lp11-init;
		qcom,mdss-dsi-init-delay-us = <2000>;
		qcom,mdss-dsi-h-front-porch = <226>;
		qcom,mdss-dsi-h-back-porch = <100>;
		qcom,mdss-dsi-h-pulse-width = <20>;
		qcom,mdss-dsi-h-sync-skew = <0>;
		qcom,mdss-dsi-v-back-porch = <8>;
		qcom,mdss-dsi-v-front-porch = <14>;
		qcom,mdss-dsi-v-pulse-width = <2>;
		qcom,mdss-dsi-h-left-border = <0>;
		qcom,mdss-dsi-h-right-border = <0>;
		qcom,mdss-dsi-v-top-border = <0>;
		qcom,mdss-dsi-v-bottom-border = <0>;
		qcom,mdss-dsi-bpp = <24>;
		qcom,mdss-dsi-color-order = "rgb_swap_rgb";
		qcom,mdss-dsi-underflow-color = <0xFF>;
		qcom,mdss-dsi-border-color = <0>;
		qcom,mdss-dsi-dma-trigger = "trigger_sw";
		qcom,mdss-dsi-mdp-trigger = "none";
		qcom,mdss-dsi-bl-min-level = <1>;
		qcom,mdss-dsi-bl-max-level = <255>;
		qcom,mdss-dsi-bl-pmic-control-type = "bl_ctrl_dcs";
		qcom,mdss-dsi-lane-0-state;
		qcom,mdss-dsi-lane-1-state;
		qcom,mdss-dsi-lane-2-state;
		qcom,mdss-dsi-lane-3-state;
		qcom,mdss-dsi-bllp-eof-power-mode;
		qcom,mdss-dsi-bllp-power-mode;
		qcom,mdss-dsi-traffic-mode = "burst_mode";
		qcom,mdss-dsi-force-clk-lane-hs;
		qcom,mdss-dsi-reset-sequence = <1 5>, <0 1>, <1 10>;
		qcom,mdss-dsi-h-sync-pulse = <0>;
		qcom,mdss-dsi-hfp-power-mode;
		qcom,mdss-dsi-panel-timings = [8C 1E 14 00 44 4A 18 22 18 03 04 00];
		qcom,mdss-dsi-t-clk-pre = <0x1C>;
		qcom,mdss-dsi-t-clk-post = <0x04>;
		qcom,mdss-dsi-pixel-packing = "loose";
		qcom,mdss-dsi-lane-map = "lane_map_0123";
		qcom,mdss-dsi-on-command-state = "dsi_lp_mode";
		qcom,mdss-dsi-off-command-state = "dsi_hs_mode";
		qcom,mdss-dsi-rx-eot-ignore;
		qcom,mdss-dsi-tx-eot-append;
		qcom,mdss-dsi-on-command = [
			39 00 00 00 00 00 03 F0 5A 5A /* Tesk key ON */
			39 01 00 00 00 00 02 CC 4C /* PCD Polarity Setting */
			05 01 00 00 14 00 02 11 00 /* Sleep out  wait 20ms */

			39 00 00 00 00 00 22 /* 360nit 2.0 Gamma */
			CA 01 00 01 00 01 00 /* V255 R,G,B*/
			80 80 80 /* V203 R,G,B*/
			80 80 80 /* V151 R,G,B*/
			80 80 80 /* V87 R,G,B*/
			80 80 80 /* V51 R,G,B*/
			80 80 80 /* V35 R,G,B*/
			80 80 80 /* V23 R,G,B*/
			80 80 80 /* V11 R,G,B*/
			80 80 80 /* V3 R,G,B*/
			00 00 00 /* VT R,G,B*/

			39 00 00 00 00 00 05 B2 00 0F 00 0F /* AID setting *//* AOR 0% */
			39 00 00 00 00 00 03 B6 BC 0F /* ELVSS */

			39 00 00 00 00 00 02 F7 03 /* gamma upate */
			39 00 00 00 00 00 02 F7 00 /* gamma upate */

			39 00 00 00 00 00 04 C0 D8 D8 40 /* pentile setting */
			39 00 00 00 00 00 02 B0 06 /* global para */
			39 00 00 00 78 00 02 B8 A8 /* De_DIM setting */

			39 01 00 00 00 00 03 F0 A5 A5 /* Tesk key OFF */
		];

		qcom,mdss-dsi-off-command = [
			05 01 00 00 00 00 02 28 00
			05 01 00 00 78 00 02 10 00
		];

/*
* ************************************************************************************************************************************
*
*
*			Below  parameters are samsung dependent thigs
*
*
* ************************************************************************************************************************************
*/
		/*samsung,support_factory_panel_swap;*/
		/**************************************************
		*			RX CMDS
		* samsung,mdnie_read_rx_cmds_revA = [ 06 01 00 00 00 00 01 D7 04 03];
		* D7 = register address, 04 = size, 03 = start postion
		***************************************************/
		samsung,manufacture_id0_rx_cmds_revA = [ 06 01 00 00 00 00 01 da 01 00];
		samsung,manufacture_id1_rx_cmds_revA = [ 06 01 00 00 00 00 01 db 01 00];
		samsung,manufacture_id2_rx_cmds_revA = [ 06 01 00 00 00 00 01 dc 01 00];

		samsung,smart_dimming_mtp_rx_cmds_revA = [ 06 01 00 00 00 00 01 C8 21 00];

		samsung,ddi_id_rx_cmds_revA = [06 01 00 00 00 00 01 D5 05 00 ];

		samsung,mtp_read_sysfs_rx_cmds_revA = [ 06 01 00 00 00 00 01 01 01 01];

		samsung,mdnie_read_rx_cmds_revA = [ 06 01 00 00 00 00 01 D7 04 03];

		samsung,manufacture_date_rx_cmds_revA = [ 06 01 00 00 00 00 01 B5 02 17];	/* read B6 24~25th , 23=0x17*/

		samsung,hbm_rx_cmds_revA = [ 06 01 00 00 00 00 01 C8 06 21];	/* read C8h 34th~39th , 33=0x21*/
		samsung,cell_id_rx_cmds_revA = [06 01 00 00 00 00 01 C8 07 28];     /* read C8 41~47th , 40=0x28 */
		samsung,hbm2_rx_cmds_revA = [ 06 01 00 00 00 00 01 C8 0F 48];	/* read C8h 73th~87th , 72=0x48*/
		samsung,elvss_rx_cmds_revA = [ 06 01 00 00 00 00 01 b6 01 15];	/* read C6 22th , 21=0x15*/

		/**************************************************
		*			TX CMDS
		***************************************************/
		samsung,display_on_tx_cmds_revA = [05 01 00 00 00 00 02 29 00];

		samsung,packet_size_tx_cmds_revA = [37 01 00 00 00 00 02 07 00];

		samsung,reg_read_pos_tx_cmds_revA = [15 01 00 00 00 00 02 B0 00];

		samsung,level1_key_enable_tx_cmds_revA = [
			29 01 00 00 00 00 03 F0 5A 5A
		];
		samsung,level1_key_disable_tx_cmds_revA = [
			29 01 00 00 00 00 03 F0 A5 A5
		];
		samsung,level2_key_enable_tx_cmds_revA = [
			29 01 00 00 00 00 03 F0 5A 5A
		];
		samsung,level2_key_disable_tx_cmds_revA = [
			29 01 00 00 00 00 03 F0 A5 A5
		];

		samsung,gamma_tx_cmds_revA = [
			39 01 00 00 00 00 22	/* Brightness Condition Set - Gamma 2.2 Setting*/
			CA 01 00 01 00 01 00
			80 80 80 80 80 80 80
			80 80 80 80 80 80 80
			80 80 80 80 80 80 80
			80 80 80 00 00 00

			39 01 00 00 00 00 02 F7 03	/* gamma upate */
		];

		samsung,hbm_gamma_tx_cmds_revA = [
			39 01 00 00 00 00 23            /* Brightness Condition Set - Gamma 2.2 Setting*/
			B4 0B
			FF FF FF
			FF FF FF
			FF FF FF
			FF FF FF
			FF FF FF
			FF FF FF
			FF FF FF
			80 80 80
			80 80 80
			80 80 80
			00 00 00
		];

		samsung,hbm_etc_tx_cmds_revA = [
			39 01 00 00 00 00 03 B6 AC 0F	/* MPS/ELVSS Setting */
			39 01 00 00 00 00 02 B5 50		/* OPR Average Calculation */
			39 01 00 00 00 00 02 53 C0		/* HBM Control */
			39 01 00 00 00 00 02 55 02		/* 0x02 : ACL 15% on */
			39 01 00 00 01 00 02 F7 03		/* gamma upate */
			39 01 00 00 00 00 02 F7 00		/* gamma upate */
		];

		samsung,hbm_off_tx_cmds_revA = [
			39 01 00 00 00 00 02 53 00
		];

		/*
		* ************************************************************************************************************************
		* AID command list and mappings
		* ************************************************************************************************************************
		*/
		samsung,aid_tx_cmds_revA = [
			39 01 00 00 00 00 03 B2 04 EE   /* 00 samsung_brightness aor 96.78% */
			39 01 00 00 00 00 03 B2 04 E0   /* 01 samsung_brightness aor 95.71% */
			39 01 00 00 00 00 03 B2 04 D3   /* 02 samsung_brightness aor 94.71% */
			39 01 00 00 00 00 03 B2 04 CE   /* 03 samsung_brightness aor 94.33% */
			39 01 00 00 00 00 03 B2 04 CD   /* 04 samsung_brightness aor 94.25% */
			39 01 00 00 00 00 03 B2 04 B3   /* 05 samsung_brightness aor 92.25% */
			39 01 00 00 00 00 03 B2 04 AE   /* 06 samsung_brightness aor 91.87% */
			39 01 00 00 00 00 03 B2 04 A0   /* 07 samsung_brightness aor 90.80% */
			39 01 00 00 00 00 03 B2 04 93   /* 08 samsung_brightness aor 89.80% */
			39 01 00 00 00 00 03 B2 04 8D   /* 09 samsung_brightness aor 89.34% */
			39 01 00 00 00 00 03 B2 04 80   /* 10 samsung_brightness aor 88.34% */
			39 01 00 00 00 00 03 B2 04 73   /* 11 samsung_brightness aor 87.35% */
			39 01 00 00 00 00 03 B2 04 6C   /* 12 samsung_brightness aor 86.81% */
			39 01 00 00 00 00 03 B2 04 52   /* 13 samsung_brightness aor 84.82% */
			39 01 00 00 00 00 03 B2 04 45   /* 14 samsung_brightness aor 83.82% */
			39 01 00 00 00 00 03 B2 04 3E   /* 15 samsung_brightness aor 83.28% */
			39 01 00 00 00 00 03 B2 04 2F   /* 16 samsung_brightness aor 82.13% */
			39 01 00 00 00 00 03 B2 04 12   /* 17 samsung_brightness aor 79.91% */
			39 01 00 00 00 00 03 B2 04 03   /* 18 samsung_brightness aor 78.76% */
			39 01 00 00 00 00 03 B2 03 EE   /* 19 samsung_brightness aor 77.15% */
			39 01 00 00 00 00 03 B2 03 D1   /* 20 samsung_brightness aor 74.92% */
			39 01 00 00 00 00 03 B2 03 BF   /* 21 samsung_brightness aor 73.54% */
			39 01 00 00 00 00 03 B2 03 A5   /* 22 samsung_brightness aor 71.55% */
			39 01 00 00 00 00 03 B2 03 90   /* 23 samsung_brightness aor 69.94% */
			39 01 00 00 00 00 03 B2 03 6F   /* 24 samsung_brightness aor 67.41% */
			39 01 00 00 00 00 03 B2 03 51   /* 25 samsung_brightness aor 65.11% */
			39 01 00 00 00 00 03 B2 03 3D   /* 26 samsung_brightness aor 63.57% */
			39 01 00 00 00 00 03 B2 03 12   /* 27 samsung_brightness aor 60.28% */
			39 01 00 00 00 00 03 B2 02 F0   /* 28 samsung_brightness aor 57.67% */
			39 01 00 00 00 00 03 B2 02 CD   /* 29 samsung_brightness aor 54.98% */
			39 01 00 00 00 00 03 B2 02 A3   /* 30 samsung_brightness aor 51.76% */
			39 01 00 00 00 00 03 B2 02 80   /* 31 samsung_brightness aor 49.08% */
			39 01 00 00 00 00 03 B2 02 50   /* 32 samsung_brightness aor 45.40% */
			39 01 00 00 00 00 03 B2 02 1D   /* 33 samsung_brightness aor 41.49% */
			39 01 00 00 00 00 03 B2 01 F0   /* 34 samsung_brightness aor 38.04% */
			39 01 00 00 00 00 03 B2 01 FF   /* 35 samsung_brightness aor 39.19% */
			39 01 00 00 00 00 03 B2 01 C8   /* 36 samsung_brightness aor 34.97% */
			39 01 00 00 00 00 03 B2 01 8A   /* 37 samsung_brightness aor 30.21% */
			39 01 00 00 00 00 03 B2 01 F0   /* 38 samsung_brightness aor 38.04% */
			39 01 00 00 00 00 03 B2 01 BC   /* 39 samsung_brightness aor 34.05% */
			39 01 00 00 00 00 03 B2 01 7E   /* 40 samsung_brightness aor 29.29% */
			39 01 00 00 00 00 03 B2 01 3E   /* 41 samsung_brightness aor 24.39% */
			39 01 00 00 00 00 03 B2 00 FF   /* 42 samsung_brightness aor 19.56% */
			39 01 00 00 00 00 03 B2 00 B0   /* 43 samsung_brightness aor 13.50% */
			39 01 00 00 00 00 03 B2 00 62   /* 44 samsung_brightness aor 7.52%  */
			39 01 00 00 00 00 03 B2 00 0F   /* 45 samsung_brightness aor 1.15%  */
		];

		samsung,aid_map_table_revA = <
			5	0		6	1		7	2		8	3		9	4
			10	5		11	6		12	7		13	8		14	9
			15	10		16	11		17	12		19	13		20	14
			21	15		22	16		24	17		25	18		27	19
			29	20		30	21		32	22		34	23		37	24
			39	25		41	26		44	27		47	28		50	29
			53	30		56	31		60	32		64	33		68	34
			72	34		77	34		82	34		87	34		93	34
			98	34		105	34		111	34		119	34		126	34
			134	35		143	36		152	37		162	38		172	39
			183	40		195	41		207	42		220	43		234	44
			249	45		265	45		282	45		300	45		316	45
			333	45		360	45
		>;
		samsung,aid_tx_cmds_revC = [
			39 01 00 00 00 00 03 B2 04 EE   /* 00 samsung_brightness aor 96.78% */
			39 01 00 00 00 00 03 B2 04 E1   /* 01 samsung_brightness aor 95.78% */
			39 01 00 00 00 00 03 B2 04 D4   /* 02 samsung_brightness aor 94.79% */
			39 01 00 00 00 00 03 B2 04 CF   /* 03 samsung_brightness aor 94.40% */
			39 01 00 00 00 00 03 B2 04 C2   /* 04 samsung_brightness aor 93.30% */
			39 01 00 00 00 00 03 B2 04 B4   /* 05 samsung_brightness aor 92.33% */
			39 01 00 00 00 00 03 B2 04 AF   /* 06 samsung_brightness aor 91.95% */
			39 01 00 00 00 00 03 B2 04 A3   /* 07 samsung_brightness aor 91.03% */
			39 01 00 00 00 00 03 B2 04 96   /* 08 samsung_brightness aor 90.03% */
			39 01 00 00 00 00 03 B2 04 91   /* 09 samsung_brightness aor 89.65% */
			39 01 00 00 00 00 03 B2 04 82   /* 10 samsung_brightness aor 88.50% */
			39 01 00 00 00 00 03 B2 04 75   /* 11 samsung_brightness aor 87.50% */
			39 01 00 00 00 00 03 B2 04 70   /* 12 samsung_brightness aor 87.12% */
			39 01 00 00 00 00 03 B2 04 54   /* 13 samsung_brightness aor 84.97% */
			39 01 00 00 00 00 03 B2 04 50   /* 14 samsung_brightness aor 84.66% */
			39 01 00 00 00 00 03 B2 04 42   /* 15 samsung_brightness aor 83.59% */
			39 01 00 00 00 00 03 B2 04 33   /* 16 samsung_brightness aor 82.44% */
			39 01 00 00 00 00 03 B2 04 1E   /* 17 samsung_brightness aor 80.83% */
			39 01 00 00 00 00 03 B2 04 10   /* 18 samsung_brightness aor 79.75% */
			39 01 00 00 00 00 03 B2 03 F2   /* 19 samsung_brightness aor 77.45% */
			39 01 00 00 00 00 03 B2 03 DE   /* 20 samsung_brightness aor 75.92% */
			39 01 00 00 00 00 03 B2 03 C6   /* 21 samsung_brightness aor 74.08% */
			39 01 00 00 00 00 03 B2 03 B1   /* 22 samsung_brightness aor 72.47% */
			39 01 00 00 00 00 03 B2 03 95   /* 23 samsung_brightness aor 70.32% */
			39 01 00 00 00 00 03 B2 03 73   /* 24 samsung_brightness aor 67.71% */
			39 01 00 00 00 00 03 B2 03 5F   /* 25 samsung_brightness aor 66.18% */
			39 01 00 00 00 00 03 B2 03 43   /* 26 samsung_brightness aor 64.03% */
			39 01 00 00 00 00 03 B2 03 20   /* 27 samsung_brightness aor 61.35% */
			39 01 00 00 00 00 03 B2 02 FE   /* 28 samsung_brightness aor 58.74% */
			39 01 00 00 00 00 03 B2 02 DF   /* 29 samsung_brightness aor 56.37% */
			39 01 00 00 00 00 03 B2 02 B2   /* 30 samsung_brightness aor 52.91% */
			39 01 00 00 00 00 03 B2 02 90   /* 31 samsung_brightness aor 50.31% */
			39 01 00 00 00 00 03 B2 02 5E   /* 32 samsung_brightness aor 46.47% */
			39 01 00 00 00 00 03 B2 02 30   /* 33 samsung_brightness aor 42.94% */
			39 01 00 00 00 00 03 B2 01 F4   /* 34 samsung_brightness aor 38.34% */
			39 01 00 00 00 00 03 B2 01 BF   /* 35 samsung_brightness aor 34.28% */
			39 01 00 00 00 00 03 B2 01 82   /* 36 samsung_brightness aor 29.60% */
			39 01 00 00 00 00 03 B2 01 40   /* 37 samsung_brightness aor 24.54% */
			39 01 00 00 00 00 03 B2 01 00   /* 38 samsung_brightness aor 19.63.21% */
			39 01 00 00 00 00 03 B2 00 B2   /* 39 samsung_brightness aor 13.65.04% */
			39 01 00 00 00 00 03 B2 00 62   /* 40 samsung_brightness aor 7.52% */
			39 01 00 00 00 00 03 B2 00 0F   /* 41 samsung_brightness aor 1.15% */
		];

		samsung,aid_map_table_revC = <
			5	0		6	1		7	2		8	3		9	4
			10	5		11	6		12	7		13	8		14	9
			15	10		16	11		17	12		19	13		20	14
			21	15		22	16		24	17		25	18		27	19
			29	20		30	21		32	22		34	23		37	24
			39	25		41	26		44	27		47	28		50	29
			53	30		56	31		60	32		64	33		68	34
			72	34		77	34		82	34		87	34		93	34
			98	34		105	34		111	34		119	34		126	35
			134	36		143	37		152	38		162	39		172	40
			183	41		195	41		207	41		220	41		234	41
			249	41		265	41		282	41		300	41		316	41
			333	41		360	41
		>;

		samsung,aid_tx_cmds_revE = [
			39 01 00 00 00 00 03 B2 04 EE   /* 00 samsung_brightness aor 96.78% */
			39 01 00 00 00 00 03 B2 04 E1   /* 01 samsung_brightness aor 95.78% */
			39 01 00 00 00 00 03 B2 04 D4   /* 02 samsung_brightness aor 94.79% */
			39 01 00 00 00 00 03 B2 04 CF   /* 03 samsung_brightness aor 94.40% */
			39 01 00 00 00 00 03 B2 04 C2   /* 04 samsung_brightness aor 93.30% */
			39 01 00 00 00 00 03 B2 04 B4   /* 05 samsung_brightness aor 92.33% */
			39 01 00 00 00 00 03 B2 04 AF   /* 06 samsung_brightness aor 91.95% */
			39 01 00 00 00 00 03 B2 04 A3   /* 07 samsung_brightness aor 91.03% */
			39 01 00 00 00 00 03 B2 04 96   /* 08 samsung_brightness aor 90.03% */
			39 01 00 00 00 00 03 B2 04 91   /* 09 samsung_brightness aor 89.65% */
			39 01 00 00 00 00 03 B2 04 82   /* 10 samsung_brightness aor 88.50% */
			39 01 00 00 00 00 03 B2 04 75   /* 11 samsung_brightness aor 87.50% */
			39 01 00 00 00 00 03 B2 04 70   /* 12 samsung_brightness aor 87.12% */
			39 01 00 00 00 00 03 B2 04 54   /* 13 samsung_brightness aor 84.97% */
			39 01 00 00 00 00 03 B2 04 50   /* 14 samsung_brightness aor 84.66% */
			39 01 00 00 00 00 03 B2 04 42   /* 15 samsung_brightness aor 83.59% */
			39 01 00 00 00 00 03 B2 04 33   /* 16 samsung_brightness aor 82.44% */
			39 01 00 00 00 00 03 B2 04 1E   /* 17 samsung_brightness aor 80.83% */
			39 01 00 00 00 00 03 B2 04 10   /* 18 samsung_brightness aor 79.75% */
			39 01 00 00 00 00 03 B2 03 F2   /* 19 samsung_brightness aor 77.45% */
			39 01 00 00 00 00 03 B2 03 DE   /* 20 samsung_brightness aor 75.92% */
			39 01 00 00 00 00 03 B2 03 C6   /* 21 samsung_brightness aor 74.08% */
			39 01 00 00 00 00 03 B2 03 B1   /* 22 samsung_brightness aor 72.47% */
			39 01 00 00 00 00 03 B2 03 95   /* 23 samsung_brightness aor 70.32% */
			39 01 00 00 00 00 03 B2 03 73   /* 24 samsung_brightness aor 67.71% */
			39 01 00 00 00 00 03 B2 03 5F   /* 25 samsung_brightness aor 66.18% */
			39 01 00 00 00 00 03 B2 03 43   /* 26 samsung_brightness aor 64.03% */
			39 01 00 00 00 00 03 B2 03 20   /* 27 samsung_brightness aor 61.35% */
			39 01 00 00 00 00 03 B2 02 FE   /* 28 samsung_brightness aor 58.74% */
			39 01 00 00 00 00 03 B2 02 DF   /* 29 samsung_brightness aor 56.37% */
			39 01 00 00 00 00 03 B2 02 B2   /* 30 samsung_brightness aor 52.91% */
			39 01 00 00 00 00 03 B2 02 90   /* 31 samsung_brightness aor 50.31% */
			39 01 00 00 00 00 03 B2 02 5E   /* 32 samsung_brightness aor 46.47% */
			39 01 00 00 00 00 03 B2 02 30   /* 33 samsung_brightness aor 42.94% */
			39 01 00 00 00 00 03 B2 01 F4   /* 34 samsung_brightness aor 38.34% */
			39 01 00 00 00 00 03 B2 01 C0   /* 35 samsung_brightness aor 34.36% */
			39 01 00 00 00 00 03 B2 01 82   /* 36 samsung_brightness aor 29.60% */
			39 01 00 00 00 00 03 B2 01 42   /* 37 samsung_brightness aor 24.69% */
			39 01 00 00 00 00 03 B2 01 02   /* 38 samsung_brightness aor 19.79% */
			39 01 00 00 00 00 03 B2 00 B3   /* 39 samsung_brightness aor 13.73.04% */
			39 01 00 00 00 00 03 B2 00 6E   /* 40 samsung_brightness aor 8.44% */
			39 01 00 00 00 00 03 B2 00 0F   /* 41 samsung_brightness aor 1.15% */
		];

		samsung,aid_map_table_revE = <
			5	0		6	1		7	2		8	3		9	4
			10	5		11	6		12	7		13	8		14	9
			15	10		16	11		17	12		19	13		20	14
			21	15		22	16		24	17		25	18		27	19
			29	20		30	21		32	22		34	23		37	24
			39	25		41	26		44	27		47	28		50	29
			53	30		56	31		60	32		64	33		68	34
			72	34		77	34		82	34		87	34		93	34
			98	34		105	34		110	34		119	34		126	35
			134	36		143	37		152	38		162	34		172	35
			183	36		195	37		207	38		220	39		234	40
			249	41		265	41		282	41		300	41		316	41
			333	41		360	41
		>;

		/*
		* ************************************************************************************************************************
		* ACL command list and mappings
		* ************************************************************************************************************************
		*/
		samsung,samsung_change_acl_by_brightness;

		samsung,acl_on_tx_cmds_revA = [
			39 01 00 00 00 00 02 B5 50
			39 01 00 00 00 00 02 55 02
		];

		samsung,acl_off_tx_cmds_revA = [
			39 01 00 00 00 00 02 B5 40
			39 01 00 00 00 00 02 55 00
		];

		/*
		* ************************************************************************************************************************
		* ELVSS(ACL Off) command list and mappings
		* ************************************************************************************************************************
		*/

		samsung,elvss_lowtemp_tx_cmds_revA = [
			29 01 00 00 00 00 02 B0 07
			29 01 00 00 00 00 02 B8 00
		];	/* Low Temperature Command */

		samsung,elvss_lowtemp2_tx_cmds_revA = [
			29 01 00 00 00 00 02 B0 15
			29 01 00 00 00 00 02 B6 00
		];	/* Low Temperature Command: default */

		samsung,elvss_tx_cmds_revA = [
			39 01 00 00 00 00 03 B6 AC 0F /* 0 DEFAULT_ELVSS(0x0F) */
			39 01 00 00 00 00 03 B6 AC 11 /* 1 DEFAULT_ELVSS(0x11) */
			39 01 00 00 00 00 03 B6 AC 14 /* 2 DEFAULT_ELVSS(0x14) */
			39 01 00 00 00 00 03 B6 AC 17 /* 3 DEFAULT_ELVSS(0x17) */
			39 01 00 00 00 00 03 B6 AC 19 /* 4 DEFAULT_ELVSS(0x19) */
			39 01 00 00 00 00 03 B6 AC 1B /* 5 DEFAULT_ELVSS(0x1B) */
			39 01 00 00 00 00 03 B6 AC 1D /* 6 DEFAULT_ELVSS(0x1D) */
			39 01 00 00 00 00 03 B6 AC 1F /* 7 DEFAULT_ELVSS(0x1F) */
			39 01 00 00 00 00 03 B6 BC 1F /* 8 DEFAULT_ELVSS(0x1F) */
			39 01 00 00 00 00 03 B6 BC 1E /* 9 DEFAULT_ELVSS(0x1E) */
			39 01 00 00 00 00 03 B6 BC 1D /* 10 DEFAULT_ELVSS(0x1D) */
			39 01 00 00 00 00 03 B6 BC 1C /* 11 DEFAULT_ELVSS(0x1C) */
			39 01 00 00 00 00 03 B6 BC 1B /* 12 DEFAULT_ELVSS(0x1B) */
			39 01 00 00 00 00 03 B6 BC 1A /* 13 DEFAULT_ELVSS(0x1A) */
			39 01 00 00 00 00 03 B6 BC 18 /* 14 DEFAULT_ELVSS(0x18) */
			39 01 00 00 00 00 03 B6 BC 17 /* 15 DEFAULT_ELVSS(0x17) */
			39 01 00 00 00 00 03 B6 BC 16 /* 16 DEFAULT_ELVSS(0x16) */
			39 01 00 00 00 00 03 B6 BC 14 /* 17 DEFAULT_ELVSS(0x14) */
			39 01 00 00 00 00 03 B6 BC 13 /* 18 DEFAULT_ELVSS(0x13) */
			39 01 00 00 00 00 03 B6 BC 12 /* 19 DEFAULT_ELVSS(0x12) */
			39 01 00 00 00 00 03 B6 BC 10 /* 20 DEFAULT_ELVSS(0x10) */
			39 01 00 00 00 00 03 B6 BC 0F /* 21 DEFAULT_ELVSS(0x0F) */
		];
		/* bl_level, Index in elvss command list */
		samsung,smart_acl_elvss_map_table_revA = <
			5	0		6	0		7	0		8	0		9	0
			10	0		11	0		12	0		13	0		14	0
			15	0		16	0		17	0		19	0		20	0
			21	1		22	2		24	3		25	4		27	5
			29	6		30	7		32	7		34	7		37	7
			39	7		41	8		44	8		47	8		50	8
			53	8		56	8		60	8		64	8		68	8
			72	8		77	8		82	8		87	8		93	8
			98	8		105	8		111	9		119	9		126	9
			134	9		143	10		152	10		162	10		172	10
			183	11		195	12		207	13		220	14		234	14
			249	15		265	16		282	17		300	18		316	19
			333	20		360	21
			>;

		samsung,elvss_tx_cmds_revE = [
			39 01 00 00 00 00 03 B6 BC 0F /* 0 DEFAULT_ELVSS(0x0F) */
			39 01 00 00 00 00 03 B6 BC 11 /* 1 DEFAULT_ELVSS(0x11) */
			39 01 00 00 00 00 03 B6 BC 13 /* 2 DEFAULT_ELVSS(0x13) */
			39 01 00 00 00 00 03 B6 BC 15 /* 3 DEFAULT_ELVSS(0x15) */
			39 01 00 00 00 00 03 B6 BC 17 /* 4 DEFAULT_ELVSS(0x17) */
			39 01 00 00 00 00 03 B6 BC 19 /* 5 DEFAULT_ELVSS(0x19) */
			39 01 00 00 00 00 03 B6 BC 1D /* 6 DEFAULT_ELVSS(0x1D) */
			39 01 00 00 00 00 03 B6 BC 1C /* 7 DEFAULT_ELVSS(0x1C) */
			39 01 00 00 00 00 03 B6 BC 1B /* 8 DEFAULT_ELVSS(0x1B) */
			39 01 00 00 00 00 03 B6 BC 1A /* 9 DEFAULT_ELVSS(0x1A) */
			39 01 00 00 00 00 03 B6 BC 19 /* 10 DEFAULT_ELVSS(0x19) */
			39 01 00 00 00 00 03 B6 BC 18 /* 11 DEFAULT_ELVSS(0x18) */
			39 01 00 00 00 00 03 B6 BC 17 /* 12 DEFAULT_ELVSS(0x17) */
			39 01 00 00 00 00 03 B6 BC 16 /* 13 DEFAULT_ELVSS(0x16) */
			39 01 00 00 00 00 03 B6 BC 15 /* 14 DEFAULT_ELVSS(0x15) */
			39 01 00 00 00 00 03 B6 BC 14 /* 15 DEFAULT_ELVSS(0x14) */
			39 01 00 00 00 00 03 B6 BC 13 /* 16 DEFAULT_ELVSS(0x13) */
			39 01 00 00 00 00 03 B6 BC 12 /* 17 DEFAULT_ELVSS(0x12) */
			39 01 00 00 00 00 03 B6 BC 11 /* 18 DEFAULT_ELVSS(0x11) */
			39 01 00 00 00 00 03 B6 BC 0F /* 19 DEFAULT_ELVSS(0x0F) */
		];
		/* bl_level, Index in elvss command list */
		samsung,smart_acl_elvss_map_table_revE = <
			5	0		6	0		7	0		8	0		9	0
			10	0		11	0		12	0		13	0		14	0
			15	0		16	0		17	0		19	0		20	0
			21	0		22	1		24	2		25	3		27	4
			29	5		30	6		32	6		34	6		37	6
			39	6		41	6		44	6		47	6		50	6
			53	6		56	6		60	6		64	6		68	6
			72	6		77	6		82	7		87	7		93	8
			98	8		105	8		111	9		119	9		126	9
			134	9		143	9		152	9		162	9		172	9
			183	9		195	10		207	11		220	11		234	12
			249	13		265	14		282	15		300	16		316	17
			333	18		360	19
			>;

		/*
		* ************************************************************************************************************************
		* candela to index mappings
		* ************************************************************************************************************************
		*/
		samsung,candela_map_table_revA = <
		/*<idx>	<from>	<till>		<candella> */
			0		0		5		5
			1		6		6		6
			2		7		7		7
			3		8		8		8
			4		9		9		9
			5		10		10		10
			6		11		11		11
			7		12		12		12
			8		13		13		13
			9		14		14		14
			10		15		15		15
			11		16		16		16
			12		17		17		17
			13		18		18		19
			14		19		19		20
			15		20		20		21
			16		21		21		22
			17		22		22		24
			18		23		23		25
			19		24		24		27
			20		25		25		29
			21		26		26		30
			22		27		27		32
			23		28		28		34
			24		29		29		37
			25		30		30		39
			26		31		32		41
			27		33		34		44
			28		35		36		47
			29		37		38		50
			30		39		40		53
			31		41		43		56
			32		44		46		60
			33		47		49		64
			34		50		52		68
			35		53		56		72
			36		57		59		77
			37		60		63		82
			38		64		67		87
			39		68		71		93
			40		72		76		98
			41		77		80		105
			42		81		86		111
			43		87		91		119
			44		92		97		126
			45		98		104		134
			46		105		110		143
			47		111		118		152
			48		119		125		162
			49		126		133		172
			50		134		142		183
			51		143		150		195
			52		151		160		207
			53		161		170		220
			54		171		181		234
			55		182		193		249
			56		194		205		265
			57		206		218		282
			58		219		230		300
			59		231		242		316
			60		243		254		333
			61		255		255		360
		>;
	};
};
