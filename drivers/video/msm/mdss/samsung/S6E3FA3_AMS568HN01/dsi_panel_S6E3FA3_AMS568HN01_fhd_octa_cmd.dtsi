/* Copyright (c) 2013-2014, The Linux Foundation. All rights reserved.
 *
 * This program is free software; you can redistribute it and/or modify
 * it under the terms of the GNU General Public License version 2 and
 * only version 2 as published by the Free Software Foundation.
 *
 * This program is distributed in the hope that it will be useful,
 * but WITHOUT ANY WARRANTY; without even the implied warranty of
 * MERCHANTABILITY or FITNESS FOR A PARTICULAR PURPOSE.  See the
 * GNU General Public License for more details.
 */

/*---------------------------------------------------------------------------
 * This file is autogenerated file using gcdb parser. Please do not edit it.
 * Update input XML file to add a new entry or update variable in this file
 * VERSION = "1.0"
 *---------------------------------------------------------------------------*/
&mdss_mdp {
	dsi_samsung_fhd: ss_dsi_panel_S6E3FA3_AMS568HN01_FHD {
		qcom,mdss-dsi-panel-name = "ss_dsi_panel_S6E3FA3_AMS568HN01_FHD";
		qcom,mdss-dsi-panel-controller = <&mdss_dsi0>;
		qcom,mdss-dsi-panel-width = <1080>;
		qcom,mdss-dsi-panel-height = <1920>;
		qcom,mdss-dsi-bpp = <24>;
		qcom,mdss-dsi-panel-destination = "display_1";

		qcom,mdss-dsi-panel-timings = [E6 38 26 00 68 6E 2A 46 2C 03 04 00];

		qcom,mdss-dsi-on-command= [
			05 01 00 00 14 00 02 11 00			/* Sleep out, wait 20ms(0x14) */

			/* TE Vsync On */
			29 01 00 00 00 00 02 35 00

			/* AVC setting */
			29 01 00 00 00 00 03 FC 5A 5A		/* TEST KEY Enable */
			29 01 00 00 00 00 02 B0 1E
			29 01 00 00 00 00 02 FD 94
			29 01 00 00 00 00 03 FC A5 A5

			/* PCD Setting */
			29 01 00 00 00 00 03 FC 5A 5A		/* TEST KEY Enable */
			29 01 00 00 00 00 02 CC 4C
			29 01 00 00 00 00 03 FC A5 A5

			/* TsHL Setting */
			29 01 00 00 00 00 03 FC 5A 5A		/* TEST KEY Enable */
			29 01 00 00 00 00 02 B0 10
			29 01 00 00 00 00 02 B6 7F
			29 01 00 00 00 00 03 FC A5 A5

			/* ERR_FG Setting */
			29 01 00 00 00 00 03 FC 5A 5A		/* TEST KEY Enable */
			29 01 00 00 00 00 02 ED 44
			29 01 00 00 00 00 03 FC A5 A5

			/* Brightness condition set */
			29 01 00 00 00 00 03 F0 5A 5A		/* TEST KEY Enable */
			29 01 00 00 00 00 24 CA				/* 1) Gamma 2.2 Setting */
				01 00 01 00 01 00	/* V255 R,G,B */
				80 80 80			/* V203 R,G,B */
				80 80 80			/* V151 R,G,B */
				80 80 80			/* V87 R,G,B */
				80 80 80			/* V51 R,G,B */
				80 80 80			/* V35 R,G,B */
				80 80 80			/* V23 R,G,B */
				80 80 80			/* V11 R,G,B */
				80 80 80			/*  V3 R,G,B */
				00 00 00			/*  V0 R,G,B */
				00 00				/*  VT R,G,B */
			29 01 00 00 00 00 03 B2 00 C2		/* AID set : AOR 0% */
			29 01 00 00 00 00 03 B6 BC 0A		/* CAPS ELVSS Set(ACL ON : 0x8C) */
			29 01 00 00 00 00 03 F4 7B 1E		/* VINT Set */
			29 01 00 00 00 00 02 F7 03			/* Gamma, LTPS(AID) update */
			29 01 00 00 00 00 02 F7 00			/* Gamma, LTPS(AID) Disable */
			29 01 00 00 50 00 03 F0 A5 A5		/* TEST KEY Disable */

			/* Memory Access */
			05 01 00 00 00 00 02 2C 00
			05 01 00 00 00 00 02 3C 00
		];

		qcom,mdss-dsi-off-command=[
			05 01 00 00 0A 00 02 28 00	/* wait 10ms(0x0A) */
			05 01 00 00 96 00 02 10 00	/* wait 150ms(0x96) */
		];

		qcom,cont-splash-enabled;
		qcom,mdss-dsi-force-clk-lane-hs;
		/*qcom,cmd-sync-wait-broadcast;*/
		/*qcom,cmd-sync-wait-trigger;*/
		/*qcom,mdss-dsi-fbc-enable=*/
		/*qcom,mdss-dsi-fbc-bpp=*/
		/*qcom,mdss-dsi-fbc-packing=*/
		/*qcom,mdss-dsi-fbc-quant-error=*/
		/*qcom,mdss-dsi-fbc-bias=*/
		/*qcom,mdss-dsi-fbc-pat-mode=*/
		/*qcom,mdss-dsi-fbc-vlc-mode=*/
		/*qcom,mdss-dsi-fbc-bflc-mode=*/
		/*qcom,mdss-dsi-fbc-h-line-budget=*/
		/*qcom,mdss-dsi-fbc-budget-ctrl=*/
		/*qcom,mdss-dsi-fbc-block-budget=*/
		/*qcom,mdss-dsi-fbc-lossless-threshold=*/
		/*qcom,mdss-dsi-fbc-lossy-threshold=*/
		/*qcom,mdss-dsi-fbc-rgb-threshold=*/
		/*qcom,mdss-dsi-fbc-lossy-mode-idx=*/

		qcom,mdss-dsi-h-back-porch = <36>;
		qcom,mdss-dsi-h-front-porch = <160>;
		qcom,mdss-dsi-h-pulse-width = <12>;
		qcom,mdss-dsi-h-sync-skew = <0>;
		qcom,mdss-dsi-v-back-porch = <7>;
		qcom,mdss-dsi-v-front-porch = <7>;
		qcom,mdss-dsi-v-pulse-width = <2>;

		qcom,mdss-dsi-h-left-border = <0>;
		qcom,mdss-dsi-h-right-border = <0>;
		qcom,mdss-dsi-v-top-border = <0>;
		qcom,mdss-dsi-v-bottom-border = <0>;

		qcom,mdss-dsi-underflow-color = <0xFF>;
		qcom,mdss-dsi-border-color = <0>;

		/*qcom,mdss-dsi-pan-enable-dynamic-fps=*/
		/*qcom,mdss-dsi-pan-fps-update=*/

		qcom,mdss-dsi-bl-pmic-control-type = "bl_ctrl_dcs";
		/*qcom,mdss-dsi-bl-pmic-bank-select=*/
		/*qcom,mdss-dsi-bl-pmic-pwm-frequency=*/
		/*qcom,mdss-dsi-pwm-gpio=*/

		qcom,mdss-dsi-bl-min-level = <1>;
		qcom,mdss-dsi-bl-max-level = <255>;
		qcom,mdss-brightness-max-level = <255>;
		qcom,mdss-dsi-interleave-mode = <0>;
		qcom,mdss-dsi-panel-type = "dsi_cmd_mode";

		qcom,mdss-dsi-te-check-enable;
		qcom,mdss-dsi-te-using-te-pin;
		qcom,mdss-dsi-te-pin-select = <1>;

		qcom,mdss-dsi-te-dcs-command = <1>;
		qcom,mdss-dsi-wr-mem-start = <0x2C>;
		qcom,mdss-dsi-wr-mem-continue = <0x3C>;

		/* CMD mode panel doesn't need below stuff */
		qcom,mdss-dsi-h-sync-pulse= <0>;
		/*qcom,mdss-dsi-hfp-power-mode=*/
		/*qcom,mdss-dsi-hbp-power-mode=*/
		/*qcom,mdss-dsi-hsa-power-mode=*/
		/*qcom,mdss-dsi-last-line-interleave=*/
		qcom,mdss-dsi-bllp-eof-power-mode;
		qcom,mdss-dsi-bllp-power-mode;
		qcom,mdss-dsi-traffic-mode= "burst_mode";

		qcom,mdss-dsi-pixel-packing = "loose";

		qcom,mdss-dsi-virtual-channel-id = <0>;
		qcom,mdss-dsi-color-order = "rgb_swap_rgb";
		qcom,mdss-dsi-lane-0-state;
		qcom,mdss-dsi-lane-1-state;
		qcom,mdss-dsi-lane-2-state;
		qcom,mdss-dsi-lane-3-state;
		qcom,mdss-dsi-lane-map = "lane_map_0123";

		qcom,mdss-dsi-t-clk-pre = <0x2B>;
		qcom,mdss-dsi-t-clk-post = <0x02>;

		qcom,mdss-dsi-stream = <0>;
		qcom,mdss-dsi-mdp-trigger = "none";
		qcom,mdss-dsi-dma-trigger = "trigger_sw";
		qcom,mdss-dsi-panel-framerate = <60>;
		qcom,mdss-dsi-panel-clockrate = <898000000>;
		qcom,mdss-dsi-on-command-state = "dsi_lp_mode";
		qcom,mdss-dsi-off-command-state = "dsi_hs_mode";

		qcom,mdss-pan-physical-width-dimension = <69>;
		qcom,mdss-pan-physical-height-dimension = <122>;

		qcom,mdss-dsi-panel-mode-gpio-state = "invalid";

		qcom,mdss-dsi-reset-sequence = <1 20>, <0 20>, <1 20>;
		/*qcom,partial-update-enabled;*/
		/*qcom,panel-roi-alignment=<8 8 1 1 1 1>;*/
		/*qcom,mdss-dsi-horizontal-line-idle*/

		qcom,mdss-dsi-lp11-init;
		qcom,mdss-dsi-init-delay-us = <1000>;

		qcom,mdss-dsi-rx-eot-ignore;
		qcom,mdss-dsi-tx-eot-append;

		/*qcom,ulps-enabled*/
		/*qcom,mdss-dsi-panel-status-command=*/
		/*qcom,mdss-dsi-panel-status-command-mode="dsi_lp_mode";*/
		/*qcom,esd-check-enabled;*/
		qcom,mdss-dsi-panel-status-check-mode="reg_read_irq";
		qcom,mdss-dsi-panel-status-value = <1>;
		qcom,mdss-dsi-panel-status-irq-trigger="rising";
		/*qcom,dynamic-mode-switch-enabled*/
		/*qcom,video-to-cmd-mode-switch-commands=*/
		/*qcom,cmd-to-video-mode-switch-commands=*/
/*
 * ************************************************************************************************************************************
 *
 *
 *			Below  parameters are samsung dependent thigs
 *
 *
 * ************************************************************************************************************************************
 */
		samsung,dsi-lp11-init;
		/*samsung,osc-te-fitting-enable; */
		/*
		 * Index of te fitting command from
		 * "qcom,mdss-dsi-on-command" and
		 * "samsung,osc_te_fitting_tx_cmds_revA"
		 */
		samsung,osc-te-fitting-cmd-index = <16 03>;
		/* Check the duration of N-1 vsync */
		samsung,osc-te-fitting-sampling-rate = <5>;
		samsung,display_on_tx_cmds_revA = [05 01 00 00 32 00 02 29 00];
		samsung,display_off_tx_cmds_revA = [05 01 00 00 32 00 02 28 00];

		samsung,level1_key_enable_tx_cmds_revA = [
			29 01 00 00 00 00 03 F0 5A 5A
		];
		samsung,level1_key_disable_tx_cmds_revA = [
			29 01 00 00 00 00 03 F0 A5 A5
		];
		samsung,level2_key_enable_tx_cmds_revA = [
			29 00 00 00 00 00 03 F0 5A 5A
			29 01 00 00 00 00 03 FC 5a 5a
		];
		samsung,level2_key_disable_tx_cmds_revA = [
			29 00 00 00 00 00 03 F0 A5 A5
			29 01 00 00 00 00 03 FC A5 A5
		];

		samsung,packet_size_tx_cmds_revA = [
			37 01 00 00 00 00 02 07 00
		];

		/*
		 * First parameters can be changed
		 * by function of samsung_nv_read()
		 * because of that means offset of
		 * read position
		 */
		samsung,reg_read_pos_tx_cmds_revA = [
			15 01 00 00 00 00 02 B0 00
		];


		/*
		 * ************************************************************************************************************************
		 *	 06 01 00 00 00 00 01 c8 07 21
		 *	READ 0xC8 SIZE 0x07 OFFSET 0x21
		 * ************************************************************************************************************************
		 */
		samsung,smart_dimming_mtp_rx_cmds_revA = [ 06 01 00 00 00 00 01 c8 23 00];
		/* the last byte in all read commands will represent READ LENGH */
		samsung,manufacture_id0_rx_cmds_revA = [ 06 01 00 00 00 00 01 da 01 00];
		samsung,manufacture_id1_rx_cmds_revA = [ 06 01 00 00 00 00 01 db 01 00];
		samsung,manufacture_id2_rx_cmds_revA = [ 06 01 00 00 00 00 01 dc 01 00];

		samsung,manufacture_date_rx_cmds_revA = [ 06 01 00 00 00 00 01 c8 02 28];	/* read C8 41~42th , 40=0x28*/
		samsung,ddi_id_rx_cmds_revA = [ 06 01 00 00 00 00 01 d6 05 00];	/* read D6 1~5th */
		samsung,cell_id_rx_cmds_revA = [ 06 01 00 00 00 00 01 C8 0B 28];	/* read C8 41~51th, 40=0x28 */
		samsung,mtp_read_sysfs_rx_cmds_revA = [ 06 01 00 00 00 00 01 01 01 01];

		samsung,elvss_rx_cmds_revA = [ 06 01 00 00 00 00 01 b6 01 15];	/* read C6 22th , 21=0x15*/
		samsung,mdnie_read_rx_cmds_revA	= [ 06 01 00 00 00 00 01 A1 04 00];

		samsung,ldi_debug0_rx_cmds_revA = [06 01 00 00 00 00 01 0A 01 00];
		samsung,ldi_debug1_rx_cmds_revA = [06 01 00 00 00 00 01 0E 01 00];
		samsung,ldi_debug2_rx_cmds_revA = [06 01 00 00 00 00 01 EA 08 00];

		/*
		 * ************************************************************************************************************************
		 *	 COMMON CMD LIST
		 * ************************************************************************************************************************
		 */

		samsung,elvss_lowtemp_tx_cmds_revA = [
			29 01 00 00 00 00 02 B8 19
		];	/* Low Temperature Command */

		samsung,elvss_lowtemp2_tx_cmds_revA = [
			29 01 00 00 00 00 02 B0 15
			29 01 00 00 00 00 02 B6 00
		];	/* Low Temperature Command: default */


		samsung,gamma_tx_cmds_revA = [
			29 01 00 00 00 00 24 CA				/* 1) Gamma 2.2 Setting */
				01 00 01 00 01 00	/* V255 R,G,B */
				80 80 80			/* V203 R,G,B */
				80 80 80			/* V151 R,G,B */
				80 80 80			/* V87 R,G,B */
				80 80 80			/* V51 R,G,B */
				80 80 80			/* V35 R,G,B */
				80 80 80			/* V23 R,G,B */
				80 80 80			/* V11 R,G,B */
				80 80 80			/*  V3 R,G,B */
				00 00 00			/*  V0 R,G,B */
				00 00				/*  VT R,G,B */
			29 01 00 00 00 00 02 00 00
			29 01 00 00 00 00 02 F7 03	/* Gamma, LTPS(AID) update */

			29 01 00 00 00 00 3C		/* dummy for single transmission more 100ns delay */
			00 00 00 00 00 00 00 00 00 00
			00 00 00 00 00 00 00 00 00 00
			00 00 00 00 00 00 00 00 00 00
			00 00 00 00 00 00 00 00 00 00
			00 00 00 00 00 00 00 00 00 00
			00 00 00 00 00 00 00 00 00 00

			29 01 00 00 00 00 02 F7 00
		];

		samsung,hbm_etc_tx_cmds_revA = [
			29 01 00 00 00 00 03 B6 BC 0A 	/* HBM ELVSS */
			29 01 00 00 00 00 02 B5 50		/* ACL OPR 32 Frame Average */
			29 01 00 00 00 00 03 F4 7B 1E 	/* VINT */
			29 01 00 00 00 00 02 53 C0		/* HBM On */
		];
		samsung,hbm_off_tx_cmds_revA = [
			29 01 00 00 00 00 02 53 00		/* HBM Off */
		];


		/*
		 * ************************************************************************************************************************
		 * AID command list and mappings
		 * ************************************************************************************************************************
		 */
		/* bl_level, Index in acl command list */
		samsung,aid_tx_cmds_revA = [
			/*	0	*/29 01 00 00 00 00 03 B2 70 77	/*   2CD */
			/*	1	*/29 01 00 00 00 00 03 B2 70 6D /*   3CD */
			/*	2	*/29 01 00 00 00 00 03 B2 70 5C /*   4CD */
			/*	3	*/29 01 00 00 00 00 03 B2 70 47 /*   5CD */
			/*	4	*/29 01 00 00 00 00 03 B2 70 3C /*   6CD */
			/*	5	*/29 01 00 00 00 00 03 B2 70 2F /*   7CD */
			/*	6	*/29 01 00 00 00 00 03 B2 70 1F /*   8CD */
			/*	7	*/29 01 00 00 00 00 03 B2 70 0E /*   9CD */
			/*	8	*/29 01 00 00 00 00 03 B2 70 01 /*  10CD */
			/*	9	*/29 01 00 00 00 00 03 B2 60 F0 /*  11CD */
			/*	10	*/29 01 00 00 00 00 03 B2 60 E3 /*  12CD */
			/*	11	*/29 01 00 00 00 00 03 B2 60 D9 /*  13CD */
			/*	12	*/29 01 00 00 00 00 03 B2 60 C4 /*  14CD */
			/*	13	*/29 01 00 00 00 00 03 B2 60 BA /*  15CD */
			/*	14	*/29 01 00 00 00 00 03 B2 60 A4 /*  16CD */
			/*	15	*/29 01 00 00 00 00 03 B2 60 9A /*  17CD */
			/*	16	*/29 01 00 00 00 00 03 B2 60 7C /*  19CD */
			/*	17	*/29 01 00 00 00 00 03 B2 60 66 /*  20CD */
			/*	18	*/29 01 00 00 00 00 03 B2 60 5C /*  21CD */
			/*	19	*/29 01 00 00 00 00 03 B2 60 45 /*  22CD */
			/*	20	*/29 01 00 00 00 00 03 B2 60 27 /*  24CD */
			/*	21	*/29 01 00 00 00 00 03 B2 60 1D /*  25CD */
			/*	22	*/29 01 00 00 00 00 03 B2 50 FE /*  27CD */
			/*	23	*/29 01 00 00 00 00 03 B2 50 DF /*  29CD */
			/*	24	*/29 01 00 00 00 00 03 B2 50 CE /*  30CD */
			/*	25	*/29 01 00 00 00 00 03 B2 50 AE /*  32CD */
			/*	26	*/29 01 00 00 00 00 03 B2 50 8F /*  34CD */
			/*	27	*/29 01 00 00 00 00 03 B2 50 62 /*  37CD */
			/*	28	*/29 01 00 00 00 00 03 B2 50 44 /*  39CD */
			/*	29	*/29 01 00 00 00 00 03 B2 50 24 /*  41CD */
			/*	30	*/29 01 00 00 00 00 03 B2 40 F8 /*  44CD */
			/*	31	*/29 01 00 00 00 00 03 B2 40 C2 /*  47CD */
			/*	32	*/29 01 00 00 00 00 03 B2 40 90 /*  50CD */
			/*	33	*/29 01 00 00 00 00 03 B2 40 5F /*  53CD */
			/*	34	*/29 01 00 00 00 00 03 B2 40 2F /*  56CD */
			/*	35	*/29 01 00 00 00 00 03 B2 30 EC /*  60CD */
			/*	36	*/29 01 00 00 00 00 03 B2 30 AB /*  64CD */
			/*	37	*/29 01 00 00 00 00 03 B2 30 6B /*  68CD */
			/*	38	*/29 01 00 00 00 00 03 B2 30 20 /*  77CD */
			/*	39	*/29 01 00 00 00 00 03 B2 20 DB /*  77 ~ 183CD*/
			/*	40	*/29 01 00 00 00 00 03 B2 20 76 /* 195CD */
			/*	41	*/29 01 00 00 00 00 03 B2 20 12 /* 207CD */
			/*	42	*/29 01 00 00 00 00 03 B2 10 B8 /* 220CD */
			/*	43	*/29 01 00 00 00 00 03 B2 10 3E /* 234CD */
			/*	44	*/29 01 00 00 00 00 03 B2 00 C2 /* 249~360CD */
		];


		/* bl_level, Index in acl command list */
		samsung,aid_map_table_revA = <
			2	0		3	1		4	2		5	3		6	4
			7	5		8	6		9	7		10	8		11	9
			12	10		13	11		14	12		15	13		16	14
			17	15		19	16		20	17		21	18		22	19
			24	20		25	21		27	22		29	23		30	24
			32	25		34	26		37	27		39	28		41	29
			44	30		47	31		50	32		53	33		56	34
			60	35		64	36		68	37		72	38		77	39
			82	39		87	39		93	39		98	39		105	39
			111	39		119	39		126	39		134	39		143	39
			152	39		162	39		172	39		183	39		195	40
			207	41		220	42		234	43		249	44		265	44
			282	44		300	44		316	44		333	44		360	44
		>;

		/*
		 * ************************************************************************************************************************
		 * ACL command list and mappings
		 * ************************************************************************************************************************
		 */

		samsung,samsung_change_acl_by_brightness;

		samsung,acl_on_tx_cmds_revA = [
			29 01 00 00 00 00 02 B5 50	/* ACL 32Frame Averaging */
			29 01 00 00 00 00 02 55 02	/* ACL 15%(default) ON */
		];

		samsung,acl_percent_tx_cmds_revA = [
			29 01 00 00 00 00 02 55 00	/* ACL OFF */
			29 01 00 00 00 00 02 55 01	/* ACL 15% */
			29 01 00 00 00 00 02 55 02	/* Default ACL 8% */
			29 01 00 00 00 00 02 55 03	/* ACL 20% */

		];

		samsung,acl_off_tx_cmds_revA = [
			29 01 00 00 00 00 02 B5 40	/* 16 Frame Avg. */
			29 01 00 00 00 00 02 55 00	/* ACL OFF */
		];

		/* bl_level , Index in acl command list */
		samsung,acl_map_table_revA =  <
			2	2		3	2		4	2		5	2		6	2
			7	2		8	2		9	2		10	2		11	2
			12	2		13	2		14	2		15	2		16	2
			17	2		19	2		20	2		21	2		22	2
			24	2		25	2		27	2		29	2		30	2
			32	2		34	2		37	2		39	2		41	2
			44	2		47	2		50	2		53	2		56	2
			60	2		64	2		68	2		72	2		77	2
			82	2		87	2		93	2		98	2		105	2
			111	2		119	2		126	2		134	2		143	2
			152	2		162	2		172	2		183	2		195	2
			207	2		220	2		234	2		249	2		265	2
			282	2		300	2		316	2		333	2		360	2
		>;

		/*
		 * ************************************************************************************************************************
		 * ELVSS(ACL Off) command list and mappings
		 * ************************************************************************************************************************
		 */
		samsung,elvss_tx_cmds_revA = [
			29 01 00 00 00 00 03 b6 AC 0E /* 0 */
			29 01 00 00 00 00 03 b6 AC 10 /* 1 */
			29 01 00 00 00 00 03 b6 AC 12 /* 2 */
			29 01 00 00 00 00 03 b6 AC 15 /* 3 */
			29 01 00 00 00 00 03 b6 AC 17 /* 4 */
			29 01 00 00 00 00 03 b6 AC 18 /* 5 */
			29 01 00 00 00 00 03 b6 BC 17 /* 6 */
			29 01 00 00 00 00 03 b6 BC 16 /* 7 */
			29 01 00 00 00 00 03 b6 BC 15 /* 8 */
			29 01 00 00 00 00 03 b6 BC 14 /* 9 */
			29 01 00 00 00 00 03 b6 BC 13 /* 10 */
			29 01 00 00 00 00 03 b6 BC 12 /* 11 */
			29 01 00 00 00 00 03 b6 BC 11 /* 12 */
			29 01 00 00 00 00 03 b6 BC 10 /* 13 */
			29 01 00 00 00 00 03 b6 BC 0F /* 14 */
			29 01 00 00 00 00 03 b6 BC 0E /* 15 */
			29 01 00 00 00 00 03 b6 BC 0D /* 16 */
			29 01 00 00 00 00 03 b6 BC 0C /* 17 */
			29 01 00 00 00 00 03 b6 BC 0B /* 18 */
			29 01 00 00 00 00 03 b6 BC 0A /* 19 */
		];

		/*
		 * ************************************************************************************************************************
		 * SMART ACL(ACL On) ELVSS command list and mappings
		 * ************************************************************************************************************************
		 */
		samsung,smart_acl_elvss_tx_cmds_revA = [
			29 01 00 00 00 00 03 b6 AC 0E /* 0 */
			29 01 00 00 00 00 03 b6 AC 10 /* 1 */
			29 01 00 00 00 00 03 b6 AC 12 /* 2 */
			29 01 00 00 00 00 03 b6 AC 15 /* 3 */
			29 01 00 00 00 00 03 b6 AC 17 /* 4 */
			29 01 00 00 00 00 03 b6 AC 18 /* 5 */
			29 01 00 00 00 00 03 b6 BC 17 /* 6 */
			29 01 00 00 00 00 03 b6 BC 16 /* 7 */
			29 01 00 00 00 00 03 b6 BC 15 /* 8 */
			29 01 00 00 00 00 03 b6 BC 14 /* 9 */
			29 01 00 00 00 00 03 b6 BC 13 /* 10 */
			29 01 00 00 00 00 03 b6 BC 12 /* 11 */
			29 01 00 00 00 00 03 b6 BC 11 /* 12 */
			29 01 00 00 00 00 03 b6 BC 10 /* 13 */
			29 01 00 00 00 00 03 b6 BC 0F /* 14 */
			29 01 00 00 00 00 03 b6 BC 0E /* 15 */
			29 01 00 00 00 00 03 b6 BC 0D /* 16 */
			29 01 00 00 00 00 03 b6 BC 0C /* 17 */
			29 01 00 00 00 00 03 b6 BC 0B /* 18 */
			29 01 00 00 00 00 03 b6 BC 0A /* 19 */
		];

		/* bl_level, Index in elvss command list */
		samsung,smart_acl_elvss_map_table_revA = <
			2	0		3	0		4	0		5	0		6	0
			7	0		8	0		9	0		10	0		11	0
			12	0		13	0		14	0		15	0		16	1
			17	2		19	3		20	5		21	5		22	5
			24	5		25	5		27	5		29	5		30	5
			32	5		34	5		37	4		39	4		41	6
			44	6		47	6		50	6		53	6		56	6
			60	6		64	6		68	6		72	6		77	7
			82	7		87	7		93	8		98	8		105	8
			111	9		119	9		126	10		134	10		143	11
			152	11		162	12		172	13		183	13		195	13
			207	13		220	14		234	14		249	15		265	15
			282	16		300	17		316	18		333	18		360	19
		>;

		/*
		 * ************************************************************************************************************************
		 * SMART VINT set command list and mappings
		 * ************************************************************************************************************************
		 */
		samsung,vint_tx_cmds_revA = [
			29 01 00 00 00 00 03 F4 7B 15 /* 0 */
			29 01 00 00 00 00 03 F4 7B 16 /* 1 */
			29 01 00 00 00 00 03 F4 7B 17 /* 2 */
			29 01 00 00 00 00 03 F4 7B 18 /* 3 */
			29 01 00 00 00 00 03 F4 7B 19 /* 4 */
			29 01 00 00 00 00 03 F4 7B 1A /* 5 */
			29 01 00 00 00 00 03 F4 7B 1B /* 6 */
			29 01 00 00 00 00 03 F4 7B 1C /* 7 */
			29 01 00 00 00 00 03 F4 7B 1D /* 8 */
			29 01 00 00 00 00 03 F4 7B 1E /* 9 */
		];

		/* bl_level, Index in vint command list */
		samsung,vint_map_table_revA = <
			2	0		3	0		4	0		5	0		6	1
			7	2		8	3		9	4		10	5		11	6
			12	7		13	8		14	9		15	9		16	9
			17	9		19	9		20	9		21	9		22	9
			24	9		25	9		27	9		29	9		30	9
			32	9		34	9		37	9		39	9		41	9
			44	9		47	9		50	9		53	9		56	9
			60	9		64	9		68	9		72	9		77	9
			82	9		87	9		93	9		98	9		105	9
			111	9		119	9		126	9		134	9		143	9
			152	9		162	9		172	9		183	9		195	9
			207	9		220	9		234	9		249	9		265	9
			282	9		300	9		316	9		333	9		360	9
		>;


		/*
		 * ************************************************************************************************************************
		 * candela to index mappings
		 * ************************************************************************************************************************
		 */
		samsung,candela_map_table_revA = <
		/*<idx><PMSL range> <candella> *//*linear map*/
			0	0	1	2
			1	2	2	3
			2	3	3	4
			3	4	4	5
			4	5	5	6
			5	5	5	7
			6	6	6	8
			7	7	7	9
			8	8	8	10
			9	8	8	11
			10	9	9	12
			11	10	10	13
			12	10	10	14
			13	11	11	15
			14	12	12	16
			15	13	13	17
			16	14	14	19
			17	15	15	20
			18	16	16	21
			19	16	16	22
			20	17	17	24
			21	18	18	25
			22	19	19	27
			23	20	21	29
			24	22	23	30
			25	24	24	32
			26	25	26	34
			27	27	28	37
			28	29	29	39
			29	30	32	41
			30	33	34	44
			31	35	36	47
			32	37	38	50
			33	39	40	53
			34	41	43	56
			35	44	46	60
			36	47	49	64
			37	50	52	68
			38	53	56	72
			39	57	59	77
			40	60	63	82
			41	64	67	87
			42	68	71	93
			43	72	76	98
			44	77	80	105
			45	81	86	111
			46	87	91	119
			47	92	97	126
			48	98	104	134
			49	105	110	143
			50	111	118	152
			51	119	125	162
			52	126	133	172
			53	134	142	183	/* default brightness level*/
			54	143	150	195
			55	151	160	207
			56	161	170	220
			57	171	181	234
			58	182	193	249
			59	194	205	265
			60	206	218	282
			61	219	230	300
			62	231	242	316
			63	243	254	333
			64	255	255	360
		>;

		/*
		 * ************************************************************************************************************************
		 *   APLPM
		 * ************************************************************************************************************************
		 */
		samsung,alpm_on_tx_cmds_revA = [
			05 01 00 00 14 00 02 28 00	/* display off wait 20ms */
			29 01 00 00 00 00 03 F0 5A 5A	/* TEST KEY Enable */
			29 01 00 00 00 00 0A		/* Update Gamma */
				BB 01 00 00 00
				07 80 4D 4A 5B
			29 01 00 00 00 00 03 F0 A5 A5	/* TEST KEY Enable */
			/* image write for APLM mode */
			29 01 00 00 00 00 05 30 00 00 00 00	/* user set partial area */
			29 01 00 00 00 00 02 12 00		/* partial mode on */
			29 01 00 00 14 00 02 39 00		/* idel mode on wait 20ms */
/*			29 01 00 00 00 00 02 29 00*/		/* display on */
		];

		samsung,alpm_off_tx_cmds_revA = [
			05 01 00 00 14 00 02 28 00	/* display off wait 20ms */
			/* image write for normal mode */
			29 01 00 00 00 00 02 38 00	/* idel Mode off */
			29 01 00 00 00 00 02 13 00	/* normal mode on */

/*			29 01 00 00 00 00 02 29 00*/	/* display on */
		];
	};
};
