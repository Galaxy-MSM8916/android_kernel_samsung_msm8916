/* Copyright (c) 2013-14, Samsung Electronics Corporation. All rights reserved.
 *
 * This program is free software; you can redistribute it and/or modify
 * it under the terms of the GNU General Public License version 2 and
 * only version 2 as published by the Free Software Foundation.
 *
 * This program is distributed in the hope that it will be useful,
 * but WITHOUT ANY WARRANTY; without even the implied warranty of
 * MERCHANTABILITY or FITNESS FOR A PARTICULAR PURPOSE.  See the
 * GNU General Public License for more details.
 */

/*---------------------------------------------------------------------------
 * This file is autogenerated file using gcdb parser. Please do not edit it.
 * Update input XML file to add a new entry or update variable in this file
 * VERSION = "1.0"
 *---------------------------------------------------------------------------*/
&mdss_mdp {
	ss_dsi_panel_S6D7AA0X62_BV050HDM_HD: ss_dsi_panel_S6D7AA0X62_BV050HDM_HD {
		qcom,mdss-dsi-panel-name = "ss_dsi_panel_S6D7AA0X62_BV050HDM_HD";
		label = "ss_dsi_panel_S6D7AA0X62_BV050HDM_HD";
		qcom,mdss-dsi-panel-controller = <&mdss_dsi0>;
		qcom,mdss-dsi-panel-type = "dsi_video_mode";
		qcom,mdss-dsi-panel-destination = "display_1";
		qcom,cont-splash-enabled;
		qcom,mdss-dsi-panel-framerate = <60>;
		qcom,mdss-dsi-virtual-channel-id = <0>;
		qcom,mdss-dsi-stream = <0>;
		qcom,mdss-dsi-panel-width = <720>;
		qcom,mdss-dsi-panel-height = <1280>;
		qcom,mdss-pan-physical-width-dimension = <62>; /* <Width> real size of panel in mm */
		qcom,mdss-pan-physical-height-dimension = <106>; /*<Height> real size of panel in mm */
		qcom,mdss-dsi-lp11-init;
		qcom,mdss-dsi-init-delay-us = <100>;
		qcom,mdss-dsi-h-front-porch = <104>;//
		qcom,mdss-dsi-h-back-porch = <154>;//
		qcom,mdss-dsi-h-pulse-width = <42>;//
		qcom,mdss-dsi-h-sync-skew = <0>;
		qcom,mdss-dsi-v-back-porch = <12>;//
		qcom,mdss-dsi-v-front-porch = <16>;//
		qcom,mdss-dsi-v-pulse-width = <4>;//
		qcom,mdss-dsi-h-left-border = <0>;
		qcom,mdss-dsi-h-right-border = <0>;
		qcom,mdss-dsi-v-top-border = <0>;
		qcom,mdss-dsi-v-bottom-border = <0>;
		qcom,mdss-dsi-bpp = <24>;
		qcom,mdss-dsi-color-order = <0>;
		qcom,mdss-dsi-underflow-color = <0xff>;
		qcom,mdss-dsi-border-color = <0>;
		qcom,mdss-dsi-dma-trigger = "trigger_sw";
		qcom,mdss-dsi-mdp-trigger = "none";
		qcom,mdss-dsi-bl-min-level = <1>;
		qcom,mdss-dsi-bl-max-level = <255>;
		qcom,mdss-dsi-bl-pmic-control-type = "bl_ctrl_dcs";
		qcom,mdss-dsi-lane-0-state;
		qcom,mdss-dsi-lane-1-state;
		qcom,mdss-dsi-lane-2-state;
		qcom,mdss-dsi-lane-3-state;
		qcom,mdss-dsi-bllp-eof-power-mode;
		qcom,mdss-dsi-bllp-power-mode;
		qcom,mdss-dsi-traffic-mode = "burst_mode";
		qcom,mdss-dsi-force-clk-lane-hs;
		qcom,mdss-dsi-reset-sequence = <1 20>, <0 1>, <1 20>;
		qcom,mdss-dsi-h-sync-pulse = <0>;
/*		qcom,mdss-dsi-hfp-power-mode;*/
		qcom,mdss-dsi-hbp-power-mode;
/*		qcom,mdss-dsi-hsa-power-mode;*/
		qcom,mdss-dsi-panel-timings = [8B 1E 14 00 44 46 18 20 16 03 04 00];
		qcom,mdss-dsi-t-clk-pre = <0x1C>;
		qcom,mdss-dsi-t-clk-post = <0x04>;
		qcom,mdss-dsi-on-command = [
					/* Initializing  Sequence(1) */
					39 01 00 00 01 00 03 F0 5A 5A
					39 01 00 00 00 00 03 F1 5A 5A
					39 01 00 00 00 00 03 FC A5 A5
					/* OTP CTRL */
					39 01 00 00 00 00 03 D0 00 10

					/* Initializing  Sequence(2) */
					39 01 00 00 00 00 02 B1 12
					39 01 00 00 01 00 05 B2 14 22 2F 18
					39 01 00 00 01 00 02 B3 11
					39 01 00 00 01 00 0A BA 03 19 19 11 03 05 18 18 77
					39 01 00 00 01 00 04 BC 00 4E 0B
					39 01 00 00 01 00 04 C0 80 80 30
					39 01 00 00 01 00 02 C1 01	/* CABC(MIE) off & manual dimming off */
					39 01 00 00 01 00 02 C2 00
					39 01 00 00 01 00 04 C3 40 00 28
					39 01 00 00 01 00 06 E1 03 10 1C A0 10
					39 01 00 00 01 00 09 EE A5 00 98 00 A5 00 98 00
					39 01 00 00 01 00 06 F2 02 10 10 44 10
					39 01 00 00 01 00 0B F3 01 93 20 22 80 05 25 3C 26 00
					39 01 00 00 01 00 2E F4 02 02 10 26 10 02 03 03 03 10 16 03 00 0C 0C 03 04 05 13 1E 09 0A 05 05 01 04 02 61 74 75 72 83 80 80 00 00 01 01 28 04 03 28 01 D1 32
					39 01 00 00 01 00 1B F5 92 23 2D 5F BB 8B 55 0F 33 33 03 59 54 52 45 57 60 10 60 80 27 26 52 25 6F 1B
					39 01 00 00 00 00 21 F7 01 1B 08 0C 09 0D 01 01 01 04 06 01 01 00 00 1A 01 1B 0A 0E 0B 0F 01 01 01 05 07 01 01 00 00 1A
					39 01 00 00 00 00 07 F6 60 25 05 00 00 00
					39 01 00 00 00 00 06 FD 16 10 11 23 09
					39 01 00 00 00 00 07 FE 00 02 03 21 80 78
					39 01 00 00 00 00 12 EF 34 12 98 BA 10 80 24 80 80 80 00 00 00 44 A0 82 00
					39 01 00 00 00 00 0E CD 2E 2E 2E 2E 2E 2E 2E 2E 2E 2E 2E 2E 2E
					39 01 00 00 00 00 0E CE 00 00 00 00 00 00 00 00 00 00 00 00 00
					39 01 00 00 00 00 02 51 00	/* change default brightness to 0 */
					39 01 00 00 00 00 02 53 24	/* CABC(MIE) off & manual dimming off */
					39 01 00 00 00 00 02 55 00	/* CABC(MIE) off & manual dimming off */

					/* Gamma Setting Sequence(3)*/
			39 01 00 00 00 00 12 FA 08 3F 0A 0C 00 02 06 03 04 0C 11 16 19 1A 1E 25 2F/* Positive Gamma *//*	2.4	*/
			39 01 00 00 00 00 12 FB 08 3F 0A 0C 00 01 05 03 03 0B 11 16 18 1A 1E 25 2E/* Negative Gamma */
/*	39 01 00 00 00 00 12 FA 08 3F 0D 11 06 0A 0E 0D 0E 15 19 18 19 1A 1B 1F 28*//* Positive Gamma *//*	2.2	*/
/*	39 01 00 00 00 00 12 FB 08 3F 0C 11 05 0A 0E 0C 0D 15 18 18 19 19 1A 1E 27*//* Negative Gamma */
/*	39 01 00 00 00 00 12 FA 08 3F 0E 13 09 0E 13 12 13 1B 1F 24 25 27 2A 2B 32*//* Positive Gamma *//*	2.6	*/
/*	39 01 00 00 00 00 12 FB 08 3F 0D 13 09 0E 13 12 13 1A 1F 24 25 26 29 1A 31*//* Negative Gamma */
/*	39 01 00 00 00 00 12 FA 08 3F 0E 15 0B 10 16 15 16 1E 23 29 2A 2C 2E 30 36*//* Positive Gamma *//*	2.8	*/
/*	39 01 00 00 00 00 12 FB 08 3F 0E 14 0B 10 15 14 16 1D 23 29 2A 2B 2E 30 35*//* Negative Gamma */

					/* Initializing Sequence(1-1) */
					39 01 00 00 01 00 03 F0 A5 A5
					39 01 00 00 00 00 03 F1 A5 A5
					39 01 00 00 00 00 03 FC 5A 5A

					/* Display on Sequence(4) */
					05 01 00 00 78 00 02 11 00	/* Sleep Out & 120ms(0x78) Delay */
					05 01 00 00 05 00 02 29 00	/* Display On & 5ms(0x05) Delay */
					05 01 00 00 05 00 02 29 00	/* Display On & 5ms(0x05) Delay */
					05 01 00 00 05 00 02 29 00	/* Display On & 5ms(0x05) Delay */
					05 01 00 00 05 00 02 29 00	/* Display On & 5ms(0x05) Delay */
					];
		qcom,mdss-dsi-on-command-state = "dsi_lp_mode";
		qcom,mdss-dsi-off-command-state = "dsi_hs_mode";
		qcom,mdss-dsi-off-command = [
					05 01 00 00 32 00 02 28 00	/* wait 50ms(0x32) */
					05 01 00 00 96 00 02 10 00	/* wait 150ms(0x96) */
					];
		samsung,mdss_check_panel_status_cmds_revA = [06 01 00 00 00 00 01 0A 01 00];	
		samsung,mdss-check-panel-status-result = <0x9C>;		
		samsung,mdss-sleep-out-command-enable;
		samsung,mdss_sleep_out_cmds_revA = [
					05 01 00 00 78 00 02 11 00	/* Sleep Out & 120ms(0x78) Delay */
					05 01 00 00 05 00 02 29 00	/* Display On & 5ms(0x05) Delay */
					05 01 00 00 05 00 02 29 00	/* Display On & 5ms(0x05) Delay */
					05 01 00 00 05 00 02 29 00	/* Display On & 5ms(0x05) Delay */
					05 01 00 00 05 00 02 29 00	/* Display On & 5ms(0x05) Delay */
			];
		samsung,mdss-dsi-bl-scale-low-level = <8>;
		samsung,mdss-dsi-bl-scale-dim-level = <8>;
		samsung,mdss-dsi-bl-scale-default-level = <89>;
		samsung,mdss-dsi-bl-scale-max-level = <188>;
		samsung,mdss-dsi-bl-pms-low-level = <7>;
		samsung,mdss-dsi-bl-pms-dim-level = <7>;
		samsung,mdss-dsi-bl-pms-default-level = <158>;
		samsung,mdss-dsi-bl-pms-max-level = <255>;
/*
 * ************************************************************************************************************************************
 *
 *
 *			Below  parameters are samsung dependent thigs
 *
 *
 * ************************************************************************************************************************************
 */
		samsung,mdnie-tuning-enable-tft;
		samsung,lcd-display-format-bgr;
		samsung,level2_key_enable_tx_cmds_revA = [
			39 01 00 00 00 00 03 F0 5A 5A
		];
		samsung,level2_key_disable_tx_cmds_revA = [
			39 01 00 00 00 00 03 F0 A5 A5
		];
		samsung,packet_size_tx_cmds_revA = [
			37 01 00 00 00 00 02 07 00
		];
		/*
		 * First parameters can be changed
		 * by function of samsung_nv_read()
		 * because of that means offset of
		 * read position
		 */
		samsung,reg_read_pos_tx_cmds_revA = [
			15 01 00 00 00 00 02 B0 00
		];
		samsung,manufacture_id0_rx_cmds_revA = [06 01 00 00 00 00 01 da 03 00];
		samsung,manufacture_id1_rx_cmds_revA = [06 01 00 00 00 00 01 db 03 00];
		samsung,manufacture_id2_rx_cmds_revA = [06 01 00 00 00 00 01 dc 03 00];
/*
		* Command sets for CABC control
*/
		samsung,panel-vendor = "BOE";
		samsung,tft_pwm_tx_cmds_revA=[
			39 01 00 00 00 00 02 51 FF/*First command should be PWM duty change command*/
		];
		samsung,cabc_on_tx_cmds_revA = [
			39 01 00 00 00 00 02 55 01
		];
		samsung,cabc_off_tx_cmds_revA = [
			39 01 00 00 00 00 02 55 00
		];
		/*
		* ************************************************************************************************************************
		* Scaled level to index mappings
		* ************************************************************************************************************************
		*/
	samsung,scaled_level_map_table_revA = <
		/*<idx>	  <from>  <till> <scaled_level> */
			0		0		0		0
			1		1		7		2
			2		8		11		4
			3		12		14		6
			4		15		17		8
			5		18		19		10
			6		20		22		12
			7		23		24		14
			8		25		27		16
			9		28		29		18
			10		30		32		19
			11		33		34		20
			12		35		37		21
			13		38		39		22
			14		40		42		24
			15		43		44		25
			16		45		47		26
			17		48		49		27
			18		50		52		28
			19		53		54		29
			20		55		57		30
			21		58		59		31
			22		60		62		32
			23		63		64		33
			24		65		67		34
			25		68		70		35
			26		71		72		36
			27		73		75		37
			28		76		77		38
			29		78		80		39
			30		81		82		40
			31		83		85		41
			32		86		87		42
			33		88		90		43
			34		91		92		44
			35		93		95		45
			36		96		97		46
			37		98		100		48
			38		101		102		50
			39		103		105		52
			40		106		107		54
			41		108		110		56
			42		111		112		58
			43		113		115		60
			44		116		117		62
			45		118		120		64
			46		121		122		66
			47		123		125		68
			48		126		127		70
			49		128		130		72
			50		131		133		74
			51		134		135		76
			52		136		138		78
			53		139		140		80
			54		141		143		82
			55		144		145		84
			56		146		148		86
			57		149		150		88
			58		151		153		90
			59		154		155		92
			60		156		158		94
			61		159		160		96
			62		161		163		98
			63		164		165		100
			64		166		168		103
			65		169		170		106
			66		171		173		109
			67		174		175		112
			68		176		178		115
			69		179		180		118
			70		181		183		121
			71		184		185		124
			72		186		188		127
			72		189		190		130
			74		191		193		133
			75		194		196		137
			76		197		198		141
			77		199		201		145
			78		202		203		149
			79		204		206		153
			80		207		208		157
			81		209		211		161
			82		212		213		165
			83		214		216		169
			84		217		218		173
			85		219		221		177
			86		222		223		181
			87		224		226		185
			88		227		228		189
			89		229		231		193
			90		232		233		197
			91		234		236		201
			92		237		238		205
			93		239		241		209
			94		242		243		213
			95		244		246		217
			96		247		248		221
			97		249		251		225
			98		252		253		229
			99		254		255		233
		>;
	};
};

