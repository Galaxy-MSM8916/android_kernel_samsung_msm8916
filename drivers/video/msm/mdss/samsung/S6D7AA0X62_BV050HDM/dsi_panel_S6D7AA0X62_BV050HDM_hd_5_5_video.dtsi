/* Copyright (c) 2013-14, Samsung Electronics Corporation. All rights reserved.
 *
 * This program is free software; you can redistribute it and/or modify
 * it under the terms of the GNU General Public License version 2 and
 * only version 2 as published by the Free Software Foundation.
 *
 * This program is distributed in the hope that it will be useful,
 * but WITHOUT ANY WARRANTY; without even the implied warranty of
 * MERCHANTABILITY or FITNESS FOR A PARTICULAR PURPOSE.  See the
 * GNU General Public License for more details.
 */

/*---------------------------------------------------------------------------
 * This file is autogenerated file using gcdb parser. Please do not edit it.
 * Update input XML file to add a new entry or update variable in this file
 * VERSION = "1.0"
 *---------------------------------------------------------------------------*/
&mdss_mdp {
	ss_dsi_panel_S6D7AA0X62_BV050HDM_HD: ss_dsi_panel_S6D7AA0X62_BV050HDM_HD {
		qcom,mdss-dsi-panel-name = "ss_dsi_panel_S6D7AA0X62_BV050HDM_HD";
		label = "ss_dsi_panel_S6D7AA0X62_BV050HDM_HD";
		qcom,mdss-dsi-panel-controller = <&mdss_dsi0>;
		qcom,mdss-dsi-panel-type = "dsi_video_mode";
		qcom,mdss-dsi-panel-destination = "display_1";
		qcom,cont-splash-enabled;
		qcom,mdss-dsi-panel-framerate = <60>;
		qcom,mdss-dsi-virtual-channel-id = <0>;
		qcom,mdss-dsi-stream = <0>;
		qcom,mdss-dsi-panel-width = <720>;
		qcom,mdss-dsi-panel-height = <1280>;
		qcom,mdss-pan-physical-width-dimension = <68>; /* <Width> real size of panel in mm */
		qcom,mdss-pan-physical-height-dimension = <121>; /*<Height> real size of panel in mm */
		qcom,mdss-dsi-lp11-init;
		qcom,mdss-dsi-init-delay-us = <100>;
		qcom,mdss-dsi-h-front-porch = <104>;
		qcom,mdss-dsi-h-back-porch = <154>;
		qcom,mdss-dsi-h-pulse-width = <42>;
		qcom,mdss-dsi-h-sync-skew = <0>;
		qcom,mdss-dsi-v-back-porch = <12>;
		qcom,mdss-dsi-v-front-porch = <16>;
		qcom,mdss-dsi-v-pulse-width = <4>;
		qcom,mdss-dsi-panel-clockrate = <481000000>;
		qcom,mdss-dsi-h-left-border = <0>;
		qcom,mdss-dsi-h-right-border = <0>;
		qcom,mdss-dsi-v-top-border = <0>;
		qcom,mdss-dsi-v-bottom-border = <0>;
		qcom,mdss-dsi-bpp = <24>;
		qcom,mdss-dsi-color-order = <0>;
		qcom,mdss-dsi-underflow-color = <0xff>;
		qcom,mdss-dsi-border-color = <0>;
		qcom,mdss-dsi-dma-trigger = "trigger_sw";
		qcom,mdss-dsi-mdp-trigger = "none";
		qcom,mdss-dsi-bl-min-level = <1>;
		qcom,mdss-dsi-bl-max-level = <306>;
		qcom,mdss-brightness-max-level = <306>;
		qcom,mdss-dsi-bl-pmic-control-type = "bl_ctrl_dcs";
		qcom,mdss-dsi-lane-0-state;
		qcom,mdss-dsi-lane-1-state;
		qcom,mdss-dsi-lane-2-state;
		qcom,mdss-dsi-lane-3-state;
		qcom,mdss-dsi-bllp-eof-power-mode;
		qcom,mdss-dsi-bllp-power-mode;
		qcom,mdss-dsi-traffic-mode = "burst_mode";
		qcom,mdss-dsi-force-clk-lane-hs;
		qcom,mdss-dsi-reset-sequence = <1 20>, <0 1>, <1 20>;
		qcom,mdss-dsi-h-sync-pulse = <0>;
/*		qcom,mdss-dsi-hfp-power-mode;*/
		qcom,mdss-dsi-hbp-power-mode;
/*		qcom,mdss-dsi-hsa-power-mode;*/

		/*			
			Full Rate Bitclk	481.77
			escclk	19.2
			UI	2.084291498
			Tlpx	49.49333333

			T_CLK_PREPARE	38		45.73804574
			T_CLK_ZERO		254.2619543	291.0602911
			T_CLK_TRAIL		60		66.52806653
			T_HS_PREPARE		48.31600832	58.21205821
			T_HS_ZERO		107.5779626	149.7975709
			T_HS_TRAIL		68.31600832	70.68607069
			T_HS_RQST				54.05405405
			T_HS_EXIT		100		141.7004049
			T_TA_GO		208.3333333	208.3333333
			T_TA_SURE		52.08333333	104.1666667
			T_TA_GET		260.4166667	260.4166667
			TEOT of data lane			80.68607069
			TEOT of clock lane			76.52806653
			T_CLK_POST		168.1081081	278.5862786
			T_CLK_PRE		16.63201663	93.4468122
		*/
		qcom,mdss-dsi-panel-timings = [8B 1E 14 00 44 46 18 20 16 03 04 00];
		qcom,mdss-dsi-t-clk-pre = <0x1C>;
		qcom,mdss-dsi-t-clk-post = <0x04>;
		qcom,mdss-dsi-on-command = [
					39 01 00 00 00 00 03 F0 5A 5A
					39 01 00 00 00 00 03 F1 5A 5A
					39 01 00 00 00 00 03 FC A5 A5
					39 01 00 00 00 00 03 D0 00 10

					39 01 00 00 00 00 02 B1 12
					39 01 00 00 00 00 05 B2 14 22 2F 18
					39 01 00 00 00 00 02 B3 11
					39 01 00 00 00 00 0A BA 03 19 19 11 03 05 18 18 77
					39 01 00 00 00 00 04 BC 00 4E 0B
					39 01 00 00 00 00 04 C0 80 80 30
					39 01 00 00 01 00 02 C1 03
					39 01 00 00 0A 00 02 C2 00
					39 01 00 00 00 00 04 C3 40 00 28
					39 01 00 00 00 00 09 EE A8 00 95 00 A8 00 95 00
					39 01 00 00 00 00 06 F2 02 10 10 C4 80 /* VBP 16 VFP 16 HBP 196 HFP 128 */
					39 01 00 00 00 00 0B F3 01 93 20 22 80 05 25 3C 26 00
					39 01 00 00 00 00 21 F7 01 1B 08 0C 09 0D 01 01 01 04 06
					01 01 00 00 1A 01 1B 0A 0E 0B 0F 01 01 01 05
								07 01 01 00 00 1A
					39 01 00 00 00 00 12 EF 34 12 98 BA 10 80 24 80 80 80 00
								00 00 44 A0 82 00
					39 01 00 00 00 00 07 F6 60 25 05 00 00 03
					39 01 00 00 00 00 0E CD 2E 2E 2E 2E 2E 2E 2E 2E 2E 2E 2E 2E 2E
					39 01 00 00 00 00 0E CE 00 00 00 00 00 00 00 00 00 00 00 00 00
					39 01 00 00 00 00 02 53 2C
					39 01 00 00 00 00 02 55 00

					39 01 00 00 00 00 12 FA 01 3F 09 0C 00 01 06 04 04 0C 10
								15 16 18 1C 20 2A
					39 01 00 00 00 00 12 FB 01 3F 09 0C 00 01 06 04 04 0C 10
								15 16 18 1C 20 2A

					39 01 00 00 00 00 03 F0 A5 A5
					39 01 00 00 00 00 03 F1 A5 A5
					39 01 00 00 00 00 03 FC 5A 5A

					05 01 00 00 78 00 02 11 00
					05 01 00 00 14 00 02 29 00
					];
		qcom,mdss-dsi-on-command-state = "dsi_lp_mode";
		qcom,mdss-dsi-off-command-state = "dsi_hs_mode";
		qcom,mdss-dsi-off-command = [
					05 01 00 00 0A 00 02 28 00	/* wait 10ms(0x0A) */
					05 01 00 00 78 00 02 10 00	/* wait 120ms(0x78) */
					];
/*
 * ************************************************************************************************************************************
 *
 *
 *			Below  parameters are samsung dependent thigs
 *
 *
 * ************************************************************************************************************************************
 */
 		samsung,tft-common-support;
		samsung,mdnie-tuning-enable-tft;

		samsung,level2_key_enable_tx_cmds_revA = [
			39 01 00 00 00 00 03 F0 5A 5A
		];
		samsung,level2_key_disable_tx_cmds_revA = [
			39 01 00 00 00 00 03 F0 A5 A5
		];
		samsung,packet_size_tx_cmds_revA = [
			37 01 00 00 00 00 02 07 00
		];
		/*
		 * First parameters can be changed
		 * by function of samsung_nv_read()
		 * because of that means offset of
		 * read position
		 */
		samsung,reg_read_pos_tx_cmds_revA = [
			15 01 00 00 00 00 02 B0 00
		];
		samsung,mtp_read_sysfs_rx_cmds_revA = [ 06 01 00 00 00 00 01 01 01 01];
		samsung,manufacture_id0_rx_cmds_revA = [06 01 00 00 00 00 01 da 03 00];
		samsung,manufacture_id1_rx_cmds_revA = [06 01 00 00 00 00 01 db 03 00];
		samsung,manufacture_id2_rx_cmds_revA = [06 01 00 00 00 00 01 dc 03 00];
/*
		* Command sets for CABC control
*/
		samsung,panel-vendor = "BOE";
		samsung,tft_pwm_tx_cmds_revA=[
			39 01 00 00 00 00 02 51 FF/*First command should be PWM duty change command*/
		];
		/*
		* ************************************************************************************************************************
		* Scaled level to index mappings
		* ************************************************************************************************************************
		*/
	samsung,scaled_level_map_table_revA = <
		/*<idx>	  <from>  <till> <scaled_level> */
			0		0		0		0
			1		1		7		2
			2		8		11		5
			3		12		14		9
			4		15		17		12
			5		18		19		13
			6		20		22		14
			7		23		24		15
			8		25		27		16
			9		28		29		17
			10		30		32		18
			11		33		34		19
			12		35		37		20
			13		38		39		21
			14		40		42		22
			15		43		44		23
			16		45		47		24
			17		48		49		25
			18		50		52		26
			19		53		54		27
			20		55		57		28
			21		58		59		29
			22		60		62		30
			23		63		64		31
			24		65		67		32
			25		68		70		34
			26		71		72		36
			27		73		75		38
			28		76		77		40
			29		78		80		42
			30		81		82		44
			31		83		85		46
			32		86		87		48
			33		88		90		50
			34		91		92		52
			35		93		95		54
			36		96		97		56
			37		98		100		58
			38		101		102		60
			39		103		105		62
			40		106		107		64
			41		108		110		66
			42		111		112		68
			43		113		115		70
			44		116		117		73
			45		118		120		76
			46		121		122		79
			47		123		125		82
			48		126		127		85
			49		128		130		88
			50		131		133		91
			51		134		135		94
			52		136		138		95
			53		139		140		96
			54		141		143		97
			55		144		145		98
			56		146		148		99
			57		149		150		100
			58		151		153		101
			59		154		155		102
			60		156		158		104
			61		159		160		106
			62		161		163		108
			63		164		165		110
			64		166		168		112
			65		169		170		114
			66		171		173		116
			67		174		175		118
			68		176		178		120
			69		179		180		122
			70		181		183		124
			71		184		185		126
			72		186		188		128
			72		189		190		130
			74		191		193		132
			75		194		196		134
			76		197		198		147
			77		199		201		140
			78		202		203		143
			79		204		206		146
			80		207		208		149
			81		209		211		152
			82		212		213		155
			83		214		216		158
			84		217		218		161
			85		219		221		164
			86		222		223		167
			87		224		226		170
			88		227		228		173
			89		229		231		176
			90		232		233		179
			91		234		236		182
			92		237		238		185
			93		239		241		188
			94		242		243		191
			95		244		246		194
			96		247		248		197
			97		249		251		201
			98		252		253		203
			99		254		255		205
		>;
		samsung,hbm_candela_map_table_revA = <
			0	0	255	255	0
			0	256	306	306	6
		>;
	};
};
&soc {
	mdss_dsi0: qcom,mdss_dsi@1a98000 {
		qcom,dsi-pref-prim-pan = <&ss_dsi_panel_S6D7AA0X62_BV050HDM_HD>;
	};
};