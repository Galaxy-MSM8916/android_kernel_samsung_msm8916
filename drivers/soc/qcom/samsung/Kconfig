## drivers/soc/qcom/samsung/Kconfig
```kconfig
# When adding new entries keep the list in alphabetical order

comment "Samsung Debugging Feature"
menuconfig SEC_DEBUG
	bool "Samsung TN Ramdump Feature"
	default n
	help
	  Samsung TN Ramdump Feature.
	  Enables collection of ram dump.
	  Enables task history, debug level etc.
	  This feature is enabled in defconfig.
if SEC_DEBUG

config SEC_DEBUG_PRINTK_NOCACHE
	bool "Samsung non-cached kernel printk"
	default y
	help
	  Samsung non-cached kernel printk
	  This ensures that printk is never stale
	  which is a good feature when debugging without
	  hardware debuggers. If unsure, keep it turned on.
config SEC_DEBUG_SCHED_LOG
	bool "Samsung Scheduler Logging Feature"
	default n
	help
	  Samsung Scheduler Logging Feature for Debug use.
	  Enables task scheduling history.
	  Enables IRQ scheduling history.
	  This feature is enabled in defconfig.
config SEC_DEBUG_SEMAPHORE_LOG
	bool "Samsung Semaphore Logging Feature"
	default n
	help
	  Samsung Semaphore Logging Feature for Debug use.
	  Enables semaphore debugging statistics.
	  Enables logging.
	  This feature is enabled in defconfig.

config SEC_FILE_LEAK_DEBUG
	bool "Samsung File Leak Debugging Feature"
	default n
	help
	  Samsung File Leak Debugging Feature for Debug use.
	  Enables the forced panic mode when EMFILE Eror occurs.
	  This feature is enabled in defconfig.

config SEC_LOGGER_BUFFER_EXPANSION
	bool "Samsung Logger Buffer Expansion Feature"
	default n
	help
	  This is used to expand buffers of logger.
	  This feature is enabled in defconfig.

config SEC_LOGGER_BUFFER_EXPANSION_SIZE
	int "Samsung Logger Buffer Expansion Size(MB)"
	depends on SEC_LOGGER_BUFFER_EXPANSION
	default 2
	help
	  This is used to expand main buffer of logger(MB).

endif

config SEC_FORKHANG_DEBUG
	bool "Debug Feature for Newly Forked task getting HANg on mmap_sem down_read()"
	default n
	help
	  mmap_sem writer lock logging for ram dump analysis.
	  Collects kernel debug log.
	  Log is collected in the no-cache area.
	  This feature is enabled in defconfig.

config SEC_DEBUG_USER
	bool "Panic on Userspace fault"
	default y
	help
	  Panic on Userspace fault
	  This feature enables collection of ram dump,
	  on user fault.
	  Enabled native code debugging.
config SEC_DEBUG_IRQ_EXIT_LOG
	bool "Temporary Logging for IRQ delay"
	default n
	help
	  Verbose Logging for IRQ delay.
	  Helps indetification of irq enter and exit.
	  This is to track the current state of IRQ execution.
	  This is enabled in defconfig file.
config SEC_DEBUG_MSG_LOG
	bool "Message Log for ram dump debug"
	default n
	help
	  Verbose Logging for ram dump analysis.
	  Collects kernel debug log.
	  Log is collected in the no-cache area.
	  This feature is enabled in defconfig.
config SEC_DEBUG_SUBSYS
	bool "Debug subsystems"
	default n
	help
	  Subsystems debug feature.
	  When enabled provides kernel logs, modem logs, RPM registers,
	  Schedule and IRQ logs at the time of crash along with the
	  reason for crash, which can be extracted as a html in RAM dump mode.
config SEC_DEBUG_DCVS_LOG
	bool "Temporary Logging for DCVS"
	default n
	help
	  DCVS Logging Feature for Debug use.
	  The ACPU clock rate changes will be logged as a part
	  of secdbg_log structure along with the CPU time stamp.
	  The previous frequency and the new frequency for both the CPU along
	  with the CPU time stamp will be logged.
config SEC_DEBUG_FUELGAUGE_LOG
	bool "Temporary Logging for FuelGauge"
	default n
	help
	 FuelGauge Logging Feature for Debug use.
	 The FuelGauge values are logged as a part
	 of secdbg_log structure along with the CPU time stamp.
	 The voltage and soc values along with the CPU time will be logged.
config SEC_DEBUG_LOW_LOG
	bool "Kernel Message Logging for Debug Level Low"
	default n
	help
	 Kernel Message Logging Feature for Debug use.
	 The Kernel Messages are logged using file I/O
	 when an exception occurs, when the debug level is low.
	 The file I/O is added in kernel driver level
	 so that kernel messages are logged on next reboot.
config SEC_DEBUG_MDM_FILE_INFO
	bool "MDM filename and line number in UPLOAD mode"
	default n
	help
	 This feature enables display of MDM info in upload mode.
	 This feature enabled SSR in debug level low.
	 Collects MDM ram dump and then calls panic.
	 UPLOAD mode has MDM dump info to show it on LCD.
config SEC_DEBUG_DOUBLE_FREE
	bool "Enable double free detection"
	default n
	help
	 Detect erraneous codes that frees a kmalloced node
	 twice. When kfree(p) is called, p is not freed right away.
	 Instead, it is pushed into a circular buffer. What it frees
	 is the oldest pointer that was pushed into the buffer.
	 If someone tries to free the same pointer p, *p
	 is read and checked for a magic code that is written
	 when it was first freed. If it matches, the whole
	 circular buffer is searched. Panic is be called when
	 the match is found.

config SEC_LOG_LAST_KMSG
	bool "Enable /proc/last_kmsg support: if EMBEDDED"
	default n
	help
	  This option enables /proc/last_kmsg support.
config SEC_DEBUG_NOCACHE_LOG_IN_LEVEL_LOW
	bool "Enable nocache logging in debug level LOW"
	default n
	help
	  Enable nocache logging in debug level LOW.

config SEC_MONITOR_BATTERY_REMOVAL
	bool "Enable monitering whether normal power sequence or not"
	default n
	help
	  Enable monitering Power off & battery removal.

config SEC_BSP
	bool "Enable /proc/boot_stat support"
	default n
	help
	  This option enables /proc/boot_stat support.

config SEC_THERMISTOR
	bool "Use external thermistor near AP for checking temprature"
	default n
	help
	  Use thermistor driver for checking temperature near AP chip.

config SEC_USE_FLASH_THERMISTOR
	depends on SEC_THERMISTOR
	bool "Use external thermistor near flash for checking temprature"
	default n
	help
	  Use thermistor driver for checking temperature near flash led.
```

## drivers/staging/android/Kconfig
```kconfig
menu "Android"

config ANDROID
	bool "Android Drivers"
	default N
	---help---
	  Enable support for various drivers needed on the Android platform

if ANDROID

config ANDROID_BINDER_IPC
	bool "Android Binder IPC Driver"
	default n
	---help---
	  Binder is used in Android for both communication between processes,
	  and remote method invocation.

	  This means one Android process can call a method/routine in another
	  Android process, using Binder to identify, invoke and pass arguments
	  between said processes.

config ANDROID_BINDER_IPC_32BIT
	bool "Use old 32-bit binder api"
	default y if !64BIT
	---help---
	  Enable to support an old 32-bit Android user-space. Breaks the new
	  Android user-space.

config ASHMEM
	bool "Enable the Anonymous Shared Memory Subsystem"
	default n
	depends on SHMEM
	---help---
	  The ashmem subsystem is a new shared memory allocator, similar to
	  POSIX SHM but with different behavior and sporting a simpler
	  file-based API.

	  It is, in theory, a good memory allocator for low-memory devices,
	  because it can discard shared memory units when under memory pressure.

config ANDROID_LOGGER
	tristate "Android log driver"
	default n
	---help---
	  This adds support for system-wide logging using four log buffers.

	  These are:

	      1: main
	      2: events
	      3: radio
	      4: system

	  Log reading and writing is performed via normal Linux reads and
	  optimized writes. This optimization avoids logging having too
	  much overhead in the system.

config LOGCAT_SIZE
	int "Adjust android log buffer sizes"
	default 512
	depends on ANDROID_LOGGER
	help
	  Set logger buffer size. Enter a number greater than zero.
	  Any value less than 256 is recommended. Reduce value to save kernel static memory size.

config ANDROID_TIMED_OUTPUT
	bool "Timed output class driver"
	default y

config ANDROID_TIMED_GPIO
	tristate "Android timed gpio driver"
	depends on GPIOLIB && ANDROID_TIMED_OUTPUT
	default n

config ANDROID_LOW_MEMORY_KILLER
	bool "Android Low Memory Killer"
	default N
	---help---
	  Registers processes to be killed when memory is low

config ANDROID_LOW_MEMORY_KILLER_AUTODETECT_OOM_ADJ_VALUES
	bool "Android Low Memory Killer: detect oom_adj values"
	depends on ANDROID_LOW_MEMORY_KILLER
	default y
	---help---
	  Detect oom_adj values written to
	  /sys/module/lowmemorykiller/parameters/adj and convert them
	  to oom_score_adj values.

config SEC_OOM_KILLER
	bool "Android OOM Killer"
	default n
	help
	 klaatu@samsung
	 This enables 'Android-Style oom-killer'
	 The way to select victim by oom-killer provided by
	 linux kernel is totally different from android policy.
	 Hence, it makes more sense that we select the oom victim
	 as android does when LMK is invoked.

config SEC_DEBUG_LMK_MEMINFO
	bool "Show Meminfo when lmk invoked"
	default n
	help
	  Show memory information when lmk kills process

config SEC_DEBUG_LMK_COUNT_INFO
	bool "Record LMK execution count"
	default n
	help
	  Show LMK execution count information when lmk invoked

config ANDROID_INTF_ALARM_DEV
	bool "Android alarm driver"
	depends on RTC_CLASS
	default n
	---help---
	  Provides non-wakeup and rtc backed wakeup alarms based on rtc or
	  elapsed realtime, and a non-wakeup alarm on the monotonic clock.
	  Also exports the alarm interface to user-space.

config SYNC
	bool "Synchronization framework"
	default n
	select ANON_INODES
	help
	  This option enables the framework for synchronization between multiple
	  drivers.  Sync implementations can take advantage of hardware
	  synchronization built into devices like GPUs.

config SW_SYNC
	bool "Software synchronization objects"
	default n
	depends on SYNC
	help
	  A sync object driver that uses a 32bit counter to coordinate
	  syncrhronization.  Useful when there is no hardware primitive backing
	  the synchronization.

config SW_SYNC_USER
	bool "Userspace API for SW_SYNC"
	default n
	depends on SW_SYNC
	help
	  Provides a user space API to the sw sync object.
	  *WARNING* improper use of this can result in deadlocking kernel
	  drivers from userspace.

config ONESHOT_SYNC
	bool "One shot sync objects"
	depends on SYNC
	help
	  This sync driver provides a way to create sync objects that may
	  be signaled by userspace. Unlike other sync objects, the
	  sync objects created by this driver may be signaled in any order
	  without changing the state of other sync objects on the timeline.

config ONESHOT_SYNC_USER
	bool "Userspace API for ONESHOT_SYNC"
	depends on SYNC
	help
	  Provide a userspace API for creating oneshot sync objects.

config RUNTIME_COMPCACHE
	bool "Android rtcc v3"
	depends on ZRAM && ANDROID
	default n
	help
	  This option enables rtcc v3 for android

config KSWAPD_NOSWAP
	bool "Disable swap in kswapd"
	depends on RUNTIME_COMPCACHE
	default n
	help
	  This option controls swap action in kswapd

source "drivers/staging/android/ion/Kconfig"

source "drivers/staging/android/fiq_debugger/Kconfig"

endif # if ANDROID

endmenu
```

## drivers/usb/notify/Kconfig
```kconfig
#
# USB notify configuration
#

comment "USB Notify features"
config USB_HOST_NOTIFY
	boolean "USB Host notify Driver"
	depends on USB_NOTIFY_LAYER
	help
	  Android framework needs uevents for usb host operation.
	  Host notify Driver serves uevent format
	  that is used by usb host or otg.

config USB_NOTIFY_LAYER
	boolean "USB notify layer"
	depends on USB
	help
	  Added usb notify layer on gadget,host,otg drivers.
          The usb notify layer controls otg mode and vbus draw
          and vbus detect irq.

config USB_NOTIFIER
	boolean "USB notifier"
	depends on USB_NOTIFY_LAYER
	help
	  Added platform driver to call usb notify.
	  The usb_notifier.c can be fixed for each models.
```
