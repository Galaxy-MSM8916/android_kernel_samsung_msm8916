## arch/arm/configs/msm8916_sec_a3_eur_defconfig
```kconfig
CONFIG_SEC_A3_EUR_PROJECT=y
CONFIG_MACH_A3_EUR_OPEN=y

# SEC_GPIO
CONFIG_SEC_GPIO_SETTINGS=y

# HARD RESET
CONFIG_RESTART_REASON_SEC_PARAM=y

# MUIC
CONFIG_SM5502_MUIC=y
CONFIG_MUIC_SUPPORT_RUSTPROOF_INBATT=y
CONFIG_USBID_STANDARD_VER_01=y
CONFIG_MUIC_SUPPORT_CHARGING_CABLE=y

# HALL IC
CONFIG_SENSORS_HALL=y

# Vibrator
CONFIG_SS_VIBRATOR=y

# DUAL SIM / SINGLE SIM Detection
CONFIG_CHECK_SIMSLOT_COUNT=y
CONFIG_CHECK_SIMSLOT_COUNT_DT=y

# Power off Alarm
CONFIG_RTC_AUTO_PWRON=y
CONFIG_RTC_AUTO_PWRON_PARAM=y

# AUDIO
CONFIG_AUDIO_SPEAKER_OUT_NXP_AMP_ENABLE=y
CONFIG_AUDIO_QUAT_I2S_ENABLE=y

# SENSORS
CONFIG_SENSORS=y
CONFIG_SENSORS_CORE=y
CONFIG_SENSORS_USE_SYMLINK=y
CONFIG_SYSFS=y
CONFIG_SENSORS_CM36652=y
CONFIG_SENSORS_CM36652_LEDA_EN_GPIO=y

# BMC150
CONFIG_SENSORS_BMA2X2=y
CONFIG_SENSORS_BMM050=y
CONFIG_SENSORS_BMA2X2_ENABLE_INT1=y
CONFIG_SENSORS_ACCELEROMETER_2G=y

# DISPLAY
CONFIG_PANEL_S6E88A0_AMS452EF01_QHD=y

# INPUT (TSP, Touchkey)
CONFIG_TOUCHSCREEN_ZINITIX_BT541=y
CONFIG_KEYBOARD_ABOV_TOUCH_A3=y

# BATTERY
CONFIG_MFD_RT5033=y
CONFIG_BATTERY_SAMSUNG=y
CONFIG_BATTERY_SAMSUNG_DATA_FILE="a3_battery_data.h"
CONFIG_SAMSUNG_LPM_MODE=y
CONFIG_CHARGER_RT5033=y
CONFIG_FUELGAUGE_RT5033=y
CONFIG_REGULATOR_RT5033=y
CONFIG_MFD_RT5033_RESET_GPIO=y
CONFIG_MFD_RT5033_SLDO_VBUSDET=n
CONFIG_BATTERY_SWELLING=y

# NFC
CONFIG_NFC=y
CONFIG_SEC_NFC=y
CONFIG_SEC_NFC_I2C=y
CONFIG_SEC_NFC_USE_8916_BBCLK2=y
CONFIG_SEC_NFC_IF_I2C=y
CONFIG_SEC_NFC_PRODUCT_N5=y

# FLASH
CONFIG_FLASHLIGHT=y
CONFIG_RT_FLASH_LED=y
CONFIG_FLED_RT5033=y
CONFIG_FLED_RT5033_EXT_GPIO=y

# CAMERA
#CONFIG_MSM_OTP is not set
CONFIG_IMX219=y
CONFIG_S5K5E3YX=y

# Bluetooth
CONFIG_HID_SUPPORT=y
# CONFIG_BT_HCISMD is not set
# CONFIG_BT_HCIUART is not set
# CONFIG_BT_HCIUART_H4 is not set

# MMC
CONFIG_SEC_HYBRID_TRAY=y

# SSWAP
CONFIG_SWAP=y
CONFIG_FRONTSWAP=y
CONFIG_ZSMALLOC=y
CONFIG_ZSWAP=y
```

## arch/arm/configs/msm8916_sec_a5_chnctc_defconfig
```kconfig
CONFIG_SEC_A5_PROJECT=y
CONFIG_MACH_A5_CHN_CTC=y

# SEC_GPIO
CONFIG_SEC_GPIO_SETTINGS=y
# MUIC
CONFIG_SM5502_MUIC=y
CONFIG_MUIC_SUPPORT_RUSTPROOF_INBATT=y
CONFIG_USBID_STANDARD_VER_01=y
CONFIG_MUIC_SUPPORT_CHARGING_CABLE=y

# HALL IC
CONFIG_SENSORS_HALL=y

# Vibrator
CONFIG_SS_VIBRATOR=y

CONFIG_MFD_RT5033=y

CONFIG_MFD_RT5033_RESET_GPIO=y
CONFIG_MFD_RT5033_SLDO_VBUSDET=n
CONFIG_BATTERY_SAMSUNG=y
CONFIG_BATTERY_SAMSUNG_DATA_FILE="a5_battery_data.h"
CONFIG_SAMSUNG_LPM_MODE=y
CONFIG_CHARGER_RT5033=y
CONFIG_FUELGAUGE_RT5033=y
CONFIG_REGULATOR_RT5033=y
CONFIG_BATTERY_SWELLING=y

#SENSORS
CONFIG_SENSORS=y
CONFIG_SENSORS_CORE=y
CONFIG_SENSOR_USE_SYMLINK=y
CONFIG_SYSFS=y
CONFIG_INPUT=y
CONFIG_INPUT_GPIO=y
CONFIG_INPUT_POLLDEV=y
# CONFIG_INPUT_MPU6515 is not set
# CONFIG_INPUT_MPU6500_SELFTEST is not set
# CONFIG_INPUT_MPU6500_POLLING is not set
# CONFIG_SENSORS_HSCDTD008A is not set
CONFIG_SENSORS_TMD3782S=y
CONFIG_SENSORS_TMD3782S_VDD_LEDA=y
# BMC150
CONFIG_SENSORS_BMA2X2=y
CONFIG_SENSORS_BMM050=y
CONFIG_SENSORS_BMC150_VDD=y
CONFIG_SENSORS_BMA2X2_ENABLE_INT1=y
CONFIG_SENSORS_ACCELEROMETER_2G=y
#
#NFC
CONFIG_NFC=y
CONFIG_NFC_PN547=y
CONFIG_NFC_PN547_8916_USE_BBCLK2=y

#AUDIO
CONFIG_AUDIO_SPEAKER_OUT_NXP_AMP_ENABLE=y
CONFIG_RADIO_IRIS=y
CONFIG_RADIO_IRIS_TRANSPORT=m
#CONFIG_SAMSUNG_JACK_WATCH_DOG_RESET_WORK_AROUND=y
CONFIG_AUDIO_QUAT_I2S_ENABLE=y

#FLASH
CONFIG_FLASHLIGHT=y
CONFIG_RT_FLASH_LED=y
CONFIG_FLED_RT5033=y
CONFIG_FLED_RT5033_EXT_GPIO=y

#CAMERA
CONFIG_SEC_A5_COMMON_CAMERA=y
#CONFIG_MSM_OTP is not set
CONFIG_IMX135=y
CONFIG_S5K5E3YX=y

#Power off Alarm
CONFIG_RTC_AUTO_PWRON=y
CONFIG_RTC_AUTO_PWRON_PARAM=y

#optimize mmc block delay on resume
CONFIG_MMC_BLOCK_DEFERRED_RESUME=y

CONFIG_TRACE_MODEM_MEM_FAIL=y


# SSWAP
CONFIG_SWAP=y
CONFIG_FRONTSWAP=y
CONFIG_ZSMALLOC=y
CONFIG_ZSWAP=y
```

## arch/arm/configs/msm8916_sec_fortuna3g_eur_defconfig
```kconfig
CONFIG_SEC_FORTUNA_PROJECT=y
CONFIG_MACH_FORTUNA3G_EUR=y

# HARD RESET
CONFIG_RESTART_REASON_SEC_PARAM=y

# SS Pinctrl Driver
CONFIG_SEC_GPIO_SETTINGS=y

# MUIC
CONFIG_SM5502_MUIC=y
# CONFIG_MUIC_SM5502_SUPPORT_LANHUB_TA is not set
CONFIG_MUIC_SUPPORT_RUSTPROOF=y
CONFIG_USBID_STANDARD_VER_01=y

#Touch Screen
#CONFIG_TOUCHSCREEN_IST30XX=y
CONFIG_TOUCHSCREEN_ZINITIX_BT541=y

#LCD
#CONFIG_FB_MSM_MIPI_HX8389C_QHD_VIDEO_PANEL=y
CONFIG_PANEL_HX8389C_GH9607501A_QHD=y
CONFIG_PANEL_S6D78A0_GH9607501A_QHD=y
CONFIG_FB_MSM_MDSS_SAMSUNG=y

#CHARGING/BATTERY
CONFIG_MFD_RT5033=y
CONFIG_MFD_RT5033_RESET_GPIO=n
CONFIG_MFD_RT5033_SLDO_VBUSDET=y
CONFIG_BATTERY_SAMSUNG=y
CONFIG_BATTERY_SAMSUNG_DATA_FILE="fortuna_battery_data.h"
CONFIG_SAMSUNG_LPM_MODE=y
CONFIG_CHARGER_RT5033=y
CONFIG_FUELGAUGE_RT5033=y
CONFIG_REGULATOR_RT5033=y

# VIBRATOR
CONFIG_MSM_VIBRATOR=y

#SENSOR
CONFIG_SENSORS=y
CONFIG_SENSORS_CORE=y
CONFIG_SENSORS_K303C=y
CONFIG_SENSORS_GP2A002=y
CONFIG_SENSORS_GP2A_VDD=y

#FLASH
CONFIG_FLASHLIGHT=y
CONFIG_RT_FLASH_LED=y
CONFIG_FLED_RT5033=y
CONFIG_FLED_RT5033_EXT_GPIO=y

# CAMERA
CONFIG_IMX219=y
CONFIG_S5K5E3YX=y

#APC CPR QUOTIENT
CONFIG_APC_CPR_QUOT_BOOST=y

#optimize mmc block delay on resume
#CONFIG_MMC_BLOCK_DEFERRED_RESUME=y

# RTCC v3
CONFIG_SWAP=y
CONFIG_FRONTSWAP=y
CONFIG_ZSMALLOC=y
CONFIG_ZSWAP=y

# DUAL SIM / SINGLE SIM Detection
#CONFIG_CHECK_SIMSLOT_COUNT=y
#CONFIG_CHECK_SIMSLOT_COUNT_GPIO=1008
```

## arch/arm/configs/msm8916_sec_fortuna_chnzt_defconfig
```kconfig
CONFIG_SEC_FORTUNA_PROJECT=y
CONFIG_MACH_FORTUNA_CHN_ZT=y

# HARD RESET
CONFIG_RESTART_REASON_SEC_PARAM=y

# SS Pinctrl Driver
CONFIG_SEC_GPIO_SETTINGS=y

# MUIC
CONFIG_SM5502_MUIC=y
CONFIG_SM5504_MUIC=y
# CONFIG_MUIC_SM5502_SUPPORT_LANHUB_TA is not set
CONFIG_MUIC_SUPPORT_RUSTPROOF=y
CONFIG_USBID_STANDARD_VER_01=y

#Touch Screen
CONFIG_TOUCHSCREEN_IST30XX=y
CONFIG_TOUCHSCREEN_ZINITIX_BT541=y

#LCD
CONFIG_PANEL_HX8389C_GH9607501A_QHD=y
CONFIG_PANEL_S6D78A0_GH9607501A_QHD=y

# Charging/Battery
CONFIG_MFD_RT5033=y
CONFIG_MFD_RT5033_RESET_GPIO=n
CONFIG_MFD_RT5033_SLDO_VBUSDET=y
CONFIG_BATTERY_SAMSUNG=y
CONFIG_BATTERY_SAMSUNG_DATA_FILE="fortuna_battery_data.h"
CONFIG_SAMSUNG_LPM_MODE=y
CONFIG_CHARGER_RT5033=y
CONFIG_FUELGAUGE_RT5033=y
CONFIG_REGULATOR_RT5033=y

# VIBRATOR
CONFIG_MSM_VIBRATOR=y

#SENSOR
CONFIG_SENSORS=y
CONFIG_SENSORS_CORE=y
CONFIG_SENSORS_K2HH=y
CONFIG_SENSORS_K2HH_VDD=y
CONFIG_SENSORS_GP2A002=y
CONFIG_SENSORS_GP2A_VDD=y
# CONFIG_SENSORS_HSCDTD008A is not set
#NFC
CONFIG_NFC_PN547=y
CONFIG_NFC_PN547_8916_USE_BBCLK2=y

#FLASH
CONFIG_FLASHLIGHT=y
CONFIG_RT_FLASH_LED=y
CONFIG_FLED_RT5033=y
CONFIG_FLED_RT5033_EXT_GPIO=y

#CAMERA
CONFIG_IMX219=y
CONFIG_S5K4ECGX=y
CONFIG_S5K5E3YX=y
CONFIG_S5K6A3YX=y
CONFIG_SR030PC50=y
CONFIG_SR130PC20=y
CONFIG_SR200PC20=y
CONFIG_SR544=y

# DUAL SIM / SINGLE SIM Detection
CONFIG_CHECK_SIMSLOT_COUNT=y
# CONFIG_CHECK_SIMSLOT_COUNT_GPIO is not set
CONFIG_CHECK_SIMSLOT_COUNT_DT=y

# MODEM SECURE CHECK
# CONFIG_SEC_PERIPHERAL_SECURE_CHK=y

#optimize mmc block delay on resume
CONFIG_MMC_BLOCK_DEFERRED_RESUME=y

# SSWAP
CONFIG_SWAP=y
CONFIG_FRONTSWAP=y
CONFIG_ZSMALLOC=y
CONFIG_ZSWAP=y

#APC CPR QUOTIENT
CONFIG_APC_CPR_QUOT_BOOST=y
```

## arch/arm/configs/msm8916_sec_fortuna_eur_defconfig
```kconfig
CONFIG_SEC_FORTUNA_PROJECT=y
CONFIG_MACH_FORTUNA_EUR_OPEN=y

CONFIG_SEC_GPIO_SETTINGS=y

# MUIC
CONFIG_SM5502_MUIC=y
CONFIG_MUIC_SUPPORT_RUSTPROOF=y
CONFIG_USBID_STANDARD_VER_01=y

# LCD
#CONFIG_PANEL_S6E88A0_AMS452EF01_QHD=y
#CONFIG_MDNIE_LITE_TUNING=y
#CONFIG_ESD_RECOVERY=y
CONFIG_PANEL_HX8389C_GH9607501A_QHD=y
CONFIG_PANEL_S6D78A0_GH9607501A_QHD=y
CONFIG_FB_MSM_MDSS_SAMSUNG=y

#CONFIG_REGULATOR_FIXED_VOLTAGE=y

# INPUT (TSP, Touchkey)
CONFIG_TOUCHSCREEN_ZINITIX_BT541=y
#CONFIG_KEYBOARD_ABOV_TOUCH=y
#CONFIG_TOUCHSCREEN_TA_CALLBACK_ENABLE=y

# HALL IC
#CONFIG_SENSORS_HALL=y

# Charging/Battery
CONFIG_MFD_RT5033=y
CONFIG_MFD_RT5033_RESET_GPIO=n
CONFIG_MFD_RT5033_SLDO_VBUSDET=y
CONFIG_BATTERY_SAMSUNG=y
CONFIG_BATTERY_SAMSUNG_DATA_FILE="fortuna_battery_data.h"
CONFIG_SAMSUNG_LPM_MODE=y
CONFIG_CHARGER_RT5033=y
CONFIG_FUELGAUGE_RT5033=y
CONFIG_REGULATOR_RT5033=y

# VIBRATOR
CONFIG_MSM_VIBRATOR=y

#############################################
# SOUND FEATURE
#############################################
#CONFIG_AUDIO_SPEAKER_OUT_NXP_AMP_ENABLE=y
#CONFIG_AUDIO_QUAT_I2S_ENABLE=y
#############################################

# SENSOR
CONFIG_SENSORS=y
CONFIG_SENSORS_CORE=y
#CONFIG_SENSORS_CM36652=y
#CONFIG_SENSORS_CM36652_LEDA_EN_GPIO=y
# BMC150
CONFIG_SENSORS_BMA2X2=y
CONFIG_SENSORS_BMM050=y
#CONFIG_INPUT_BMA2x2_ACC_ALERT_INT=y
CONFIG_SENSORS_GP2A002=y
CONFIG_SENSORS_GP2A_VDD=y

# NFC
CONFIG_SEC_NFC=y
CONFIG_SEC_NFC_I2C=y
CONFIG_SEC_NFC_USE_8916_BBCLK2=y
CONFIG_SEC_NFC_IF_I2C=y
CONFIG_SEC_NFC_PRODUCT_N5=y
CONFIG_SEC_NFC_CLK_ALWAYS_ENABLE=y

# FLASH
CONFIG_FLASHLIGHT=y
CONFIG_RT_FLASH_LED=y
CONFIG_FLED_RT5033=y
CONFIG_FLED_RT5033_EXT_GPIO=y

# CAMERA
CONFIG_IMX219=y
CONFIG_S5K5E3YX=y
#CONFIG_MSM_OTP=y

# optimize mmc block delay on resume
#CONFIG_MMC_BLOCK_DEFERRED_RESUME=y

# DUAL SIM / SINGLE SIM Detection
CONFIG_CHECK_SIMSLOT_COUNT=y
# CONFIG_CHECK_SIMSLOT_COUNT_GPIO is not set
CONFIG_CHECK_SIMSLOT_COUNT_DT=y


# SSWAP
CONFIG_SWAP=y
CONFIG_FRONTSWAP=y
CONFIG_ZSMALLOC=y
CONFIG_ZSWAP=y

# MMC
CONFIG_SEC_HYBRID_TRAY=y
```

## arch/arm/configs/msm8916_sec_fortuna_spr_defconfig
```kconfig
CONFIG_SEC_FORTUNA_PROJECT=y
CONFIG_MACH_FORTUNA_SPR=y

# HARD RESET
CONFIG_RESTART_REASON_SEC_PARAM=y

# MUIC
CONFIG_SM5502_MUIC=y
CONFIG_USBID_STANDARD_VER_01=y
CONFIG_MUIC_SUPPORT_RUSTPROOF=y

#Touch Screen
CONFIG_TOUCHSCREEN_ZINITIX_BT541=y

#LCD
CONFIG_PANEL_HX8389C_GH9607501A_QHD=y
CONFIG_PANEL_S6D78A0_GH9607501A_QHD=y

#Vibrator
CONFIG_SS_VIBRATOR=y

# BATTERY
CONFIG_MFD_RT5033=y
CONFIG_BATTERY_SAMSUNG=y
CONFIG_BATTERY_SAMSUNG_DATA_FILE="fortuna_battery_data.h"
CONFIG_SAMSUNG_LPM_MODE=y
CONFIG_CHARGER_RT5033=y
CONFIG_FUELGAUGE_RT5033=y
CONFIG_REGULATOR_RT5033=y
CONFIG_MFD_RT5033_RESET_WA=y
CONFIG_MFD_RT5033_SLDO_VBUSDET=y
CONFIG_BATTERY_SWELLING=n

#SENSOR
CONFIG_SENSORS=y
CONFIG_SENSORS_CORE=y
CONFIG_SENSORS_GP2A002=y
CONFIG_SENSORS_GP2A_VDD=y
#BMC150
CONFIG_SENSORS_BMA2X2=y
CONFIG_SENSORS_BMM050=y
CONFIG_SENSORS_BMA2X2_ENABLE_INT1=y
CONFIG_SENSORS_BMA2X2_MODE_B1=y
CONFIG_INPUT_BMA2x2_ACC_ALERT_INT=y

#NFC
CONFIG_NFC=y
CONFIG_SEC_NFC=y
CONFIG_SEC_NFC_IF_I2C=y
CONFIG_SEC_NFC_PRODUCT_N5=y
CONFIG_SEC_NFC_USE_8916_BBCLK2=y

#FLASH
CONFIG_FLASHLIGHT=y
CONFIG_RT_FLASH_LED=y
CONFIG_FLED_RT5033=y
CONFIG_FLED_RT5033_EXT_GPIO=y

#CAMERA
CONFIG_S5K4H5YB=y
CONFIG_S5K5E3YX=y

# DUAL SIM / SINGLE SIM Detection
CONFIG_CHECK_SIMSLOT_COUNT=y
# CONFIG_CHECK_SIMSLOT_COUNT_GPIO is not set
CONFIG_CHECK_SIMSLOT_COUNT_DT=y

# MODEM SECURE CHECK
CONFIG_SEC_PERIPHERAL_SECURE_CHK=y

# SSWAP
CONFIG_SWAP=y
CONFIG_FRONTSWAP=y
CONFIG_ZSMALLOC=y
CONFIG_ZSWAP=y

#APC CPR QUOTIENT
CONFIG_APC_CPR_QUOT_BOOST=y
```

## arch/arm/configs/msm8916_sec_fortuna_tfn_defconfig
```kconfig
CONFIG_SEC_FORTUNA_PROJECT=y
CONFIG_MACH_FORTUNA_TFN=y

# HARD RESET
CONFIG_RESTART_REASON_SEC_PARAM=y

# MUIC
CONFIG_SM5502_MUIC=y
CONFIG_SM5504_MUIC=y
CONFIG_USBID_STANDARD_VER_01=y

#Touch Screen
CONFIG_TOUCHSCREEN_ZINITIX_BT541=y

#LCD
CONFIG_PANEL_HX8389C_GH9607501A_QHD=y
CONFIG_PANEL_S6D78A0_GH9607501A_QHD=y

#Vibrator
CONFIG_MSM_VIBRATOR=y

# BATTERY
CONFIG_MFD_RT5033=y
CONFIG_BATTERY_SAMSUNG=y
CONFIG_BATTERY_SAMSUNG_DATA_FILE="fortuna_battery_data.h"
CONFIG_SAMSUNG_LPM_MODE=y
CONFIG_CHARGER_RT5033=y
CONFIG_FUELGAUGE_RT5033=y
CONFIG_REGULATOR_RT5033=y
CONFIG_MFD_RT5033_RESET_WA=y
CONFIG_MFD_RT5033_SLDO_VBUSDET=n
CONFIG_BATTERY_SWELLING=n

#SENSOR
CONFIG_SENSORS=y
CONFIG_SENSORS_CORE=y
CONFIG_SENSORS_GP2A002=y
CONFIG_SENSORS_GP2A_VDD=y
#BMC150
CONFIG_SENSORS_BMA2X2=y
CONFIG_SENSORS_BMM050=y
CONFIG_SENSORS_BMA2X2_ENABLE_INT1=y
CONFIG_CHARGER_NOTIFY_SENSOR=y

#NFC
CONFIG_NFC_PN547=y
CONFIG_NFC_PN547_8916_USE_BBCLK2=y

#MMC
CONFIG_SEC_HYBRID_TRAY=y

#FLASH
CONFIG_FLASHLIGHT=y
CONFIG_RT_FLASH_LED=y
CONFIG_FLED_RT5033=y
CONFIG_FLED_RT5033_EXT_GPIO=y

#CAMERA
CONFIG_S5K4H5YB=y
CONFIG_S5K5E3YX=y
CONFIG_IMX219=y

# SSWAP
CONFIG_SWAP=y
CONFIG_FRONTSWAP=y
CONFIG_ZSMALLOC=y
CONFIG_ZSWAP=y

#APC CPR QUOTIENT
CONFIG_APC_CPR_QUOT_BOOST=y
```

## arch/arm/configs/msm8916_sec_fortunave3g_eur_defconfig
```kconfig
CONFIG_SEC_FORTUNA_PROJECT=y
CONFIG_MACH_FORTUNAVE3G_EUR=y

# HARD RESET
CONFIG_RESTART_REASON_SEC_PARAM=y

# SS Pinctrl Driver
CONFIG_SEC_GPIO_SETTINGS=y

#Vibrator
CONFIG_MSM_VIBRATOR=y

# MUIC
CONFIG_SM5502_MUIC=y
# CONFIG_MUIC_SM5502_SUPPORT_LANHUB_TA is not set
CONFIG_MUIC_SUPPORT_RUSTPROOF=y
CONFIG_USBID_STANDARD_VER_01=y

#Touch Screen
CONFIG_TOUCHSCREEN_ZINITIX_BT541=y

#LCD
CONFIG_PANEL_HX8389C_GH9607501A_QHD=y
CONFIG_PANEL_S6D78A0_GH9607501A_QHD=y

CONFIG_MFD_RT5033=y
CONFIG_MFD_RT5033_RESET_GPIO=n
CONFIG_MFD_RT5033_SLDO_VBUSDET=y
CONFIG_BATTERY_SAMSUNG=y
CONFIG_BATTERY_SAMSUNG_DATA_FILE="fortuna_battery_data.h"
CONFIG_SAMSUNG_LPM_MODE=y
CONFIG_CHARGER_RT5033=y
CONFIG_FUELGAUGE_RT5033=y
CONFIG_REGULATOR_RT5033=y

#SENSOR
CONFIG_SENSORS=y
CONFIG_SENSORS_CORE=y
CONFIG_SENSORS_K303C=y
CONFIG_SENSORS_GP2A002=y
CONFIG_SENSORS_GP2A_VDD=y

#FLASH
CONFIG_FLASHLIGHT=y
CONFIG_RT_FLASH_LED=y
CONFIG_FLED_RT5033=y
CONFIG_FLED_RT5033_EXT_GPIO=y

#CAMERA
CONFIG_S5K4H5YB=y
CONFIG_S5K5E3YX=y

#optimize mmc block delay on resume
CONFIG_MMC_BLOCK_DEFERRED_RESUME=y

# DUAL SIM / SINGLE SIM Detection
CONFIG_CHECK_SIMSLOT_COUNT=y
CONFIG_CHECK_SIMSLOT_COUNT_GPIO=1008

CONFIG_TRACE_MODEM_MEM_FAIL=y

# SSWAP
CONFIG_SWAP=y
CONFIG_FRONTSWAP=y
CONFIG_ZSMALLOC=y
CONFIG_ZSWAP=y

#APC CPR QUOTIENT
CONFIG_APC_CPR_QUOT_BOOST=y
```

## arch/arm/configs/msm8916_sec_gt510lte_eur_defconfig
```kconfig
CONFIG_SEC_GT510_PROJECT=y
CONFIG_MACH_GT510_EUR_OPEN=y

# HARD RESET
CONFIG_RESTART_REASON_SEC_PARAM=y

# MUIC
CONFIG_EXTCON=y
CONFIG_EXTCON_MAX77849=y
CONFIG_MUIC_SUPPORT_DESK_DOCK=y
CONFIG_MUIC_SUPPORT_CHARGING_CABLE=y
CONFIG_ADC_ONESHOT=y
CONFIG_MUIC_SUPPORT_RUSTPROOF=y
CONFIG_MUIC_SUPPORT_LANHUB=y

#AUDIO
CONFIG_AUDIO_SPEAKER_OUT_MAXIM_AMP_ENABLE=y
# CONFIG_AUDIO_SPEAKER_OUT_NXP_AMP_ENABLE is not set
CONFIG_AUDIO_QUAT_I2S_ENABLE=y
CONFIG_JACK_AUDIO=y

#HALL IC
CONFIG_SENSORS_HALL=y

#TSP BOOSTER
# CONFIG_COMMON_INPUT_BOOSTER is not set
# CONFIG_CPU_FREQ_LIMIT_USERSPACE is not set
# CONFIG_CPU_FREQ_LIMIT is not set

# TSP
#CONFIG_TOUCHSCREEN_MMS300=y
#CONFIG_KEYBOARD_TC360_TKEY=y
#CONFIG_TOUCHSCREEN_SYNAPTICS_S7301=y
#CONFIG_TOUCHSCREEN_SYNAPTICS_S7301_KEYS=y
#CONFIG_TOUCHSCREEN_SYNAPTICS_S7301_WORKAROUND=y
#CONFIG_TOUCHSCREEN_SYNAPTICS_S7301_KEYLED=y
#CONFIG_SEC_TOUCHSCREEN_SURFACE_TOUCH=y
CONFIG_TOUCHSCREEN_ATMEL_MXT1664T=y
CONFIG_NO_ERROR_ON_MISMATCH=y
CONFIG_DEBUG_SECTION_MISMATCH=y

#
# Specific keyboard combination reject in kernel level.
# Only processing Framework level.
#
CONFIG_USE_VM_KEYBOARD_REJECT=y

#Vibrator
CONFIG_SS_VIBRATOR=y

#LCD
CONFIG_PANEL_S6D7AA0_LTL101AT01_WXGA=y
CONFIG_PANEL_S6D7AA0_BOE_LTL101AT01_WXGA=y

# BATTERY
CONFIG_MFD_MAX77849=y
CONFIG_CHARGER_MAX77849=y
CONFIG_BATTERY_SAMSUNG=y
CONFIG_BATTERY_SAMSUNG_DATA_FILE="gt510_battery_data.h"
CONFIG_FUELGAUGE_MAX77849=y
CONFIG_FUELGAUGE_MAX77849_COULOMB_COUNTING=y
CONFIG_SAMSUNG_LPM_MODE=y
CONFIG_BATTERY_SWELLING=y
CONFIG_BATTERY_SWELLING_SELF_DISCHARGING=y
CONFIG_PREVENT_SOC_JUMP=y

#SENSOR
CONFIG_SENSORS=y
CONFIG_SENSORS_CORE=y
CONFIG_SENSORS_K2HH=y
CONFIG_SENSORS_K2HH_VDD=y
CONFIG_SENSORS_CM3323=y
CONFIG_SENSORS_TCS3490=y
CONFIG_SENSORS_SX9500_WIFI=y
CONFIG_SENSORS_SX9500_WIFI_NORMAL_TOUCH_THRESHOLD=9
CONFIG_SENSORS_SX9500_WIFI_INIT_TOUCH_THRESHOLD=800
CONFIG_SENSORS_SX9500_WIFI_REGULATOR_ONOFF=y
CONFIG_SENSORS_SX9500_WIFI_DEFENCE_CODE_FOR_TA_NOISE=y

#CAMERA
CONFIG_SR544=y
CONFIG_SR200PC20=y
CONFIG_MSM_EEPROM=n
CONFIG_MSM_OTP=y
CONFIG_SENSOR_8_BPP=y

#APC CPR QUOTIENT
CONFIG_APC_CPR_QUOT_BOOST=y

# TIMA LOG
CONFIG_ARCH_MSM8939_TIMA=y

# SSWAP
CONFIG_SWAP=y
CONFIG_FRONTSWAP=y
CONFIG_ZSMALLOC=y
CONFIG_ZSWAP=y
```
