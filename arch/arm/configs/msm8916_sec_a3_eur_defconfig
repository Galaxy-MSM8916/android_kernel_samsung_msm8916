## arch/arm/configs/msm8929_sec_j7_spr_defconfig
```kconfig
CONFIG_SEC_J7_PROJECT=y
CONFIG_MACH_J7_USA_SPR=y

# GPIO SETTING
CONFIG_SEC_GPIO_SETTINGS=y

#INPUT MODULES
#CONFIG_TOUCHSCREEN_IST30XXC is not set
CONFIG_INPUT_UINPUT=y
CONFIG_INPUT_GPIO=y
#CONFIG_TOUCHSCREEN_TA_CALLBACK_ENABLE is not set
CONFIG_TOUCHSCREEN_MELFAS_MMS438=y
CONFIG_KEYBOARD_TC360_TKEY_J7=y

CONFIG_SENSORS_HALL=y

# MOTOR
CONFIG_SM5703_VIBRATOR=y

# HALL IC
CONFIG_SENSORS_HALL=y

# DUAL SIM / SINGLE SIM Detection
CONFIG_CHECK_SIMSLOT_COUNT=y
# CONFIG_CHECK_SIMSLOT_COUNT_GPIO is not set
CONFIG_CHECK_SIMSLOT_COUNT_DT=y


# MUIC
CONFIG_SM5703_MUIC=y
CONFIG_USBID_STANDARD_VER_01=y
CONFIG_MUIC_SUPPORT_RUSTPROOF=y
CONFIG_MUIC_SUPPORT_CHARGING_CABLE=y
CONFIG_MUIC_SUPPORT_DESKDOCK=y

#FLASH
CONFIG_FLASHLIGHT=y
CONFIG_SM_FLASH_LED=y
CONFIG_FLED_SM5703=y
CONFIG_FLED_SM5703_EXT_GPIO=y
CONFIG_FLED_KTD2692=y
CONFIG_FRONT_FLASH=y

#CAMERA
CONFIG_S5K3L2XX=y
CONFIG_S5K5E3YX=y
CONFIG_CAMERA_SYSFS_V2=y
CONFIG_SW_LANDING_FOR_MULTI_TASKING=y

# IFPMIC
# Charging/Battery
CONFIG_MFD_SM5703=y
CONFIG_REGULATOR_SM5703=y
CONFIG_CHARGER_SM5703=y
CONFIG_BATTERY_SAMSUNG=y
CONFIG_BATTERY_SAMSUNG_DATA_FILE="j7_battery_data.h"
CONFIG_SAMSUNG_LPM_MODE=y
CONFIG_FUELGAUGE_SM5703=y
CONFIG_BATTERY_SWELLING=y
CONFIG_SIOP_CHARGING_LIMIT_CURRENT=1000
CONFIG_PREVENT_SOC_JUMP=y
CONFIG_CHARGER_SM5703_SOFT_START_CHARGING=y
CONFIG_CHARGER_SM5703_DUALPATH=y

#LCD
CONFIG_PANEL_EA8061_AMS549HZ01=y

#BATTERY
CONFIG_BATTERY_SWELLING=y

#AUDIO
#CONFIG_AUDIO_SPEAKER_OUT_NXP_AMP_ENABLE=y
#CONFIG_AUDIO_QUAT_I2S_ENABLE=y

#SENSOR
CONFIG_SENSORS_CORE=y
CONFIG_SENSORS_K2HH=y
# CONFIG_SENSORS_K2HH_VDD is not set
# CONFIG_SENSORS_CM36672P_PMIC_LEDA is not set
CONFIG_SENSORS_CM36672P=y

#DISPLAY
#CONFIG_PANEL_S6E3FA2_AMS549EH01_FHD is not set

# TIMA LOG
# CONFIG_ARCH_MSM8939_TIMA=y

#CAMERA
#CONFIG_MSM_OTP=y

# debugging more information
#CONFIG_DEBUG_FS=y

## CHINA
#configs for Wi-Fi WAPI
CONFIG_TARGET_LOCALE_CHN=y
CONFIG_WLAN_REGION_CODE=300

#MMC
#CONFIG_SEC_HYBRID_TRAY=y

#NFC
CONFIG_NFC=y
CONFIG_NFC_PN547=y
CONFIG_NFC_PN547_8916_USE_BBCLK2=y
CONFIG_NFC_PN547_8916_CLK_CTL=y

# MSM8929
CONFIG_ARCH_MSM8929=y
CONFIG_NR_CPUS=8

# SSWAP
CONFIG_SWAP=y
CONFIG_FRONTSWAP=y
CONFIG_ZSMALLOC=y
CONFIG_PGTABLE_MAPPING=y
CONFIG_ZSWAP=y
CONFIG_ZPOOL=y
CONFIG_DIRECT_RECLAIM_FILE_PAGES_ONLY=y
CONFIG_INCREASE_MAXIMUM_SWAPPINESS=y
CONFIG_FIX_INACTIVE_RATIO=y
CONFIG_TIGHT_PGDAT_BALANCE=y
CONFIG_VNSWAP=y
CONFIG_SWAP_ENABLE_READAHEAD=n
```

## arch/arm/hotplug/Kconfig
```kconfig
config INTELLI_PLUG
        bool "Enable intelli-plug cpu hotplug driver"
        default n
        help
          Generic Intelli-plug cpu hotplug driver for ARM SOCs

config MSM_HOTPLUG
	bool "MSM hotplug driver"
	depends on HOTPLUG_CPU
	default y
	help
	  The MSM hotplug driver controls on-/offlining of additional cores based
	  on current cpu load.
```
