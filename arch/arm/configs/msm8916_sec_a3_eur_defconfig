## arch/arm/configs/msm8916_sec_gt58lte_tmo_defconfig
```kconfig
CONFIG_SEC_GT58_PROJECT=y
CONFIG_MACH_GT58_USA_TMO=y

# HARD RESET
CONFIG_RESTART_REASON_SEC_PARAM=y

# MUIC
CONFIG_EXTCON=y
CONFIG_EXTCON_MAX77849=y
CONFIG_MUIC_SUPPORT_DESK_DOCK=y
CONFIG_MUIC_SUPPORT_CHARGING_CABLE=y
CONFIG_ADC_ONESHOT=y
CONFIG_MUIC_SUPPORT_LANHUB=y

# USB HOST
CONFIG_USB_HOST_NOTIFY=y

# AUDIO
CONFIG_AUDIO_SPEAKER_OUT_NXP_AMP_ENABLE=y
CONFIG_AUDIO_QUAT_I2S_ENABLE=y
CONFIG_AMP_TFA9895=Y

# GPIO
CONFIG_SEC_GPIO_SETTINGS=y

# HALL IC
CONFIG_SENSORS_HALL=y

# TSP
CONFIG_TOUCHSCREEN_ZINITIX_BT532=y

# Vibrator
CONFIG_MSM_VIBRATOR=y

# LCD
CONFIG_PANEL_S6D7AA0_LSL080AL03_WXGA=y
CONFIG_PANEL_S6D7AA0_LSL080AL03_BOE_WXGA=y

# BATTERY
CONFIG_MFD_MAX77849=y
CONFIG_CHARGER_MAX77849=y
CONFIG_BATTERY_SAMSUNG=y
CONFIG_FUELGAUGE_MAX77849=y
CONFIG_FUELGAUGE_MAX77849_COULOMB_COUNTING=y
CONFIG_SAMSUNG_LPM_MODE=y
CONFIG_BATTERY_SWELLING=y
CONFIG_BATTERY_SWELLING_SELF_DISCHARGING=y
CONFIG_BATTERY_SAMSUNG_DATA_FILE="gt5note8_battery_data.h"
CONFIG_CHARGING_VZWCONCEPT=y
CONFIG_SLOW_CHARGING_CURRENT_STANDARD=400
CONFIG_PREVENT_SOC_JUMP=y

# SENSOR
CONFIG_SENSORS=y
CONFIG_SENSORS_CORE=y
CONFIG_SENSORS_K2HH=y
CONFIG_SENSORS_K2HH_VDD=y
CONFIG_SENSORS_CM3323=y
CONFIG_SENSORS_TCS3490=y
CONFIG_SENSORS_SX9500=y
CONFIG_SENSORS_SX9500_NORMAL_TOUCH_THRESHOLD=8
CONFIG_SENSORS_SX9500_INIT_TOUCH_THRESHOLD=2000
CONFIG_SENSORS_SX9500_REGULATOR_ONOFF=y
CONFIG_SENSORS_SX9500_DEFENCE_CODE_FOR_TA_NOISE=y
CONFIG_SENSORS_SX9500_SAMPLE_RATE_SET_125KHZ=y
CONFIG_SENSORS_SX9500_WIFI=y
CONFIG_SENSORS_SX9500_WIFI_NORMAL_TOUCH_THRESHOLD=4
CONFIG_SENSORS_SX9500_WIFI_INIT_TOUCH_THRESHOLD=2000
CONFIG_SENSORS_SX9500_WIFI_REGULATOR_ONOFF=y
CONFIG_SENSORS_SX9500_WIFI_DEFENCE_CODE_FOR_TA_NOISE=y

# CAMERA
CONFIG_SR544=y
CONFIG_SR200PC20=y
CONFIG_MSM_EEPROM=n
CONFIG_MSM_OTP=y

# APC CPR QUOTIENT
CONFIG_APC_CPR_QUOT_BOOST=y

# SSWAP
CONFIG_SWAP=y
CONFIG_FRONTSWAP=y
CONFIG_ZSMALLOC=y
CONFIG_ZSWAP=y
```

## arch/arm/configs/msm8916_sec_gtelwifi_usa_defconfig
```kconfig
CONFIG_SEC_GTEL_PROJECT=y
CONFIG_MACH_GTELWIFI_USA_OPEN=y

# HARD RESET
CONFIG_RESTART_REASON_SEC_PARAM=y

# GPIO SETTING
CONFIG_SEC_GPIO_SETTINGS=y

# MUIC
CONFIG_MUIC_SUPPORT_RUSTPROOF=y
CONFIG_USBID_STANDARD_VER_01=y
CONFIG_SM5703_MUIC=y
CONFIG_MUIC_SM5703_SUPPORT_LANHUB_TA=y
# CONFIG_MUIC_SUPPORT_VZW_INCOMPATIBLE is not set
# CONFIG_MUIC_SUPPORT_CHARGING_CABLE is not set

#Touch Key
#CONFIG_KEYBOARD_ABOV_TOUCH_A5=y

#Touch Screen
#CONFIG_TOUCHSCREEN_MMS300_A=y
CONFIG_TOUCHSCREEN_ZT7554_TS=y
CONFIG_INPUT_BOOSTER=y

# Vibrator
CONFIG_SM5703_VIBRATOR=n

#SENSORS
CONFIG_SENSORS=y
CONFIG_SENSORS_CORE=y
CONFIG_SENSORS_K2HH=y
CONFIG_SENSORS_K2HH_VDD=y
CONFIG_SENSORS_SX9500=y
CONFIG_SENSORS_SX9500_NORMAL_TOUCH_THRESHOLD=7
CONFIG_SENSORS_SX9500_INIT_TOUCH_THRESHOLD=2000
CONFIG_SENSORS_SX9500_REGULATOR_ONOFF=y
CONFIG_SENSORS_SX9500_DEFENCE_CODE_FOR_TA_NOISE=y
CONFIG_SENSORS_SX9500_WIFI=y
CONFIG_SENSORS_SX9500_WIFI_NORMAL_TOUCH_THRESHOLD=4
CONFIG_SENSORS_SX9500_WIFI_INIT_TOUCH_THRESHOLD=2000
CONFIG_SENSORS_SX9500_WIFI_REGULATOR_ONOFF=y
CONFIG_SENSORS_SX9500_WIFI_DEFENCE_CODE_FOR_TA_NOISE=y

#AUDIO
#CONFIG_AUDIO_SPEAKER_OUT_NXP_AMP_ENABLE=y
#CONFIG_AUDIO_QUAT_I2S_ENABLE=y

#DISPLAY
CONFIG_PANEL_NT51017_B4P096WX5VP09_WXGA=y

#optimize mmc block delay on resume
CONFIG_MMC_BLOCK_DEFERRED_RESUME=y

#BATTERY
CONFIG_MFD_SM5703=y
CONFIG_FUELGAUGE_SM5703=y
CONFIG_CHARGER_SM5703=y
CONFIG_REGULATOR_SM5703=y
CONFIG_BATTERY_SAMSUNG=y
CONFIG_BATTERY_SAMSUNG_DATA_FILE="gtel_battery_data.h"
CONFIG_SAMSUNG_LPM_MODE=y
CONFIG_CHARGING_VZWCONCEPT=y
CONFIG_BATTERY_SWELLING=y
CONFIG_BATTERY_SWELLING_SELF_DISCHARGING=y
CONFIG_SIOP_CHARGING_LIMIT_CURRENT=1900
CONFIG_CHARGER_SM5703_SOFT_START_CHARGING=y
CONFIG_PREVENT_SOC_JUMP=y

#FLASH
CONFIG_FLASHLIGHT=y
CONFIG_RT_FLASH_LED=y
CONFIG_FLED_RT5033=y
CONFIG_FLED_RT5033_EXT_GPIO=y

#CAMERA
CONFIG_S5K4ECGX=y
CONFIG_SR200PC20=y
CONFIG_SENSOR_8_BPP=y
CONFIG_CAMERA_SYSFS_V2=y

#IPSec
CONFIG_CRYPTO_NULL=y
#MMC
#CONFIG_SEC_HYBRID_TRAY=y


# Bluetooth deconfig
#
CONFIG_HID_SUPPORT=y
# CONFIG_BT_HCISMD=y is not set
# CONFIG_BT_HCIUART=y is not set
# CONFIG_BT_HCIUART_H4=y is not set


#APC CPR QUOTIENT
CONFIG_APC_CPR_QUOT_BOOST=y

# EXTEND SERIAL NUM LENGTH
CONFIG_EXTEND_SERIAL_NUM_16=y

# SSWAP
CONFIG_SWAP=y
CONFIG_FRONTSWAP=y
CONFIG_ZSMALLOC=y
CONFIG_ZSWAP=y
```

## arch/arm/configs/msm8916_sec_gtes_spr_defconfig
```kconfig
CONFIG_SEC_GTES_PROJECT=y
CONFIG_MACH_GTES_USA_SPR=y

# HARD RESET
CONFIG_RESTART_REASON_SEC_PARAM=y

#Barcode Print
CONFIG_BARCODE_PAINTER=y

# GPIO SETTING
CONFIG_SEC_GPIO_SETTINGS=y

# MUIC
CONFIG_MUIC_SUPPORT_RUSTPROOF=y
CONFIG_USBID_STANDARD_VER_01=y
CONFIG_MUIC_SUPPORT_CHARGING_CABLE=y
CONFIG_SM5703_MUIC=y
CONFIG_MUIC_SM5703_SUPPORT_LANHUB_TA=y

#Touch Screen
CONFIG_TOUCHSCREEN_ZT7548_TS=y

# Vibrator
CONFIG_SM5703_VIBRATOR=y

#SENSORS
CONFIG_SENSORS=y
CONFIG_SENSORS_CORE=y
CONFIG_SENSORS_K2HH=y
CONFIG_SENSORS_K2HH_VDD=y
CONFIG_SENSORS_SX9500_ALWAYS=y
CONFIG_SENSORS_SX9500_NORMAL_TOUCH_THRESHOLD=11
CONFIG_SENSORS_SX9500_REGULATOR_ONOFF=y

#DISPLAY
CONFIG_PANEL_S6D7AA0X11_TV080WXM_WXGA=y

#optimize mmc block delay on resume
CONFIG_MMC_BLOCK_DEFERRED_RESUME=y

#BATTERY
CONFIG_MFD_SM5703=y
CONFIG_FUELGAUGE_SM5703=y
CONFIG_CHARGER_SM5703=y
CONFIG_REGULATOR_SM5703=y
CONFIG_BATTERY_SAMSUNG=y
CONFIG_BATTERY_SAMSUNG_DATA_FILE="gtes_battery_data.h"
CONFIG_SAMSUNG_LPM_MODE=y
CONFIG_PREVENT_SOC_JUMP=y
CONFIG_BATTERY_SWELLING=y
CONFIG_SIOP_CHARGING_LIMIT_CURRENT=1700
CONFIG_SW_SELF_DISCHARGING=y

#FLASH
CONFIG_FLASHLIGHT=y
CONFIG_RT_FLASH_LED=y
CONFIG_FLED_RT5033=y
CONFIG_FLED_RT5033_EXT_GPIO=y

#CAMERA
CONFIG_S5K4ECGX=y
CONFIG_DB8221A=y
CONFIG_SENSOR_8_BPP=y
CONFIG_CAMERA_SYSFS_V2=y
CONFIG_CAM_DUAL_POWER_SEQ=y

#IPSec
CONFIG_CRYPTO_NULL=y
#MMC
# CONFIG_SEC_HYBRID_TRAY=y is not set

# Bluetooth deconfig
#
CONFIG_HID_SUPPORT=y
# CONFIG_BT_HCISMD=y is not set
# CONFIG_BT_HCIUART=y is not set
# CONFIG_BT_HCIUART_H4=y is not set

#APC CPR QUOTIENT
CONFIG_APC_CPR_QUOT_BOOST=y

# SSWAP
CONFIG_SWAP=y
CONFIG_FRONTSWAP=y
CONFIG_ZSMALLOC=y
CONFIG_ZSWAP=y
```

## arch/arm/configs/msm8916_sec_j3lte_chnctc_defconfig
```kconfig
CONFIG_SEC_J3_PROJECT=y
CONFIG_MACH_J3LTE_CHN_CTC=y

CONFIG_RESTART_REASON_SEC_PARAM=y

# SS Pinctrl Driver
CONFIG_SEC_GPIO_SETTINGS=y

# MUIC
CONFIG_SM5703_MUIC=y
CONFIG_USBID_STANDARD_VER_01=y
CONFIG_MUIC_SUPPORT_CHARGING_CABLE=y
CONFIG_MUIC_SUPPORT_RUSTPROOF=y
CONFIG_MUIC_SUPPORT_DESKDOCK=y

#USB Host
CONFIG_USB_HOST_NOTIFY=y

#Touch Screen
CONFIG_TOUCHSCREEN_IST30XXC=y
CONFIG_KEYBOARD_TC360_TKEY_J3=y

# Vibrator
CONFIG_SM5703_VIBRATOR=y

#LCD
CONFIG_PANEL_S6E8AA5X01_AMS497HY01_HD=y

#SENSOR
CONFIG_SENSORS=y
CONFIG_SENSORS_CORE=y
CONFIG_SENSORS_K2HH=y
CONFIG_SENSORS_CM36672P=y

#NFC
CONFIG_NFC=y
CONFIG_NFC_PN547=y
CONFIG_NFC_PN547_8916_USE_BBCLK2=y
CONFIG_NFC_PN547_8916_CLK_CTL=y
CONFIG_NFC_PN547_PVDD_EN_CONTROL=y

#FLASH
CONFIG_FLASHLIGHT=y
CONFIG_SM_FLASH_LED=y
CONFIG_FLED_SM5703=y
CONFIG_FLED_SM5703_EXT_GPIO=y

#CAMERA
CONFIG_S5K4H5YC=y
CONFIG_S5K5E3YX=y
CONFIG_CAMERA_SYSFS_V2=y
CONFIG_SW_LANDING_FOR_MULTI_TASKING=y

#AUDIO
CONFIG_RADIO_IRIS=y
CONFIG_RADIO_IRIS_TRANSPORT=m

#optimize mmc block delay on resume
CONFIG_MMC_BLOCK_DEFERRED_RESUME=y

# Pre-power on alarm
CONFIG_RTC_AUTO_PWRON=y
CONFIG_RTC_AUTO_PWRON_PARAM=y

# IPSec
CONFIG_CRYPTO_NULL=y

# Charging/Battery
CONFIG_MFD_SM5703=y
CONFIG_REGULATOR_SM5703=y
CONFIG_CHARGER_SM5703=y
CONFIG_BATTERY_SAMSUNG=y
CONFIG_BATTERY_SAMSUNG_DATA_FILE="j3_battery_data.h"
CONFIG_SAMSUNG_LPM_MODE=y
CONFIG_FUELGAUGE_SM5703=y
CONFIG_BATTERY_SWELLING=y
CONFIG_SIOP_CHARGING_LIMIT_CURRENT=700
CONFIG_PREVENT_SOC_JUMP=y
CONFIG_CHARGER_SM5703_SOFT_START_CHARGING=y
CONFIG_CHARGER_SM5703_DUALPATH=y

# DUAL SIM / SINGLE SIM Detection
CONFIG_CHECK_SIMSLOT_COUNT=y
# CONFIG_CHECK_SIMSLOT_COUNT_GPIO is not set
CONFIG_CHECK_SIMSLOT_COUNT_DT=y

# MMC

# SDP
CONFIG_SDP=y
CONFIG_SDP_VAULT=y

# ION MSM SYSTEM HEAP POOL LIMIT
CONFIG_ION_MSM_SYSTEM_HEAP_POOL_LIMIT=y

# SSWAP
CONFIG_SWAP=y
CONFIG_FRONTSWAP=y
CONFIG_ZSMALLOC=y
CONFIG_ZSWAP=y

# MMAP read-around
CONFIG_MMAP_READAROUND_LIMIT=16
```

## arch/arm/configs/msm8916_sec_j3lte_spr_defconfig
```kconfig
CONFIG_SEC_J3_PROJECT=y
CONFIG_MACH_J3LTE_USA_SPR=y

# HARD RESET
CONFIG_RESTART_REASON_SEC_PARAM=y

# MUIC
CONFIG_SM5703_MUIC=y
CONFIG_USBID_STANDARD_VER_01=y
CONFIG_MUIC_SUPPORT_CHARGING_CABLE=y
CONFIG_MUIC_SUPPORT_RUSTPROOF=y
CONFIG_MUIC_SUPPORT_DESKDOCK=y
#AUDIO


#Touch Screen
CONFIG_TOUCHSCREEN_IST30XXC=y
CONFIG_KEYBOARD_TC360_TKEY_J3=y

#LCD
CONFIG_PANEL_S6E8AA5X01_AMS497HY01_HD=y

#Vibrator
CONFIG_SM5703_VIBRATOR=y


# Charging/Battery
CONFIG_MFD_SM5703=y
CONFIG_REGULATOR_SM5703=y
CONFIG_CHARGER_SM5703=y
CONFIG_BATTERY_SAMSUNG=y
CONFIG_BATTERY_SAMSUNG_DATA_FILE="j3_battery_data.h"
CONFIG_SAMSUNG_LPM_MODE=y
CONFIG_FUELGAUGE_SM5703=y
CONFIG_BATTERY_SWELLING=y
CONFIG_SIOP_CHARGING_LIMIT_CURRENT=700
CONFIG_PREVENT_SOC_JUMP=y
CONFIG_CHARGER_SM5703_SOFT_START_CHARGING=y
CONFIG_CHARGER_SM5703_DUALPATH=y

#SENSOR
CONFIG_SENSORS=y
CONFIG_SENSORS_CORE=y
CONFIG_SENSORS_K2HH=y
CONFIG_SENSORS_CM36672P=y

#FLASH
CONFIG_FLASHLIGHT=y
CONFIG_SM_FLASH_LED=y
CONFIG_FLED_SM5703=y
CONFIG_FLED_SM5703_EXT_GPIO=y

#CAMERA
CONFIG_DB8221A=y
CONFIG_SR544=y
CONFIG_SENSOR_8_BPP=y

CONFIG_MSM_EEPROM=n
CONFIG_MSM_OTP=y


# DUAL SIM / SINGLE SIM Detection
CONFIG_CHECK_SIMSLOT_COUNT=y
# CONFIG_CHECK_SIMSLOT_COUNT_GPIO is not set
CONFIG_CHECK_SIMSLOT_COUNT_DT=y

# MODEM SECURE CHECK
CONFIG_SEC_PERIPHERAL_SECURE_CHK=y

#APC CPR QUOTIENT
CONFIG_APC_CPR_QUOT_BOOST=y

# SDP
CONFIG_SDP=y
CONFIG_SDP_VAULT=y

# SSWAP
CONFIG_SWAP=y
CONFIG_FRONTSWAP=y
CONFIG_ZSMALLOC=y
CONFIG_ZSWAP=y
```

## arch/arm/configs/msm8916_sec_j53g_eur_defconfig
```kconfig
CONFIG_SEC_J5_PROJECT=y
CONFIG_MACH_J53G_EUR_OPEN=y

CONFIG_RESTART_REASON_SEC_PARAM=y

# SS Pinctrl Driver
CONFIG_SEC_GPIO_SETTINGS=y

# MUIC
CONFIG_SM5703_MUIC=y
CONFIG_USBID_STANDARD_VER_01=y
CONFIG_MUIC_SUPPORT_CHARGING_CABLE=y
CONFIG_MUIC_SUPPORT_RUSTPROOF=y
CONFIG_MUIC_SUPPORT_DESKDOCK=y

#Touch Screen
CONFIG_TOUCHSCREEN_IST30XXC=y
CONFIG_TOUCHSCREEN_TA_CALLBACK_ENABLE=y
CONFIG_KEYBOARD_TC360_TKEY_J5=y

# Vibrator
CONFIG_SM5703_VIBRATOR=y

# HALL IC
CONFIG_SENSORS_HALL=y
CONFIG_SENSORS_HALL_DETECT_NOISE=y

#LCD
CONFIG_PANEL_S6D7AA0X62_BV050HDM_HD_5_5=y
CONFIG_PANEL_S6E8AA5X01_AMS497HY01_720P=y
CONFIG_MFD_LM3632=y

#SENSOR
CONFIG_SENSORS=y
CONFIG_SENSORS_CORE=y
CONFIG_SENSORS_K2HH=y
CONFIG_SENSORS_GP2A002=y
CONFIG_SENSORS_GP2A_VDD=y
CONFIG_SENSORS_GP2A_MODE_B15=y

#FLASH
CONFIG_FLASHLIGHT=y
CONFIG_SM_FLASH_LED=y
CONFIG_FLED_SM5703=y
CONFIG_FLED_SM5703_EXT_GPIO=y
CONFIG_FLED_LM3632=y
CONFIG_FLED_KTD2692=y
CONFIG_FRONT_FLASH=y

#CAMERA
CONFIG_S5K3L2XX=y
CONFIG_S5K5E3YX=y
CONFIG_CAMERA_SYSFS_V2=y
CONFIG_SW_LANDING_FOR_MULTI_TASKING=y
CONFIG_EEPROM_CAMERA_QUP_I2C=y

#AUDIO
CONFIG_SW_100K_TO_GND=y

#optimize mmc block delay on resume
CONFIG_MMC_BLOCK_DEFERRED_RESUME=y

# IPSec
CONFIG_CRYPTO_NULL=y

# Charging/Battery
CONFIG_MFD_SM5703=y
CONFIG_REGULATOR_SM5703=y
CONFIG_CHARGER_SM5703=y
CONFIG_BATTERY_SAMSUNG=y
CONFIG_BATTERY_SAMSUNG_DATA_FILE="j5_battery_data.h"
CONFIG_SAMSUNG_LPM_MODE=y
CONFIG_FUELGAUGE_SM5703=y
CONFIG_BATTERY_SWELLING=y
CONFIG_PREVENT_SOC_JUMP=y
CONFIG_SW_SELF_DISCHARGING=y
CONFIG_CHARGER_SM5703_DUALPATH=y

# DUAL SIM / SINGLE SIM Detection
CONFIG_CHECK_SIMSLOT_COUNT=y
# CONFIG_CHECK_SIMSLOT_COUNT_GPIO is not set
CONFIG_CHECK_SIMSLOT_COUNT_DT=y

# SSWAP
CONFIG_SWAP=y
CONFIG_FRONTSWAP=y
CONFIG_ZSMALLOC=y
CONFIG_ZSWAP=y

#APC CPR QUOTIENT
CONFIG_APC_CPR_QUOT_BOOST=y
```

## arch/arm/configs/msm8916_sec_j5lte_chncmcc_defconfig
```kconfig
CONFIG_SEC_J5_PROJECT=y
CONFIG_MACH_J5LTE_CHN_CMCC=y

CONFIG_RESTART_REASON_SEC_PARAM=y

# SS Pinctrl Driver
CONFIG_SEC_GPIO_SETTINGS=y

# MUIC
CONFIG_SM5703_MUIC=y
CONFIG_USBID_STANDARD_VER_01=y
CONFIG_MUIC_SUPPORT_CHARGING_CABLE=y
CONFIG_MUIC_SUPPORT_RUSTPROOF=y
CONFIG_MUIC_SUPPORT_DESKDOCK=y

#Touch Screen
CONFIG_TOUCHSCREEN_IST30XXC=y
#CONFIG_TOUCHSCREEN_ZINITIX_BT541=y
CONFIG_TOUCHSCREEN_TA_CALLBACK_ENABLE=y

# Vibrator
CONFIG_SM5703_VIBRATOR=y

#LCD
CONFIG_PANEL_S6D7AA0X62_BV050HDM_HD_5_5=y
CONFIG_PANEL_ILI6236S_CPT50_HD=y
CONFIG_PANEL_ILI9881C_SKI499017_HD=y
CONFIG_MFD_LM3632=y

#SENSOR
CONFIG_SENSORS=y
CONFIG_SENSORS_CORE=y
CONFIG_SENSORS_K2HH=y
CONFIG_SENSORS_GP2A002=y
CONFIG_SENSORS_GP2A_VDD=y
CONFIG_SENSORS_GP2A_MODE_B15=y

#NFC
CONFIG_NFC_PN547=y
CONFIG_NFC_PN547_8916_USE_BBCLK2=y
CONFIG_NFC_PN547_8916_CLK_CTL=y
CONFIG_NFC_PN547_USE_EXTERNAL_LDO_VIO=y

#FLASH
CONFIG_FLASHLIGHT=y
CONFIG_SM_FLASH_LED=y
CONFIG_FLED_SM5703=y
CONFIG_FLED_SM5703_EXT_GPIO=y
CONFIG_FLED_LM3632=y
CONFIG_FLED_KTD2692=y
CONFIG_FRONT_FLASH=y

#CAMERA
CONFIG_S5K3L2XX=y
CONFIG_S5K5E3YX=y
CONFIG_CAMERA_SYSFS_V2=y
CONFIG_SW_LANDING_FOR_MULTI_TASKING=y
CONFIG_EEPROM_CAMERA_QUP_I2C=y


#optimize mmc block delay on resume
CONFIG_MMC_BLOCK_DEFERRED_RESUME=y

# Pre-power on alarm
CONFIG_RTC_AUTO_PWRON=y
CONFIG_RTC_AUTO_PWRON_PARAM=y

# IPSec
CONFIG_CRYPTO_NULL=y

# Charging/Battery
CONFIG_MFD_SM5703=y
CONFIG_REGULATOR_SM5703=y
CONFIG_CHARGER_SM5703=y
CONFIG_BATTERY_SAMSUNG=y
CONFIG_BATTERY_SAMSUNG_DATA_FILE="j5_battery_data.h"
CONFIG_SAMSUNG_LPM_MODE=y
CONFIG_FUELGAUGE_SM5703=y
CONFIG_BATTERY_SWELLING=y
CONFIG_PREVENT_SOC_JUMP=y

# DUAL SIM / SINGLE SIM Detection
CONFIG_CHECK_SIMSLOT_COUNT=y
# CONFIG_CHECK_SIMSLOT_COUNT_GPIO is not set
CONFIG_CHECK_SIMSLOT_COUNT_DT=y

# MMC
CONFIG_SEC_HYBRID_TRAY=y

# SSWAP
CONFIG_SWAP=y
CONFIG_FRONTSWAP=y
CONFIG_ZSMALLOC=y
CONFIG_ZSWAP=y

#APC CPR QUOTIENT
CONFIG_APC_CPR_QUOT_BOOST=y
```

## arch/arm/configs/msm8916_sec_j5xnlte_eur_defconfig
```kconfig
CONFIG_SEC_J5X_PROJECT=y
CONFIG_MACH_J5XLTE_EUR_OPEN=y

CONFIG_RESTART_REASON_SEC_PARAM=y

# SS Pinctrl Driver
CONFIG_SEC_GPIO_SETTINGS=y

# MUIC
CONFIG_SM5703_MUIC=y
CONFIG_USBID_STANDARD_VER_01=y
CONFIG_MUIC_SUPPORT_CHARGING_CABLE=y
CONFIG_MUIC_SUPPORT_RUSTPROOF=y
CONFIG_MUIC_SUPPORT_DESKDOCK=y

#USB Host
CONFIG_USB_HOST_NOTIFY=y

#Touch Screen
CONFIG_TOUCHSCREEN_IST30XXC_CMCS=y
#CONFIG_TOUCHSCREEN_ZINITIX_BT541=y
CONFIG_TOUCHSCREEN_TA_CALLBACK_ENABLE=y

#Touchkey
CONFIG_KEYBOARD_TC360_TKEY_J5X=y
CONFIG_KEYBOARD_TC305_TKEY=y
CONFIG_TOUCHKEY_GRIP=y

# Vibrator
#CONFIG_MSM_VIBRATOR is not set
CONFIG_SM5703_VIBRATOR=y

#LCD
CONFIG_PANEL_S6E8AA5X01_AMS520KT01_HD=y
CONFIG_SAMSUNG_DEBUG_DISPLAY=n

#SENSOR
CONFIG_SENSORS=y
CONFIG_SENSORS_CORE=y
CONFIG_SENSORS_K2HH=y
CONFIG_SENSORS_CM36672P=y
CONFIG_SENSORS_CM36672P_SMART_PERS=y
CONFIG_SENSORS_SX9310=y

#NFC
CONFIG_NFC=y
CONFIG_NFC_PN547=y
CONFIG_NFC_PN547_8916_USE_BBCLK2=y
CONFIG_NFC_PN547_8916_CLK_CTL=y
CONFIG_NFC_PN547_PVDD_EN_CONTROL=y

#FLASH
CONFIG_FLASHLIGHT=y
CONFIG_SM_FLASH_LED=y
CONFIG_FLED_SM5703=y
CONFIG_FLED_SM5703_EXT_GPIO=y
#CONFIG_FLED_LM3632 is not set
CONFIG_FLED_KTD2692=y
CONFIG_FRONT_FLASH=y

#CAMERA
CONFIG_S5K3L2XX=y
CONFIG_S5K5E3YX=y
CONFIG_SR552=y
CONFIG_CAMERA_SYSFS_V2=y
CONFIG_SW_LANDING_FOR_MULTI_TASKING=y
CONFIG_MSM_FRONT_EEPROM=y
CONFIG_MSM_OTP=y

#HALL IC
CONFIG_SENSORS_HALL=y

#AUDIO
CONFIG_RADIO_IRIS=y
CONFIG_RADIO_IRIS_TRANSPORT=y

#optimize mmc block delay on resume
CONFIG_MMC_BLOCK_DEFERRED_RESUME=y

# Pre-power on alarm
# CONFIG_RTC_AUTO_PWRON is not set
# CONFIG_RTC_AUTO_PWRON_PARAM is not set

# IPSec
CONFIG_CRYPTO_NULL=y

# Charging/Battery
CONFIG_MFD_SM5703=y
CONFIG_REGULATOR_SM5703=y
CONFIG_CHARGER_SM5703=y
CONFIG_BATTERY_SAMSUNG=y
CONFIG_BATTERY_SAMSUNG_DATA_FILE="j5x_battery_data.h"
CONFIG_SAMSUNG_LPM_MODE=y
CONFIG_FUELGAUGE_SM5703=y
CONFIG_BATTERY_SWELLING=y
CONFIG_PREVENT_SOC_JUMP=y
CONFIG_SW_SELF_DISCHARGING=y
CONFIG_CHARGER_SM5703_DUALPATH=y

# DUAL SIM / SINGLE SIM Detection
CONFIG_CHECK_SIMSLOT_COUNT=y
# CONFIG_CHECK_SIMSLOT_COUNT_GPIO is not set
CONFIG_CHECK_SIMSLOT_COUNT_DT=y

# SSWAP
CONFIG_SWAP=y
CONFIG_FRONTSWAP=y
CONFIG_ZSMALLOC=y
CONFIG_ZSWAP=y
```
