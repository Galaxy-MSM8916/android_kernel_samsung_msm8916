## arch/arm/configs/msm8916_sec_o7lte_chnopen_defconfig
```kconfig
CONFIG_SEC_O7_PROJECT=y
CONFIG_MACH_O7_CHN_OPEN=y

# HARD RESET
CONFIG_RESTART_REASON_SEC_PARAM=y

# SS Pinctrl Driver
CONFIG_SEC_GPIO_SETTINGS=y

# MUIC
CONFIG_SM5703_MUIC=y
CONFIG_USBID_STANDARD_VER_01=y
CONFIG_MUIC_SUPPORT_CHARGING_CABLE=y
CONFIG_MUIC_SUPPORT_RUSTPROOF=y
CONFIG_MUIC_SUPPORT_DESKDOCK=y

#USB Host
CONFIG_USB_HOST_NOTIFY=y

#Touch Screen
CONFIG_TOUCHSCREEN_IST30XXC=y
CONFIG_TOUCHSCREEN_ZT7538_TS=y
CONFIG_INPUT_BOOSTER=y
CONFIG_INPUT_UINPUT=y
CONFIG_INPUT_GPIO=y
CONFIG_TOUCHSCREEN_TA_CALLBACK_ENABLE=y
CONFIG_DUAL_TOUCH_IC_CHECK=y

# Vibrator
CONFIG_SM5703_VIBRATOR=y

#LCD
CONFIG_PANEL_S6D7AA0X62_BV050HDM_HD_5_5=y
CONFIG_PANEL_ILI9881C_SKI550002_HD=y
CONFIG_MFD_LM3632=y

#SENSOR
CONFIG_SENSORS=y
CONFIG_SENSORS_CORE=y
CONFIG_SENSORS_K2HH=y
CONFIG_SENSORS_CM36672P=y
CONFIG_SENSORS_STK3013=y

#FLASH
CONFIG_FLASHLIGHT=y
CONFIG_SM_FLASH_LED=y
CONFIG_FLED_SM5703=y
CONFIG_FLED_SM5703_EXT_GPIO=y

#CAMERA
CONFIG_S5K3L2XX=y
CONFIG_S5K5E3YX=y
CONFIG_CAMERA_SYSFS_V2=y

#AUDIO
CONFIG_RADIO_IRIS=y
CONFIG_RADIO_IRIS_TRANSPORT=y
CONFIG_SW_100K_TO_GND=y

#optimize mmc block delay on resume
CONFIG_MMC_BLOCK_DEFERRED_RESUME=y

# Pre-power on alarm
CONFIG_RTC_AUTO_PWRON=y
CONFIG_RTC_AUTO_PWRON_PARAM=y

# IPSec
CONFIG_CRYPTO_NULL=y

# Charging/Battery
CONFIG_MFD_SM5703=y
CONFIG_REGULATOR_SM5703=y
CONFIG_CHARGER_SM5703=y
CONFIG_BATTERY_SAMSUNG=y
CONFIG_BATTERY_SAMSUNG_DATA_FILE="o7_battery_data.h"
CONFIG_SAMSUNG_LPM_MODE=y
CONFIG_FUELGAUGE_SM5703=y
CONFIG_BATTERY_SWELLING=y
CONFIG_SIOP_CHARGING_LIMIT_CURRENT=700
CONFIG_PREVENT_SOC_JUMP=y
CONFIG_CHARGER_SM5703_SOFT_START_CHARGING=y
CONFIG_CHARGER_SM5703_DUALPATH=y

# DUAL SIM / SINGLE SIM Detection
CONFIG_CHECK_SIMSLOT_COUNT=y
# CONFIG_CHECK_SIMSLOT_COUNT_GPIO is not set
CONFIG_CHECK_SIMSLOT_COUNT_DT=y

# MMC
# CONFIG_SEC_HYBRID_TRAY=y //O7_CHN_OPEN not support HYBRID TRAY

# SDP
CONFIG_SDP=y
CONFIG_SDP_VAULT=y

# RTCC v3
CONFIG_SWAP=y
CONFIG_ZSMALLOC=y
CONFIG_ZRAM=y
CONFIG_RUNTIME_COMPCACHE=y
CONFIG_KSWAPD_NOSWAP=y

# KSM
CONFIG_KSM=y
CONFIG_ADAPTIVE_KSM=y
CONFIG_AKSM_FB_NOTIFY=y

CONFIG_FEATURE_NFF=y

# ION MSM SYSTEM HEAP POOL LIMIT
CONFIG_ION_MSM_SYSTEM_HEAP_POOL_LIMIT=y

# MMAP read-around
CONFIG_MMAP_READAROUND_LIMIT=16
```

## arch/arm/configs/msm8916_sec_o7lte_swaopen_defconfig
```kconfig
CONFIG_SEC_O7_PROJECT=y
CONFIG_MACH_O7_SWA_OPEN=y

# HARD RESET
CONFIG_RESTART_REASON_SEC_PARAM=y

# SS Pinctrl Driver
CONFIG_SEC_GPIO_SETTINGS=y

# MUIC
CONFIG_SM5703_MUIC=y
CONFIG_USBID_STANDARD_VER_01=y
CONFIG_MUIC_SUPPORT_CHARGING_CABLE=y
CONFIG_MUIC_SUPPORT_RUSTPROOF=y
CONFIG_MUIC_SUPPORT_DESKDOCK=y

#USB Host
CONFIG_USB_HOST_NOTIFY=y

#Touch Screen
CONFIG_TOUCHSCREEN_IST30XXC=y
CONFIG_TOUCHSCREEN_ZT7538_TS=y

# Vibrator
CONFIG_SM5703_VIBRATOR=y

#LCD
CONFIG_PANEL_S6D7AA0X62_BV050HDM_HD_5_5=y
CONFIG_PANEL_ILI9881C_SKI550002_HD=y
CONFIG_MFD_LM3632=y

#SENSOR
CONFIG_SENSORS=y
CONFIG_SENSORS_CORE=y
CONFIG_SENSORS_K2HH=y
CONFIG_SENSORS_CM36672P=y
CONFIG_SENSORS_STK3013=y

#FLASH
CONFIG_FLASHLIGHT=y
CONFIG_SM_FLASH_LED=y
CONFIG_FLED_SM5703=y
CONFIG_FLED_SM5703_EXT_GPIO=y

#CAMERA
CONFIG_S5K3L2XX=y
CONFIG_S5K5E3YX=y
CONFIG_CAMERA_SYSFS_V2=y

#AUDIO
CONFIG_RADIO_IRIS=y
CONFIG_RADIO_IRIS_TRANSPORT=y

#optimize mmc block delay on resume
CONFIG_MMC_BLOCK_DEFERRED_RESUME=y

# Charging/Battery
CONFIG_MFD_SM5703=y
CONFIG_REGULATOR_SM5703=y
CONFIG_CHARGER_SM5703=y
CONFIG_BATTERY_SAMSUNG=y
CONFIG_BATTERY_SAMSUNG_DATA_FILE="o7_battery_data.h"
CONFIG_SAMSUNG_LPM_MODE=y
CONFIG_FUELGAUGE_SM5703=y
CONFIG_BATTERY_SWELLING=y
CONFIG_PREVENT_SOC_JUMP=y
CONFIG_CHARGER_SM5703_SOFT_START_CHARGING=y
CONFIG_CHARGER_SM5703_DUALPATH=y

# DUAL SIM / SINGLE SIM Detection
CONFIG_CHECK_SIMSLOT_COUNT=y
# CONFIG_CHECK_SIMSLOT_COUNT_GPIO is not set
CONFIG_CHECK_SIMSLOT_COUNT_DT=y

# SSWAP
CONFIG_SWAP=y
CONFIG_FRONTSWAP=y
CONFIG_ZSMALLOC=y
CONFIG_ZSWAP=y
```

## arch/arm/configs/msm8916_sec_rossa_spr_defconfig
```kconfig
CONFIG_SEC_ROSSA_PROJECT=y
CONFIG_MACH_ROSSA_SPR=y

# SS Pinctrl Driver
CONFIG_SEC_GPIO_SETTINGS=y

#sensor
# CONFIG_SENSORS_ADSP is not set
# CONFIG_SENSORS_BMA255 is not set
# CONFIG_SENSORS_GP2A030A is not set
# CONFIG_SENSORS_GP2A030A_PROX is not set
# CONFIG_SENSORS_HSCDTD008A is not set

#SENSOR
CONFIG_SENSORS_CORE=y
CONFIG_SENSORS_K2HH=y
CONFIG_SENSORS_K2HH_VDD=y
CONFIG_SENSORS_GP2A002=y

# MUIC
CONFIG_SM5502_MUIC=y
CONFIG_MUIC_SUPPORT_RUSTPROOF=y
# CONFIG_MUIC_SM5502_SUPPORT_LANHUB_TA is not set
CONFIG_USBID_STANDARD_VER_01=y

# VIBRATOR
CONFIG_MSM_VIBRATOR=y

#Touch Screen
CONFIG_TOUCHSCREEN_IST30XX_CORE3=y

#LCD
CONFIG_PANEL_HX8369B_BV045WVM_WVGA=y
CONFIG_CABC_TUNING=y
CONFIG_ESD_ERR_FG_RECOVERY=y
CONFIG_MDNIE_TFT_HIMAX=y

CONFIG_MFD_RT5033=y
CONFIG_MFD_RT5033_RESET_WA=n
CONFIG_MFD_RT5033_SLDO_VBUSDET=n
CONFIG_BATTERY_SAMSUNG=y
CONFIG_BATTERY_SAMSUNG_DATA_FILE="rossa_battery_data.h"
CONFIG_SAMSUNG_LPM_MODE=y
CONFIG_CHARGER_RT5033=y
CONFIG_FUELGAUGE_RT5033=y
CONFIG_REGULATOR_RT5033=y

# Pre-power on alarm


#CAMERA
CONFIG_S5K5E3YX=y
CONFIG_MSM_OTP=y
CONFIG_SR552=y

#optimize mmc block delay on resume
CONFIG_MMC_BLOCK_DEFERRED_RESUME=y

#front cam
CONFIG_SR200PC20=y

#FLASH
CONFIG_FLASHLIGHT=y
CONFIG_RT_FLASH_LED=y
CONFIG_FLED_RT5033=y
CONFIG_FLED_RT5033_EXT_GPIO=y

# RTCC v3
CONFIG_SWAP=y
CONFIG_ZSMALLOC=y
CONFIG_ZRAM=y
CONFIG_RUNTIME_COMPCACHE=y
CONFIG_KSWAPD_NOSWAP=y

#LEDS
CONFIG_LEDS_KTD2026=y

# TIMA LOG
CONFIG_ARCH_MSM8916_TIMA=y
```

## arch/arm/configs/msm8916_sec_serranove3g_eur_defconfig
```kconfig
CONFIG_SEC_SERRANOVE_PROJECT=y
CONFIG_MACH_SERRANOVE3G_EUR_OPEN=y
CONFIG_RESTART_REASON_SEC_PARAM=y
# MUIC
CONFIG_SM5502_MUIC=y
CONFIG_SM5504_MUIC=y
CONFIG_MUIC_SUPPORT_RUSTPROOF=y
CONFIG_USBID_STANDARD_VER_01=y
CONFIG_USB_XHCI_HCD=y
CONFIG_USB_OTG_WAKELOCK=y
CONFIG_MUIC_SUPPORT_CHARGING_CABLE=y

CONFIG_SEC_GPIO_SETTINGS=y

#HALL IC
CONFIG_SENSORS_HALL=y

#VIBTONZ
CONFIG_QPNP_VIBRATOR=y

#AUDIO
# CONFIG_AUDIO_SPEAKER_OUT_NXP_AMP_ENABLE is not set
CONFIG_AUDIO_QUAT_I2S_ENABLE=y
#CONFIG_RADIO_IRIS=y
#CONFIG_RADIO_IRIS_TRANSPORT=m

#IIO
CONFIG_IIO=y
CONFIG_ST_LSM6DS3_IIO=y
CONFIG_IIO_BUFFER=y
CONFIG_IIO_TRIGGER=y
CONFIG_IIO_BUFFER_CB=y
CONFIG_IIO_TRIGGERED_BUFFER=y
CONFIG_IIO_KFIFO_BUF=y

#SENSORS
CONFIG_INPUT=y
CONFIG_INPUT_MISC=y
CONFIG_INPUT_GPIO=y
CONFIG_INPUT_POLLDEV=y

#SENSORS
CONFIG_SENSORS=y
CONFIG_SENSORS_CORE=y
CONFIG_SENSORS_USE_SYMLINK=y
CONFIG_SYSFS=y
CONFIG_SENSORS_GP2A030_IIO=y
CONFIG_SENSORS_YAS_MAGNETOMETER=y

#DISPLAY
CONFIG_PANEL_S6E88A0_AMS427AP24_QHD=y

#INPUT (TSP, Touchkey)
CONFIG_TOUCHSCREEN_MXT336S=y
CONFIG_TOUCHSCREEN_ZINITIX_BT541=y
CONFIG_KEYBOARD_TC360_TKEY=y


#BATTERY
CONFIG_MFD_RT5033=y
CONFIG_MFD_RT5033_RESET_WA=y
CONFIG_BATTERY_SAMSUNG=y
CONFIG_BATTERY_SAMSUNG_DATA_FILE="serranovelte_battery_data.h"
CONFIG_SAMSUNG_LPM_MODE=y
CONFIG_CHARGER_RT5033=y
CONFIG_FUELGAUGE_RT5033=y
CONFIG_REGULATOR_RT5033=y
# CONFIG_BATTERY_SWELLING=y
CONFIG_SIOP_CHARGING_LIMIT_CURRENT=700


#CONFIG IR LED
CONFIG_SEC_FPGA_ICE40XX=y

#MMC
CONFIG_NO_DETECT_PIN=y

#CAMERA
CONFIG_S5K6A3YX=y
CONFIG_S5K4H5YB=y

# SSWAP
CONFIG_SWAP=y
CONFIG_FRONTSWAP=y
CONFIG_ZSMALLOC=y
CONFIG_ZSWAP=y

# CONFIG_AUDIO_EXT_CLK is not set
# CONFIG_SND_SOC_WCD_MBHC is not set
```

## arch/arm/configs/msm8916_sec_serranovelte_eur_defconfig
```kconfig
CONFIG_SEC_SERRANOVE_PROJECT=y
CONFIG_MACH_SERRANOVELTE_EUR_OPEN=y
CONFIG_RESTART_REASON_SEC_PARAM=y
# MUIC
CONFIG_SM5502_MUIC=y
CONFIG_SM5504_MUIC=y
CONFIG_MUIC_SUPPORT_RUSTPROOF=y
CONFIG_USBID_STANDARD_VER_01=y
CONFIG_USB_XHCI_HCD=y
CONFIG_USB_OTG_WAKELOCK=y
CONFIG_MUIC_SUPPORT_CHARGING_CABLE=y

CONFIG_SEC_GPIO_SETTINGS=y

#HALL IC
CONFIG_SENSORS_HALL=y

#VIBTONZ
CONFIG_QPNP_VIBRATOR=y

#AUDIO
# CONFIG_AUDIO_SPEAKER_OUT_NXP_AMP_ENABLE is not set
CONFIG_AUDIO_QUAT_I2S_ENABLE=y
#CONFIG_RADIO_IRIS=y
#CONFIG_RADIO_IRIS_TRANSPORT=m

#IIO
CONFIG_IIO=y
CONFIG_ST_LSM6DS3_IIO=y
CONFIG_IIO_BUFFER=y
CONFIG_IIO_TRIGGER=y
CONFIG_IIO_BUFFER_CB=y
CONFIG_IIO_TRIGGERED_BUFFER=y
CONFIG_IIO_KFIFO_BUF=y

#SENSORS
CONFIG_INPUT=y
CONFIG_INPUT_MISC=y
CONFIG_INPUT_GPIO=y
CONFIG_INPUT_POLLDEV=y

#SENSORS
CONFIG_SENSORS=y
CONFIG_SENSORS_CORE=y
CONFIG_SENSORS_USE_SYMLINK=y
CONFIG_SYSFS=y
CONFIG_SENSORS_GP2A030_IIO=y
CONFIG_SENSORS_YAS_MAGNETOMETER=y

#DISPLAY
CONFIG_PANEL_S6E88A0_AMS427AP24_QHD=y

#INPUT (TSP, Touchkey)
CONFIG_TOUCHSCREEN_MXT336S=y
CONFIG_TOUCHSCREEN_ZINITIX_BT541=y
CONFIG_KEYBOARD_TC360_TKEY=y


#BATTERY
CONFIG_MFD_RT5033=y
CONFIG_MFD_RT5033_RESET_WA=y
CONFIG_BATTERY_SAMSUNG=y
CONFIG_BATTERY_SAMSUNG_DATA_FILE="serranovelte_battery_data.h"
CONFIG_SAMSUNG_LPM_MODE=y
CONFIG_CHARGER_RT5033=y
CONFIG_FUELGAUGE_RT5033=y
CONFIG_REGULATOR_RT5033=y
# CONFIG_BATTERY_SWELLING=y
CONFIG_SIOP_CHARGING_LIMIT_CURRENT=700

#NFC
CONFIG_NFC_PN547=y
CONFIG_NFC_PN547_8916_USE_BBCLK2=y

CONFIG_CRYPTO_GCM=y
CONFIG_XFRM_USER=y
CONFIG_NET_KEY=y
CONFIG_INET=y 
CONFIG_IP_ADVANCED_ROUTER=y 
CONFIG_IP_MULTIPLE_TABLES=y 
CONFIG_INET_AH=y 
CONFIG_INET_ESP=y 
CONFIG_INET_IPCOMP=y 
CONFIG_INET_XFRM_MODE_TRANSPORT=y 
CONFIG_INET_XFRM_MODE_TUNNEL=y 
CONFIG_INET_XFRM_MODE_BEET=y 
CONFIG_IPV6=y 
CONFIG_INET6_AH=y 
CONFIG_INET6_ESP=y 
CONFIG_INET6_IPCOMP=y 
CONFIG_INET6_XFRM_MODE_TRANSPORT=y 
CONFIG_INET6_XFRM_MODE_TUNNEL=y 
CONFIG_INET6_XFRM_MODE_BEET=y 
CONFIG_IPV6_MULTIPLE_TABLES=y 
CONFIG_NETFILTER=y 
CONFIG_NETFILTER_XTABLES=y 
CONFIG_NETFILTER_XT_MATCH_POLICY=y


#
# Bluetooth deconfig
#
CONFIG_BT=y
# CONFIG_BT_RFCOMM=y is not set
# CONFIG_BT_RFCOMM_TTY=y is not set
# CONFIG_BT_BNEP=y is not set
# CONFIG_BT_BNEP_MC_FILTER=y is not set
# CONFIG_BT_BNEP_PROTO_FILTER=y is not set
CONFIG_BT_HIDP=y
CONFIG_HID_SUPPORT=y
CONFIG_HID=y
CONFIG_HIDRAW=y
# CONFIG_BT_HCISMD=y is not set
# CONFIG_BT_HCIUART=y is not set
# CONFIG_BT_HCIUART_H4=y is not set

# Special HID drivers
CONFIG_HID_A4TECH=y
CONFIG_HID_ACRUX=y
# CONFIG_HID_ACRUX_FF is not set
CONFIG_HID_APPLE=y
CONFIG_HID_BELKIN=y
CONFIG_HID_CHERRY=y
CONFIG_HID_CHICONY=y
CONFIG_HID_PRODIKEYS=y
CONFIG_HID_CYPRESS=y
CONFIG_HID_DRAGONRISE=y
CONFIG_HID_EMS_FF=y
CONFIG_HID_ELECOM=y
CONFIG_HID_EZKEY=y
CONFIG_HID_KEYTOUCH=y
CONFIG_HID_KYE=y
CONFIG_HID_UCLOGIC=y
CONFIG_HID_WALTOP=y
CONFIG_HID_GYRATION=y
CONFIG_HID_TWINHAN=y
CONFIG_HID_KENSINGTON=y
CONFIG_HID_LCPOWER=y
CONFIG_HID_LOGITECH=y
CONFIG_HID_MAGICMOUSE=y
CONFIG_HID_MICROSOFT=y
CONFIG_HID_MONTEREY=y
CONFIG_HID_MULTITOUCH=y
CONFIG_HID_NTRIG=y
CONFIG_HID_ORTEK=y
CONFIG_HID_PANTHERLORD=y
CONFIG_HID_PETALYNX=y
CONFIG_HID_PICOLCD=y
# CONFIG_HID_PICOLCD_FB is not set
# CONFIG_HID_PICOLCD_BACKLIGHT is not set
# CONFIG_HID_PICOLCD_LCD is not set
# CONFIG_HID_PICOLCD_LEDS is not set
CONFIG_HID_QUANTA=y
CONFIG_HID_ROCCAT=y
CONFIG_HID_ROCCAT_COMMON=y
CONFIG_HID_ROCCAT_ARVO=y
CONFIG_HID_ROCCAT_KONE=y
CONFIG_HID_ROCCAT_KONEPLUS=y
CONFIG_HID_ROCCAT_KOVAPLUS=y
CONFIG_HID_ROCCAT_PYRA=y
CONFIG_HID_SAMSUNG=y
CONFIG_HID_SYNAPTICS_BT=y
CONFIG_HID_SONY=y
CONFIG_HID_SUNPLUS=y
CONFIG_HID_GREENASIA=y
CONFIG_HID_SMARTJOYPLUS=y
CONFIG_HID_TOPSEED=y
CONFIG_HID_THRUSTMASTER=y
CONFIG_HID_WACOM=y
CONFIG_HID_WACOM_POWER_SUPPLY=y
CONFIG_HID_ZAGG=y
CONFIG_HID_ZEROPLUS=y
CONFIG_HID_ZYDACRON=y
CONFIG_SEC_NET_FILTER=y
CONFIG_MSM_EVENT_TIMER=y

#CONFIG IR LED
CONFIG_SEC_FPGA_ICE40XX=y

#MMC
CONFIG_NO_DETECT_PIN=y

# FLASH
CONFIG_FLASHLIGHT=y
CONFIG_RT_FLASH_LED=y
CONFIG_FLED_RT5033=y
CONFIG_FLED_RT5033_EXT_GPIO=y

#CAMERA
CONFIG_S5K6A3YX=y
CONFIG_S5K4H5YB=y

# SSWAP
CONFIG_SWAP=y
CONFIG_FRONTSWAP=y
CONFIG_ZSMALLOC=y
CONFIG_ZSWAP=y

# CONFIG_AUDIO_EXT_CLK is not set
# CONFIG_SND_SOC_WCD_MBHC is not set
```

## arch/arm/configs/msm8929_sec_j7_chncmcc_defconfig
```kconfig
CONFIG_SEC_J7_PROJECT=y
CONFIG_MACH_J7_CHN_CMCC=y

# GPIO SETTING
CONFIG_SEC_GPIO_SETTINGS=y

#INPUT MODULES
CONFIG_TOUCHSCREEN_IST30XXC=y
CONFIG_INPUT_UINPUT=y
CONFIG_INPUT_GPIO=y
CONFIG_TOUCHSCREEN_TA_CALLBACK_ENABLE=y

# MOTOR
CONFIG_SM5703_VIBRATOR=y

# HALL IC
CONFIG_SENSORS_HALL=y

# DUAL SIM / SINGLE SIM Detection
CONFIG_CHECK_SIMSLOT_COUNT=y
# CONFIG_CHECK_SIMSLOT_COUNT_GPIO is not set
CONFIG_CHECK_SIMSLOT_COUNT_DT=y


# MUIC
CONFIG_SM5703_MUIC=y
CONFIG_USBID_STANDARD_VER_01=y
CONFIG_MUIC_SUPPORT_RUSTPROOF=y
CONFIG_MUIC_SUPPORT_CHARGING_CABLE=y
CONFIG_MUIC_SUPPORT_DESKDOCK=y

#FLASH
CONFIG_FLASHLIGHT=y
CONFIG_SM_FLASH_LED=y
CONFIG_FLED_SM5703=y
CONFIG_FLED_SM5703_EXT_GPIO=y
CONFIG_FLED_LM3632=y
CONFIG_FLED_KTD2692=y

#CAMERA
CONFIG_S5K3L2XX=y
CONFIG_S5K5E3YX=y

# IFPMIC
# Charging/Battery
CONFIG_MFD_SM5703=y
CONFIG_REGULATOR_SM5703=y
CONFIG_CHARGER_SM5703=y
CONFIG_BATTERY_SAMSUNG=y
CONFIG_BATTERY_SAMSUNG_DATA_FILE="j7_battery_data.h"
CONFIG_SAMSUNG_LPM_MODE=y
CONFIG_FUELGAUGE_SM5703=y
CONFIG_BATTERY_SWELLING=y
CONFIG_SIOP_CHARGING_LIMIT_CURRENT=1000
CONFIG_PREVENT_SOC_JUMP=y

#LCD
CONFIG_PANEL_S6D7AA0X62_BV050HDM_HD_5_5=y
CONFIG_MFD_LM3632=y

#BATTERY
CONFIG_BATTERY_SWELLING=y

#AUDIO
#CONFIG_AUDIO_SPEAKER_OUT_NXP_AMP_ENABLE=y
#CONFIG_AUDIO_QUAT_I2S_ENABLE=y

#SENSOR
CONFIG_SENSORS_CORE=y
CONFIG_SENSORS_K2HH=y
# CONFIG_SENSORS_K2HH_VDD is not set
# CONFIG_SENSORS_CM36672P_PMIC_LEDA is not set
CONFIG_SENSORS_CM36672P=y

#DISPLAY
#CONFIG_PANEL_S6E3FA2_AMS549EH01_FHD is not set

# TIMA LOG
# CONFIG_ARCH_MSM8939_TIMA=y

#CAMERA
#CONFIG_MSM_OTP=y

# debugging more information
#CONFIG_DEBUG_FS=y

## CHINA
#configs for Wi-Fi WAPI
CONFIG_TARGET_LOCALE_CHN=y
CONFIG_WLAN_REGION_CODE=300

#MMC
#CONFIG_SEC_HYBRID_TRAY=y

#NFC
CONFIG_NFC=y
CONFIG_NFC_PN547=y
CONFIG_NFC_PN547_8916_USE_BBCLK2=y
CONFIG_NFC_PN547_8916_CLK_CTL=y

#Power off Alarm
CONFIG_RTC_AUTO_PWRON=y
CONFIG_RTC_AUTO_PWRON_PARAM=y

# SSWAP
CONFIG_SWAP=y
CONFIG_FRONTSWAP=y
CONFIG_ZSMALLOC=y
CONFIG_PGTABLE_MAPPING=y
CONFIG_ZSWAP=y
CONFIG_ZPOOL=y
CONFIG_DIRECT_RECLAIM_FILE_PAGES_ONLY=y
CONFIG_INCREASE_MAXIMUM_SWAPPINESS=y
CONFIG_FIX_INACTIVE_RATIO=y
CONFIG_TIGHT_PGDAT_BALANCE=y
CONFIG_VNSWAP=y
CONFIG_SWAP_ENABLE_READAHEAD=n
```
