## drivers/misc/tzdev/Kconfig
```kconfig
config TZDEV
	bool "Samsung TZ Based Secure OS Support"
	default n
	depends on ARM || ARM64
	help
	  Samsung TZ Based Secure OS interface driver

config QCOM_SCM_ARMV8
	bool "QC ARM8 scm call"
	depends on TZDEV
	default n
	help
	  Use scm_call2() to send SMC commands to BF

config TZDEV_32BIT_SECURE_KERNEL
	bool "Secure kernel works in 32bit mode"
	depends on TZDEV
	default y
	help
	  Defines which version of secure kernel is used

config TZDEV_USE_ARM_CALLING_CONVENTION
	bool "Comply to ARM calling convention"
	depends on TZDEV
	default y
	help
	  Comply to ARM calling convention. New software architectures use
	  EL3 code comply to this convention compared to old architectures
	  when Secure kernel contains non-compatible commands handler

config TZDEV_CMA
	bool "Allocate TrustZone environment CMA region"
	depends on TZDEV && (CMA || DMA_CMA) && !ARCH_MSM
	default n
	help
	  Use CMA region to allocate TrustZone environment memory

config TZDEV_MEMRESSZ
	hex "TrustZone environment memory reservation size"
	depends on TZDEV_CMA
	default 0x01000000
	help
	  Provide reservation of memory for usage in secure world - allocation size.

config TZDEV_MEMRESSZPROT
	hex "TrustZone environment memory reservation size - protected"
	depends on TZDEV_CMA
	help
	  Provide reservation of memory for usage in secure world - bootloader-protected size.

config TZDEV_MEMRESADDR
	hex "TrustZone environment memory reservation address"
	depends on TZDEV_CMA
	help
	  Provide reservation of memory for usage in secure world - allocation address.

config TZDEV_IWI_EVENT
	int "IWI_EVENT interrupt number"
	depends on TZDEV
	default 280 if ARCH_MSM
	default 125 if ARCH_EXYNOS3
	default 113 if ARCH_EXYNOS4
	default 501 if ARCH_EXYNOS5
	default 446 if ARCH_EXYNOS7

config TZDEV_IWI_PANIC
	int "IWI_PANIC interrupt number"
	depends on TZDEV
	default 0 if ARCH_MSM
	default 126 if ARCH_EXYNOS3
	default 114 if ARCH_EXYNOS4
	default 502 if ARCH_EXYNOS5
	default 447 if ARCH_EXYNOS7

config TZLOG
	bool "TZDEV LOGGER support"
	depends on TZDEV
	default n
	help
	  Enable support for Samsung Secure OS Logger

config TZLOG_POLLING
	bool "TZDEV LOGGER polling"
	depends on TZLOG
	default n
	help
	  Enable periodic logs polling by TZDEV

config TZLOG_POLLING_PERIOD
	int "TZDEV LOGGER polling period (in ms)"
	depends on TZLOG_POLLING
	default 100
	help
	  Define logs polling period in milliseconds. The resolution is 1/Hz ms
	  rounded down (e.g. for Hz = 100, value 117 would mean 110 ms period)

config TZLOG_PG_CNT
	int "TZDEV LOGGER per-CPU buffer size (in pages)"
	depends on TZLOG
	default 1
	help
	  Select TZDEV logger buffer size in pages per CPU.

config TZDEV_MULTI_CORE_AUX_CHANNELS
	bool "TZDEV multi aux channels"
	depends on TZDEV
	default n
	help
	  Enable usage of multi aux channels (for each cpu core). If disabled,
	  aux channel 0 is always used.

config TZDEV_MSM_CRYPTO_WORKAROUND
	bool
	default n

config TZDEV_QC_CRYPTO_CLOCKS_MANAGEMENT
	bool "TZDEV crypto clock management"
	depends on TZDEV && QCOM_SCM_ARMV8
	default n
	help
	  Enable QC HW crypto clock management.
          If TZDEV_QC_CRYPTO_CLOCKS_USR_MNG is set then
          QC HW clock disable/enable is done from User-space.
          If disabled, QC HW crypto clock management is not used.

config TZDEV_QC_CRYPTO_CLOCKS_USR_MNG
	bool "User crypto clock management"
	depends on TZDEV && QCOM_SCM_ARMV8 && TZDEV_QC_CRYPTO_CLOCKS_MANAGEMENT
	default n
	help
	  Enable QC HW crypto clock management from User space. If disabled,
	  QC HW clock disable/enable is done in TZDEV.

config TZASC_TEST
	tristate "TZASC test helper module"
	depends on TZDEV
	default n
	help
	Provide the way to allocate a region of DRAM suitable for protection by
	a TZASC, get its physical address, and mmap it into userspace.

config TZASC_TEST_PAGE_ORDER
	int "TZASC test page allocation order"
	depends on TZASC_TEST
	default 5
	help
	  Select TZASC test buffer page allocation order.

config TZPC_TEST
	tristate "TZPC test helper module"
	depends on TZDEV
	default n
	help
	Provide the way to try access to SSS device.

config TZ_MEMDUMP_TEST
	tristate "TZ memdump test helper module"
	default n
	help
	Provide the way to try to memdump from physical location.

config TZ_MMAP_TEST
	bool "TZ mmap test helper module"
	default n
	help
	Provide the way to get physical address of a location with known
	contents.

config EFUSE_TEST
	tristate "efuse test Kernel Module"
	default n
	help
	  Say Y to enable efuse test kernel modules.

config ION_FD2PHYS
	tristate "ION FD to physical address converter"
	depends on ION && (ARCH_EXYNOS || ARCH_MSM)
	default y
	help
	Provide a method for userspace to get physical address from ION buffer
	descriptor

config TZIRS
	bool "Integrity reporting system"
	depends on TZDEV
	default n
	help
	  Enable Integrity reporintg system for Samsung Secure OS

config TZTUI
	bool "Trusted user interface"
	depends on TZDEV
	default n
	help
	  Enable Trusted user interface support for Samsung Secure OS

config TZ_CORE_MIGRATION
	bool "Core migration"
	depends on TZDEV
	default n
	help
	  Enable Core migration functionality for Samsung Secure OS

config TZDEV_PAGE_MIGRATION
	bool "Page migration"
	depends on TZDEV
	default n
	help
	  Enable Page migration functionality for CMA Migration
```

## drivers/motor/Kconfig
```kconfig
menuconfig MSM_VIBRATOR
        tristate "MSM_VIBRATOR"
	default n
	help
	Say Y to enable MSM_VIBRATOR support.

menuconfig BLDC_VIBRATOR
        tristate "BLDC_VIBRATOR"
	default n
	help
	Say Y to enable BLDC_VIBRATOR support.


menuconfig SS_VIBRATOR
	tristate "SS_VIBRATOR"
	default n
	help
	  Say Y to enable SAMSUNG VIBRATOR support

menuconfig SM5703_VIBRATOR
        tristate "SM5703_VIBRATOR"
        default n
        help
          Say Y to enable SM5703_VIBRATOR support.
```

## drivers/muic/universal/Kconfig
```kconfig
#
# MUIC devices
#

comment "MUIC configs"

config MUIC_UNIVERSAL
  bool "UNIVERSAL MUIC"
	depends on USE_MUIC
	default n
	help
	  If you say yes here you will get support for various MUIC chips.

config MUIC_UNIVERSAL_SM5703
  bool "SM5703 MUIC"
	depends on USE_MUIC
	default n
	help
	  If you say yes here you will get support for the SM5703 MUIC chip.

config MUIC_UNIVERSAL_SM5705
	bool "SM5705 MUIC"
	depends on USE_MUIC
	default n
	help
	  If you say yes here you will get support for the SM5705 MUIC chip.

config MUIC_UNIVERSAL_SM5705_AFC
	bool "SM5705 MUIC AFC"
	depends on USE_MUIC
	default n
	help
	  If you say yes here you will get support for the SM5705 MUIC
	  AFC feature.

config MUIC_UNIVERSAL_SM5504
  bool "SM5504 MUIC"
	depends on USE_MUIC
	default n
	help
	  If you say yes here you will get support for the SM5504 MUIC chip.

config MUIC_PINCTRL
  bool "MUIC PINCTRL"
	depends on USE_MUIC
	default n
	help
	  If you say yes here you will get support for the Pinctrl in MUIC driver.
```

## drivers/nfc/Kconfig
```kconfig
#
# Near Field Communication (NFC) devices
#

menu "Near Field Communication (NFC) devices"
	depends on NFC

config NFC_PN533
	tristate "NXP PN533 USB driver"
	depends on USB
	help
	  NXP PN533 USB driver.
	  This driver provides support for NFC NXP PN533 devices.

	  Say Y here to compile support for PN533 devices into the
	  kernel or say M to compile it as module (pn533).

config NFC_WILINK
	tristate "Texas Instruments NFC WiLink driver"
	depends on TI_ST && NFC_NCI
	help
	  This enables the NFC driver for Texas Instrument's BT/FM/GPS/NFC
	  combo devices. This makes use of shared transport line discipline
	  core driver to communicate with the NFC core of the combo chip.

	  Say Y here to compile support for Texas Instrument's NFC WiLink driver
	  into the kernel or say M to compile it as module.

config NFC_MEI_PHY
	tristate "MEI bus NFC device support"
	depends on INTEL_MEI && NFC_HCI
	help
	  This adds support to use an mei bus nfc device. Select this if you
	  will use an HCI NFC driver for an NFC chip connected behind an
	  Intel's Management Engine chip.

	  If unsure, say N.

source "drivers/nfc/pn544/Kconfig"
source "drivers/nfc/microread/Kconfig"

source "drivers/nfc/felica/Kconfig"

endmenu

config NFC_QNCI
	bool "Qualcomm NCI based NFC Controller Driver for qca199x"
	depends on I2C
	select CRC_CCITT
	help
	  This enables the NFC driver for QCA199x based devices.
	  This is for i2c connected version. NCI protocol logic
	  resides in the usermode and it has no other NFC dependencies.

config NFC_NQ
	bool "Qualcomm NCI based NFC Controller Driver for NQx"
	depends on I2C
	select CRC_CCITT
	help
	  This enables the NFC driver for NQx based devices.
	  This is for i2c connected version. NCI protocol logic
	  resides in the usermode and it has no other NFC dependencies.

config NFC_PN547
	bool "NXP PN547 NFC Controller Driver"
	depends on I2C
	default n
	help
	  NXP PN547 Near Field Communication controller support.
	  This option enables device driver support for the NFC.
	  It is used by many services. NFC is fully controlled using I2C
	  to communicate the AP chip.


config NFC_PN547_8916_USE_BBCLK2
	bool "NXP PN547 NFC CLOCK Controller"
	depends on NFC_PN547
	default n
	help
	  NXP PN547 Near Field Communication controller support.
	  This option enables device driver support for the NFC.
	  It is used by many services. NFC is fully controlled using I2C
	  to communicate the AP chip.

config NFC_PN547_8916_CLK_CTL
	bool "NXP PN547 NFC CLOCK Control"
	depends on NFC_PN547
	default n
	help
	  NXP PN547 Near Field Communication controller support.
	  This option control the clock in suspend and resume.

config NFC_PN547_USE_EXTERNAL_LDO_VIO
	bool "NXP PN547 NFC POWER Control"
	depends on NFC_PN547
	default n
	help
	  NXP PN547 Near Field Communication controller support.
	  This option enables device driver support for the NFC.
	  It is used by PN547 device driver uses external LDO as VIO power supply.

config NFC_PN547_LDO_CONTROL
	bool "PN547 NFC LDO CONTROL"
	depends on NFC_PN547
	default n
	help
	  SAMSUNG PN547 NFC LDO CONTROL feature.
	  This feature provides support for NXP PN547 products.
	  You should select this feature if your NFC product uses ldo control of i2c.
	  Say Y here to compile support for NXP PN547 LDO CONTROL feature into the
	  kernel.

config NFC_PN547_PVDD_EN_CONTROL
	bool "PN547 NFC PVDD EN CONTROL"
	depends on NFC_PN547
	default n
	help
	  SAMSUNG PN547 NFC PVDD EN CONTROL feature.
	  This feature provides support for NXP PN547 products.
	  You should select this feature if your NFC product uses pvdd en pin.
	  Say Y here to compile support for NXP PN547 PVDD EN CONTROL feature into the
	  kernel.

config ESE_P61
	bool "NXP P61 ESE Controller Driver"
	depends on SPI
	default n
	help
	  NXP P61 eSE controller support.
	  This option enables device driver support for the eSE with NFC.
	  It is used by many services. eSE is fully controlled using SPI
	  to communication

config NFC_PN547_ESE_SUPPORT
	bool "NXP PN547 ESE SUPPORT"
	depends on NFC_PN547
	default n
	help
	  NXP PN547 Near Field Communication controller support.
	  This option enables device driver support for the NFC.
	  It is used by many services. NFC is fully controlled using I2C
	  to communication

config SEC_NFC_I2C
        tristate "SEC NFC driver for I2C interface"
        depends on I2C
        default n
        help
          Say yes if you want System LSI Near Field Communication driver.
          This is for spi connected version. If unsure, say N here.
          To compile this driver as a module, choose m here. The module will
          be called sec-nfc-i2c.

config SEC_NFC
        bool "Samsung NFC driver"
        default n
        help
          SAMSUNG NFC Driver.
          This driver provides support for SAMSUNG NFC products.
          You should select your NFC product and interface.

          Say Y here to compile support for SAMSUNG NFC driver into the
          kernel.

config ESE_P3
        bool "Oberthur ese driver"
		depends on SPI
		default n
		help
		  Oberthur Driver.
		  This driver provides support for LSI NXP combined ESE products.
		  You should select your NFC product and interface.

config ESE_SECURE
		  bool "ESE P3 SECURE"
		  depends on ESE_P3
		  default n
		  help
		  Oberthur driver ESE P3 SECURE MODE feature.
		  This feature provides support for ESE P3 products.
		  You should select this feature if your ESE product uses secure mode.
		  Say Y here to compile support for ESE P3 SECURE feature into the
		  kernel.

config ESE_SPI_GPIO_START
    depends on ESE_SECURE
	int "Ese spi gpio number start"
	default 0

config ESE_SPI_GPIO_END
    depends on ESE_SECURE
	int "Ese spi gpio number end"
	default 0

config ESE_MASTER_ID
	int "ESE master id"
	depends on ESE_SECURE
	default 0
	help
	  Master Id defined in ese dtsi file.
	  If master id is changed, you must set right master id number
	  in defconfig.

config ESE_SECURE_SPI_PORT
	int "ESE SECURE SPI PORT"
	depends on ESE_SECURE
	default 0
	help
	  SPI ID defined in ese dtsi file.
	  If SPI ID is changed, you must set right SPI id number
	  in defconfig.

choice
        prompt "SEC NFC Products"
        depends on SEC_NFC
        default SEC_NFC_PRODUCT_N5
config SEC_NFC_PRODUCT_N3
        bool "N3"
config SEC_NFC_PRODUCT_N5
        bool "N5"
endchoice

choice
        prompt "SEC NFC Interface"
        depends on SEC_NFC
        default SEC_NFC_IF_I2C
config SEC_NFC_IF_UART
        bool "UART"
config SEC_NFC_IF_I2C
        depends on I2C
        bool "I2C"
config SEC_NFC_IF_I2C_GPIO
        bool "I2C-GPIO (S/W-I2C)"
        select I2C_ALGOBIT
endchoice

config SEC_NFC_CLK_REQ
        bool "External clock control (RF clock)"
        depends on SEC_NFC_PRODUCT_N5
        default n
        help
          Driver controls NFC external clock.
          This option should be enabled to control NFC external clock.
          you should select if your NFC device requests exnternal clock.

          Say Y here to compile support for exnternal clock control in the kernel.

config SEC_NFC_IO_EN
        bool "SEC NFC IO EN"
	    depends on I2C
        default n

config BCM2079X_NFC_I2C
	tristate "BCM2079X NFC driver for I2C interface"
	depends on I2C
	default n
	---help---
	  Say yes if you want BCM2079X Near Field Communication driver.
	  This is for i2c connected version. If unsure, say N here.
	  To compile this driver as a module, choose m here. The module will be called bcm2079x-i2c.

config SEC_NFC_USE_8916_BBCLK2
	bool "BCM2079X NFC CLOCK Controller"
	depends on BCM2079X_NFC_I2C
	default n
	help
	  NXP PN547 Near Field Communication controller support.
	  This option enables device driver support for the NFC.
	  It is used by many services. NFC is fully controlled using I2C
	  to communicate the AP chip.
```
