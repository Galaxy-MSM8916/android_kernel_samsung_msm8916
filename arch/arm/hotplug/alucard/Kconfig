## arch/arm/hotplug/alucard/Kconfig
```kconfig
config ALUCARD_HOTPLUG
	bool "Enable alucard-hotplug cpu hotplug driver"
	default y
	help
	  Generic Alucard-hotplug cpu hotplug driver for ARM SOCs
```

## arch/arm/hotplug/intelliplug/Kconfig
```kconfig
config INTELLI_PLUG
	bool "Enable intelli-plug cpu hotplug driver"
	default y
	help
	  Generic Intelli-plug cpu hotplug driver for ARM SOCs
```

## arch/arm/hotplug/msmhotplug/Kconfig
```kconfig
config MSM_HOTPLUG
  	bool "MSM hotplug driver"
  	depends on HOTPLUG_CPU
  	default y
  	help
  	  The MSM hotplug driver controls on-/offlining of additional cores based
  	  on current cpu load.
```

## drivers/battery/Kconfig
```kconfig
config BATTERY_SAMSUNG
	tristate "samsung battery driver"
	help
	 Say Y to include support for samsung battery driver
	 This battery driver integrated all battery-related functions
	 To see battery-related functions,
	 refer to sec_charging_common.h

config BATTERY_SAMSUNG_DATA_FILE
	depends on BATTERY_SAMSUNG
	string "samsung battery data file"
	default "default_battery_data.h"
	help
	 Path to the battery data file.

config SLOW_CHARGING_CURRENT_STANDARD
	int "slow charging"
	depends on BATTERY_SAMSUNG
	default "1000"
	help
	 Value for standard of slow-charging.

config CHARGING_VZWCONCEPT
	tristate "VZW concept about the charging"
	default n
	depends on BATTERY_SAMSUNG
	help
	 Say Y to include support for the VZW concepts.

config BATTERY_SWELLING
	bool "prevent battery swelling"
	help
	 Say Y to include support for prevent battery swelling

config BATTERY_SWELLING_SELF_DISCHARGING
	bool "prevent battery swelling with self discharging"
	help
	  Say Y to include support for prevent battery swelling with self discharging

# Fuel Gauge
config FUELGAUGE_RT5033
	tristate "RT5033 fuel gauge driver"
	depends on BATTERY_SAMSUNG
	help
	 Say Y to include support
	 for Richtek RT5033 fuel gauge driver.
	 This driver source code implemented
	 all functions for RT5033 fuel gauge.

config FUELGAUGE_SM5703
	tristate "SM5703 fuel gauge driver"
	depends on BATTERY_SAMSUNG
	help
	 Say Y to include support
	 for SiliconMitus SM5703 fuel gauge driver.
	 This driver source code implemented
	 all functions for SM5703 fuel gauge.

config FUELGAUGE_DUMMY
	tristate "dummy fuel gauge driver"
	default n
	depends on BATTERY_SAMSUNG
	help
	 Say Y to include support
	 for dummy fuel gauge driver.
	 This driver source code implemented
	 skeleton source code for fuel gauge functions.

config FUELGAUGE_STC3117
	tristate "STC3117 fuel gauge driver"
	default n
	depends on BATTERY_SAMSUNG
	help
	 Say Y to include support
	 for STC3117 fuel gauge driver.
	 This driver source code implemented
	 all functions for STC3117 fuel gauge.

config FUELGAUGE_MAX17042
	tristate "MAX17042 fuel gauge driver"
	default n
	depends on BATTERY_SAMSUNG
	help
	 Say Y to include support
	 for MAXIM MAX17042 fuel gauge driver.
	 This fuel-gauge can be used in voltage-tracking mode
	 or coulomb-counting mode.

config FUELGAUGE_MAX17042_VOLTAGE_TRACKING
	tristate "use MAX17042 fuel gauge only as voltage tracking"
	default n
	depends on FUELGAUGE_MAX17042
	help
	 Say Y to use MAX17042 fuel gauge
	 only as voltage tracking.
	 This mode is for target that consumes low current
	 like smart-phone.

config FUELGAUGE_MAX17042_COULOMB_COUNTING
	tristate "use MAX17042 fuel gauge as coulomb counting (including voltage tracking)"
	default n
	depends on FUELGAUGE_MAX17042
	help
	 Say Y to use MAX17042 fuel gauge
	 as coulomb counting (including voltage tracking).
	 This mode is for target that consumes high current
	 like tablet.

config FUELGAUGE_MAX17048
	tristate "MAX17048 fuel gauge driver"
	default n
	depends on BATTERY_SAMSUNG
	help
	 Say Y to include support
	 for MAXIM MAX17048 fuel gauge driver.
	 This fuel-gauge can be used
	 only in voltage-tracking mode.

config FUELGAUGE_MAX17050
	tristate "MAX17050 fuel gauge driver"
	default n
	depends on BATTERY_SAMSUNG
	help
	 Say Y to include support
	 for MAXIM MAX17047 or MAX17050 fuel gauge driver.
	 This fuel-gauge can be used in voltage-tracking mode
	 or coulomb-counting mode.

config FUELGAUGE_MAX17050_VOLTAGE_TRACKING
	tristate "use MAX17050 fuel gauge only as voltage tracking"
	default n
	depends on FUELGAUGE_MAX17050
	help
	 Say Y to use MAX17050 fuel gauge
	 only as voltage tracking.
	 This mode is for target that consumes low current
	 like smart-phone.

config FUELGAUGE_MAX17050_COULOMB_COUNTING
	tristate "use MAX17050 fuel gauge as coulomb counting (including voltage tracking)"
	default n
	depends on FUELGAUGE_MAX17050
	help
	 Say Y to use MAX17050 fuel gauge
	 as coulomb counting (including voltage tracking).
	 This mode is for target that consumes high current
	 like tablet.

config FUELGAUGE_MAX77823
	tristate "MAX77823 fuel gauge driver"
	default n
	depends on BATTERY_SAMSUNG
	help
	 Say Y to include support
	 for MAXIM MAX17047 or MAX17050 fuel gauge driver.
	 This fuel-gauge can be used in voltage-tracking mode
	 or coulomb-counting mode.

config FUELGAUGE_MAX77823_VOLTAGE_TRACKING
	tristate "use MAX77823 fuel gauge only as voltage tracking"
	default n
	depends on FUELGAUGE_MAX77823
	help
	 Say Y to use MAX17050 fuel gauge
	 only as voltage tracking.
	 This mode is for target that consumes low current
	 like smart-phone.

config FUELGAUGE_MAX77823_COULOMB_COUNTING
	tristate "use MAX77823 fuel gauge as coulomb counting (including voltage tracking)"
	default n
	depends on FUELGAUGE_MAX77823
	help
	 Say Y to use MAX77823 fuel gauge
	 as coulomb counting (including voltage tracking).
	 This mode is for target that consumes high current
	 like tablet.

config FUELGAUGE_MAX77843
	tristate "MAX77843 fuel gauge driver"
	default n
	depends on BATTERY_SAMSUNG
	help
	 Say Y to include support
	 It is based on the MAX17050 fuel gauge driver.
	 This fuel-gauge can be used in voltage-tracking mode
	 or coulomb-counting mode.

config FUELGAUGE_MAX77843_COULOMB_COUNTING
	tristate "use MAX77843 fuel gauge as coulomb counting (including voltage tracking)"
	default n
	depends on FUELGAUGE_MAX77843
	help
	 Say Y to use MAX77843 fuel gauge
	 as coulomb counting (including voltage tracking).
	 This mode is for target that consumes high current
	 like tablet.

config FUELGAUGE_MAX77849
	tristate "MAX77849 fuel gauge driver"
	default n
	depends on BATTERY_SAMSUNG
	help
	 Say Y to include support
	 It is based on the MAX17050 fuel gauge driver.
	 This fuel-gauge can be used in voltage-tracking mode
	 or coulomb-counting mode.

config FUELGAUGE_MAX77849_VOLTAGE_TRACKING
	tristate "use MAX77849 fuel gauge only as voltage tracking"
	default n
	depends on FUELGAUGE_MAX77849
	help
	 Say Y to use MAX77849 fuel gauge
	 only as voltage tracking.
	 This mode is for target that consumes low current
	 like smart-phone.

config FUELGAUGE_MAX77849_COULOMB_COUNTING
	tristate "use MAX77849 fuel gauge as coulomb counting (including voltage tracking)"
	default n
	depends on FUELGAUGE_MAX77849
	help
	 Say Y to use MAX77849 fuel gauge
	 as coulomb counting (including voltage tracking).
	 This mode is for target that consumes high current
	 like tablet.

config FUELGAUGE_S2MU003
	tristate "S2MU003 fuel gauge driver"
	default n
	depends on BATTERY_SAMSUNG
	help
	 Say Y to include support
	 for S.LSI S2MU003 fuel gauge driver.

config PREVENT_SOC_JUMP
	tristate "prevent soc jump at full-charged"
	default n
	depends on BATTERY_SAMSUNG
	help
		Say Y to prevent soc jump

config FUELGAUGE_SM5705
	tristate "Siliconmitus SM5705 Fuel Gauge"
	default n
	depends on I2C
	help
	  SM5705 is fuel-gauge systems for lithium-ion (Li+) batteries
	  in handheld and portable equipment. The SM5705 is configured
	  to operate with a single lithium cell

# Charger

config CHARGER_DUMMY
	tristate "dummy charger driver"
	default n
	depends on BATTERY_SAMSUNG
	help
	 Say Y to include support
	 for dummy charger driver.
	 This driver source code implemented
	 skeleton source code for charger functions.

config CHARGER_MAX8903
	tristate "MAX8903 charger driver"
	default n
	depends on BATTERY_SAMSUNG
	help
	 Say Y to include support
	 for MAXIM MAX8903 charger driver.
	 This driver source code implemented
	 all functions for MAX8903 charger.

config CHARGER_SMB328
	tristate "SMB328 charger driver"
	default n
	depends on BATTERY_SAMSUNG
	help
	 Say Y to include support
	 for Summit SMB328 charger driver.
	 This driver source code implemented
	 all functions for SMB328 charger.

config CHARGER_SMB347
	tristate "SMB347 charger driver"
	default n
	depends on BATTERY_SAMSUNG
	help
	 Say Y to include support
	 for Summit SMB347 charger driver.
	 This driver source code implemented
	 all functions for SMB347 charger.

config CHARGER_SMB358
	tristate "SMB358 charger driver"
	default n
	depends on BATTERY_SAMSUNG
	help
	 Say Y to include support
	 for Summit SMB358 charger driver.
	 This driver source code implemented
	 all functions for SMB358 charger.

config CHARGER_BQ24157
	tristate "BQ24157 charger driver"
	default n
	depends on BATTERY_SAMSUNG
	help
	 Say Y to include support
	 for TI BQ24157 charger driver.
	 This driver source code implemented
	 all functions for BQ24157 charger.

config CHARGER_BQ24190
	tristate "BQ24190 charger driver"
	default n
	depends on BATTERY_SAMSUNG
	help
	 Say Y to include support
	 for TI BQ24190 charger driver.
	 This driver source code implemented
	 all functions for BQ24190 charger.

config CHARGER_BQ24191
	tristate "BQ24191 charger driver"
	default n
	depends on BATTERY_SAMSUNG
	help
	 Say Y to include support
	 for TI BQ24191 charger driver.
	 This driver source code implemented
	 all functions for BQ24191 charger.

config CHARGER_BQ24260
	tristate "BQ24260 charger driver"
	default n
	depends on BATTERY_SAMSUNG
	help
	 Say Y to include support
	 for TI BQ24260 charger driver.
	 This driver source code implemented
	 all functions for BQ24260 charger.

config CHARGER_SM5701
	tristate "SM5701 charger driver"
	depends on MFD_SM5701 && I2C
	default n
	help
	 Say Y to include support
	 for SiliconMitus SM5701 charger driver..

config CHARGER_MAX77693
	tristate "MAX77693 battery charger support"
	depends on MFD_MAX77693 && I2C
	help
	  Say Y here to enable support for the MAX77693 charger
	  MAX77693 incluse muic, pmic, haptic, led,
	  flash driver.
	  You have to define MFD_MAX77693

config CHARGER_MAX77823
	tristate "MAX77823 battery charger support"
	depends on BATTERY_SAMSUNG
	help
	 Say Y here to enable support for the MAX77823 charger

config CHARGER_MAX77803
	tristate "MAX77803 battery charger support"
	depends on MFD_MAX77803 && I2C
	help
	  Say Y here to enable support for the MAX77803 charger
	  MAX77803 incluse muic, pmic, haptic, led,
	  flash driver.
	  You have to define MFD_MAX77803

config CHARGER_MAX77804K
	tristate "MAX77804K battery charger support"
	depends on MFD_MAX77804K && I2C
	help
	  Say Y here to enable support for the MAX77804K charger
	  MAX77804K incluse muic, pmic, haptic, led,
	  flash driver.
	  You have to define MFD_MAX77804K

config CHARGER_MAX77843
        tristate "MAX77843 battery charger support"
        depends on MFD_MAX77843 && I2C
        help
          Say Y here to enable support for the MAX77843 charger
          MAX77843 incluse muic, pmic, haptic, led,
          flash driver.
          You have to define MFD_MAX77843

config CHARGER_MAX77849
        tristate "MAX77849 battery charger support"
        depends on MFD_MAX77849 && I2C
        help
          Say Y here to enable support for the MAX77849 charger
          MAX77849 incluse muic, pmic, haptic, led,
          flash driver.
          You have to define MFD_MAX77849

config CHARGER_MAX77888
        tristate "MAX77888 battery charger support"
        depends on MFD_MAX77888 && I2C
        help
          Say Y here to enable support for the MAX77888 charger
          MAX77888 incluse muic, pmic, haptic, led,
          flash driver.
          You have to define MFD_MAX77888

config CHARGER_S2MU003
	tristate "S2MU003 charger support"
	depends on (MFD_S2MU003) && I2C
	help
	  Say Y here to enable support for the S2MU003 charger
	  S2MU003 incluse pmic, led driver.
	  You have to define MFD_S2MU003

config CHARGER_RT5033
	tristate "RT5033 charger driver"
	default n
	help
	 Say Y to include support
	 for RT5033 charger driver.
	 This driver source code implemented
	 all functions for RT5033 charger.

config CHARGER_SM5418
	tristate "SM5418 charger driver"
	default n
	help
	 Say Y to include support
	 for SM5418 charger driver.
	 This driver source code implemented
	 all functions for SMB5418 charger.

config CHARGER_SM5703
	tristate "SM5703 charger driver"
	default n
	help
	 Say Y to include support
	 for SM5703 charger driver.
	 This driver source code implemented
	 all functions for SM5703 charger.

config CHARGER_SM5703_SOFT_START_CHARGING
	bool "SM5703 soft step charging"
	default n
	depends on CHARGER_SM5703
	help
	  Say Y here to enable support for SM5703 soft step charging
	  You have to define CHARGER_SM5703

config CHARGER_SM5703_DUALPATH
	bool "SM5703 dual path"
	default n
	depends on CHARGER_SM5703
	help
	  Say Y here to enable support for SM5703 dual path setting for removal model in S/W
	  You have to define CHARGER_SM5703

config CHARGER_SM5705
	tristate "SM5705 battery charger support"
	depends on BATTERY_SAMSUNG
	help
	  Say Y here to enable support for the SM5705 charger

config AFC_CHARGER_MODE
	bool "afc charging support in sec battery driver"
	default n
	depends on CHARGER_SM5705
	help
	  Say Y to include support for sec afc charging support

config SAMSUNG_LPM_MODE
	bool "Off charging mode support in sec battery driver"
	default n
	help
	  Say Y to include support for sec off charging support
	  This value defined at bootloader.
	  Before enable this feature,
	  implemet power off charging in the bootloader.

config SAMSUNG_BATTERY_ENG_TEST
	bool "enable ENG mode for battery test"
	default n
	help
	  Say Y to include support for battery test
	  enable this feature only ENG mode
	  this featuren must disabled user binary
	  stability test etc..

config SAMSUNG_BATTERY_FACTORY
	bool "enable for factory test"
	default n
	help
	  Say Y to include support for factory test
	  enable this feature only factory mode
	  this featuren must disabled user binary
	  stability test etc..

config SAMSUNG_BATTERY_DISALLOW_DEEP_SLEEP
	bool "Disallow deep sleep during charging"
	default n
	depends on BATTERY_SAMSUNG && (ARCH_MSM8974 || ARCH_APQ8084)
	help
	  Say Y to include support
	  Disallow deep sleep during charging for stablity.

config DISABLE_SAVE_CAPACITY_MAX
	bool "Disable to save capacity max in efs"
	default n
	depends on BATTERY_SAMSUNG
	help
		Say Y to include support to disable it
		capacity_max is saved in /efs/Battery/batt_capacity_max
		capacity_max is restored after boot up
		You can find the code in healthd

config SIOP_CHARGING_LIMIT_CURRENT
	int "Siop charging limit current"
	default 0
	help
	  set SIOP charging limit current.

config DISABLE_MINIMUM_SIOP_CHARGING
	bool "Minimum siop charging current limit"
	default n
	help
	  set minimum value of siop charging current limit to usb"

config EN_OOPS
	bool "enable oops filter"
	default n
	help
	  Say Y to enable oops filter

config MACH_KOR_EARJACK_WR
	bool "enable earjack-noise workaround"
	default n
	depends on BATTERY_SAMSUNG
	help
	  Say Y to enable earjack-noise workaround at charging

config STORE_MODE
	bool "enable store mode"
	default n
	help
	  Say Y to enable CONFIG_STORE_MODE
config SW_SELF_DISCHARGING
	bool "enable sw_self_discharging"
	default n
	help
	  Say Y to enable CONFIG_SW_SELF_DISCHARGING
```
