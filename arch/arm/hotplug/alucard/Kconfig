## drivers/media/platform/msm/camera_v2/Kconfig
```kconfig
config MSM_CAMERA_SENSOR
	    bool "Qualcomm MSM camera sensor support"
	    depends on MSMB_CAMERA
        ---help---
          This flag enables support for Camera Sensor.
          The sensor driver is capable of providing real time
          data for camera support. The driver support V4L2
          subdev APIs.

config MSM_CPP
        bool "Qualcomm MSM Camera Post Processing Engine support"
        depends on MSMB_CAMERA
        ---help---
          Enable support for Camera Post-processing Engine
          The Post processing engine is capable of scaling
          and cropping image. The driver support V4L2 subdev
          APIs.

config MSM_CCI
        bool "Qualcomm MSM Camera Control Interface support"
        depends on MSMB_CAMERA
        ---help---
          Enable support for Camera Control Interface driver only
          for those platforms that have hardware support. This driver
          is responsible for handling I2C read and write on the I2C
          bus. It is also responsible for synchronization with
          GPIO and data frames.

config MSM_CSI20_HEADER
        bool "Qualcomm MSM CSI 2.0 Header"
        depends on MSMB_CAMERA
        ---help---
          Enable support for CSI drivers to include 2.0
          header. This header has register macros and its
          values and bit mask for register configuration bits
          This config macro is required targets based on 8960,
          8930 and 8064 platforms.

config MSM_CSI22_HEADER
        bool "Qualcomm MSM CSI 2.2 Header"
        depends on MSMB_CAMERA
        ---help---
          Enable support for CSI drivers to include 2.2
          header. This header has register macros and its
          values and bit mask for register configuration bits
          This config macro is required targets based on 8610
          platform.

config MSM_CSI30_HEADER
        bool "Qualcomm MSM CSI 3.0 Header"
        depends on MSMB_CAMERA
        ---help---
          Enable support for CSI drivers to include 3.0
          header. This header has register macros and its
          values and bit mask for register configuration bits
          This config macro is required for targets based on
          8064 platforms.

config MSM_CSI31_HEADER
        bool "Qualcomm MSM CSI 3.1 Header"
        depends on MSMB_CAMERA
        ---help---
          Enable support for CSI drivers to include 3.0
          header. This header has register macros and its
          values and bit mask for register configuration bits
          This config macro is required for targets based on
          APQ8084 platform.

config MSM_CSIPHY
        bool "Qualcomm MSM Camera Serial Interface Physical receiver support"
        depends on MSMB_CAMERA
        ---help---
          Enable support for Camera Serial Interface
          Physical receiver. It deserializes packets and
          supports detection of packet start and stop
          signalling.

config MSM_CSID
        bool "Qualcomm MSM Camera Serial Interface decoder support"
        depends on MSMB_CAMERA
        ---help---
          Enable support for Camera Serial Interface decoder.
          It supports lane merging and decoding of packets
          based on cid which is mapped to a virtual channel
          and datatype.

config MSM_EEPROM
        bool "Qualcomm MSM Camera ROM Interface for Calibration support"
        depends on MSMB_CAMERA
        ---help---
          Enable support for ROM Interface for Calibration
          Provides interface for reading the Claibration data.
          and also provides support for writing data in case of FLASH ROM.
          Currently supports I2C, CCI and SPI protocol

config MSM_FRONT_EEPROM
        bool "Qualcomm MSM Camera ROM Interface for Calibration support"
        depends on MSMB_CAMERA
        ---help---
          Enable support for ROM Interface for Calibration
          Provides interface for reading the Claibration data.
          and also provides support for writing data in case of FLASH ROM.
          Currently supports I2C, CCI and SPI protocol

config MSM_OTP
        bool "Qualcomm MSM Camera ROM Interface for Calibration support"
        depends on MSMB_CAMERA
        ---help---
          Enable support for ROM Interface for Calibration
          Provides interface for reading the Claibration data.
          and also provides support for writing data

config MSM_ISPIF
        bool "Qualcomm MSM Image Signal Processing interface support"
        depends on MSMB_CAMERA
        ---help---
          Enable support for Image Signal Processing interface module.
          This module acts as a crossbar between CSID and VFE. Output
          of any CID of CSID can be routed to of of pixel or raw
          data interface in VFE.

config MSM_ISPIF_V1
        bool "Qualcomm MSM Image Signal Processing interface support"
        depends on MSMB_CAMERA
        ---help---
          Enable support for Image Signal Processing interface module.
          This module acts as a crossbar between CSID and VFE. Output
          of any CID of MSM_CSI22_HEADER can be routed to of pixel
          or raw data interface in VFE.

config SENSOR_8_BPP
        bool "8 bits per pixel YUV sensor output"
        depends on MSMB_CAMERA
        ---help---
          8 bits per pixel YUV sensor output.

config IMX134
	bool "Sensor IMX134 (BAYER 8M)"
	depends on MSMB_CAMERA
	---help---
		Sony 8 MP Bayer Sensor with auto focus, uses
		4 mipi lanes full resolution @30fps and
		HFR @60fps and @120fps,
		Video HDR support.

config IMX132
	bool "Sensor IMX132 (BAYER 2M)"
	depends on MSMB_CAMERA
	---help---
		Sony 2 MP Bayer Sensor with auto focus, uses
		2 mipi lanes, preview config = 1920 x 1080 at 30 fps,
		snapshot config = 1920 x 1080 at 30 fps,
		Video HDR support.

config SR352
        bool "Sensor for front camera"
        depends on MSMB_CAMERA
        default n
        ---help---
          Siliconfile 3MP sensor,
          Rear sensor.

config SR130PC20
        bool "Sensor for front camera"
        depends on MSMB_CAMERA
        default n
        ---help---
          Siliconfile 1.3MP sensor,
          Front sensor.

config OV9724
	bool "Sensor OV9724 (BAYER 2M)"
	depends on MSMB_CAMERA
	---help---
		OmniVision 2 MP Bayer Sensor, supports 2 mipi lanes,
		preview and snapshot config at 1280*720 at 30 fps,
		hfr video at 60, 90 and 120 fps. This sensor driver does
		not support auto focus.

config HI256
        bool "Hynix hi256 (YUV 2MP)"
        depends on MSMB_CAMERA
        ---help---
                OmniVision 8 MP Bayer Sensor with auto focus.uses
                2 mipi lanes, preview config = 1632*1224 30 fps,
                snapshot config = 3264 * 2448 at 18 fps.
                2 lanes max fps is 18, 4 lanes max fps is 24.

config OV5648
	bool "Sensor OV5648 (BAYER 5M)"
	depends on MSMB_CAMERA
	---help---
		OmniVision 5 MP Bayer Sensor, only use 1 mipi lane,
		preview set to 1296*972 at 30 fps,
		snapshot set to 2592*1944 at 12 fps,
		This sensor driver does not support auto focus.

config MT9M114
	bool "Sensor MT9M114 (YUV 1.26MP)"
	depends on MSMB_CAMERA
	---help---
		MT9M114 is Aptina YUV sensor. It supports 1.26 MP preview
		and snapshot. The preview and snapshot resolution shall be
		1280 * 270. It does not support auto focus. It supports
		few special effects like saturation.
config OV5645
	bool "Sensor OV5645 (YUV 5.0MP)"
	depends on MSMB_CAMERA
	---help---
		OV5645 is Omnivision YUV sensor. It supports 5.0 MP preview
		and snapshot. The preview and snapshot resolution shall be
		1280 * 270. It does not support auto focus. It supports
		few special effects like saturation.

config SR200PC20
	bool "Sensor for front camera"
	depends on MSMB_CAMERA
	default n
	---help---
	  Siliconfile 2.0MP sensor,
	  Front sensor.
config SR544
    bool "Sensor for back camera"
	depends on MSMB_CAMERA
	default n
	---help---
	5MP sensor
	Rear sensor

config SP1628
	bool "Sensor SP1628 (YUV 720P)"
	depends on MSMB_CAMERA
	---help---
		SP1628 is SuperPix YUV sensor. It supports 720P preview
		and snapshot. The preview and snapshot resolution shall be
		1280 * 270. It does not support auto focus. It supports
		few special effects like mono.

config GC0339
	bool "Sensor GC0339 (BAYER .3M)"
	depends on MSMB_CAMERA
	---help---
		gc0339 is a Galaxycore .3 MP Bayer Sensor.
		It supports 1 or 2 mipi lanes.
		Preview and snapshot resolution shall be 640*480 at 30 fps,
		It does not support auto focus.

config OV8825
	bool "OmniVision OV8825 (BAYER 8MP)"
	depends on MSMB_CAMERA
	---help---
		OmniVision 8 MP Bayer Sensor with auto focus.uses
		2 mipi lanes, preview config = 1632*1224 30 fps,
		snapshot config = 3264 * 2448 at 18 fps.
		2 lanes max fps is 18, 4 lanes max fps is 24.

config OV8865
	bool "OmniVision OV8865 (BAYER 8MP)"
	depends on MSMB_CAMERA
	---help---
		OmniVision 8 MP Bayer Sensor with auto focus.uses
		4 mipi lanes, preview config = 1632*1224 30 fps,
		snapshot config = 3264 * 2448 at 30 fps.
		Max fps is 30fps at 3264 * 2448, 60fps at 1632 * 1224

config s5k4e1
	bool "Sensor s5k4e1 (BAYER 5MP)"
	depends on MSMB_CAMERA
	---help---
		Samsung 5 MP Bayer Sensor. It uses 2 mipi lanes,
		supports 720P preview at 30 fps
		and QSXGA snapshot at 15 fps.
		This sensor driver does not support auto focus.

config S5K8B1YX
	bool "Sensor S5K8B1YX (BAYER 2M)"
	depends on MSMB_CAMERA
	---help---
		LSI 2 MP Bayer Sensor, supports 2 mipi lanes,
		preview and snapshot config at 1280*720 at 30 fps,
		hfr video at 60, 90 and 120 fps. This sensor driver does
		not support auto focus.

config S5K6A3YX
	bool "Sensor S5K6A3YX (BAYER 1.9M)"
	depends on MSMB_CAMERA
	---help---
		S.LSI. 2 MP Bayer Sensor, supports 2 mipi lanes,

config S5K4H5YB
	bool "Sensor S5K4H5YB (BAYER 8M)"
	depends on MSMB_CAMERA
	---help---
		S.LSI. 8 MP Bayer Sensor with auto focus, uses
		4 mipi lanes full resolution @30fps and

config S5K3L2XX
	bool "Sensor S5K3L2XX (BAYER 13M)"
	depends on MSMB_CAMERA
	---help---
		S.LSI. 13MP Bayer Sensor with auto focus, uses
		4 mipi lanes full resolution @30fps

config S5K3P3SX
	bool "Sensor S5K3P3SX (BAYER 16M)"
	depends on MSMB_CAMERA
	---help---
		S.LSI. 16MP Bayer Sensor with auto focus, uses
		4 mipi lanes full resolution @30fps

config S5K5E3YX
	bool "Sensor S5K5E3YX (BAYER 5M)"
	depends on MSMB_CAMERA
	---help---
		S.LSI. 5MP Bayer Sensor with auto focus, uses
		2 mipi lanes full resolution @30fps

config SR552
	bool "Sensor SR552 (BAYER 5M)"
	depends on MSMB_CAMERA
	---help---
		S.LSI. 5MP Bayer Sensor with auto focus, uses
		2 mipi lanes full resolution @30fps

config S5K4ECGX
	bool "Sensor s5k4ecgx (SOC 5MP)"
	depends on MSMB_CAMERA
	---help---
		Samsung 5 MP SOC Sensor. It uses 2 mipi lanes,
		Support auto focus, and flash

config OV12830
	bool "OmniVision OV12830 (BAYER 12MP)"
	depends on MSMB_CAMERA
	---help---
		OmniVision 12.8 MP Bayer Sensor with auto focus.uses
		4 mipi lanes, preview config = 2112 * 1500 at 30 fps,
		snapshot config = 4224 * 3000 at 15 fps.
		2 lanes max fps is 18, 4 lanes max fps is 24.

config MSM_V4L2_VIDEO_OVERLAY_DEVICE
	tristate "Qualcomm MSM V4l2 video overlay device"
	---help---
	  Enables support for the MSM V4L2 video
	  overlay driver. This allows video rendering
	  apps to render overlaid video using Video4Linux2
	  APIs, by using /dev/videoX device

config MSMB_JPEG
	tristate "Qualcomm MSM Jpeg Encoder Engine support"
        depends on MSMB_CAMERA && (ARCH_MSM8974 || ARCH_MSM8226 || ARCH_APQ8084 || ARCH_MSM8916 || ARCH_MSM)
	---help---
	  Enable support for Jpeg Encoder/Decoder
	  Engine for 8974.
	  This module serves as the common driver
	  for the JPEG 1.0 encoder and decoder.

config MSM_GEMINI
	tristate "Qualcomm MSM Gemini JPEG engine support"
	depends on MSMB_CAMERA && (ARCH_MSM7X30 || ARCH_MSM8X60 || ARCH_MSM8960)
	---help---
	  Enables support for the Gemini JPEG encoder engine for 8x60.

config SEC_CAMERA_TUNING
	bool "Generic Tuning Concept"
	---help---
	  Enable support for Tuning in eng Binary

config CAM_USE_EXT_VANA_GPIO
	bool "Samsung EXT_VANA_GPIO"
	depends on MSMB_CAMERA
	---help---
	  Board use external LDO controlled by GPIO.

config CAM_DISABLE_LPM_MODE
	bool "Camera is Disabled in LPM mode."
	depends on NFC_PN547
	default n
	---help---
	Because NFC HW limitation which should not be turned on L16.

config CAM_PN547_PVDD_EN_CONTROL
	bool "PN547 NFC PVDD EN CONTROL"
	depends on NFC_PN547
	default n
	help
	  SAMSUNG PN547 NFC PVDD EN CONTROL feature.
	  This feature provides support for NXP PN547 products.
	  You should select this feature if your NFC product uses pvdd en pin.
	  Say Y here to compile support for NXP PN547 PVDD EN CONTROL feature into the
	  kernel.

config SW_LANDING_FOR_MULTI_TASKING
	bool "SW Landing is applied during multi tasking"
	depends on ACTUATOR
	default n
	help
	  If Camera exit while multi tasking with call, actuator makes big noise.
	  SW landing is applied during multi tasking only.

config CAMERA_SYSFS_V2
	bool "CAMERA SYS"
	depends on MSMB_CAMERA
	---help---
	  CAMERA SYS.

config DB8221A
	bool "Sensor for front camera"
	depends on MSMB_CAMERA
	default n
	---help---
	  Dongbu HiTek 2.0MP sensor,
	  Front sensor.

config OIS
        tristate "External ois support"
        depends on MSMB_CAMERA
        default n
        ---help---
          Enables support for external ois module.

config CAM_DUAL_POWER_SEQ
	bool "Dual power up sequence enable"
	depends on MSMB_CAMERA
	---help---
		This flag will allow us to write dual power up sequence.

config FRONT_FLASH
	bool "Rear LEd and Front LED both USING"
	depends on MSMB_CAMERA
	---help---
		ONLY for Front FLASH Model using.
		Front LED for LM3632 or KTD2692 Rear LED SM5703.

config EEPROM_CAMERA_QUP_I2C
	bool "Read EEPROM data in camera module"
	depends on MSMB_CAMERA
	default n
	---help---
		If the eeprom data in camera module is not read successfully,
		it causes actuator to move lens to 0x00 position, which causes actuator noise.
```

## drivers/misc/bhy/Kconfig
```kconfig
#
# Makefile for Bosch sensors driver.
#
config SENSORS_BHI
	tristate "BHI sensor hub driver support"
	default n
	depends on I2C
	help
	  If you say yes here, you get support for Bosch Sensortec's
	  BHI sensor hub driver.
```
