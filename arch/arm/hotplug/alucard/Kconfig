## drivers/iio/prox/Kconfig
```kconfig
#
# prox IIO sensors
#
config SENSORS_GP2A030_IIO
	tristate "GP2A030 proximity sensor support"
	depends on IIO
	default n
	help
	  If you say yes here you get support for sharp Sensortec's
	  proximity sensors GP2A030.
```

## drivers/input/touchscreen/atmel_mxt/Kconfig
```kconfig
## ATMEL MXT336S touchscreen driver configuration#

config TOUCHSCREEN_MXT336S
	tristate "Atmel MaxTouch 336S"
	depends on I2C
	default n
	help
	  Say Y here to enable support for the Atmel MaxTouch 336 touch
	  controller.
	  
	  If unsure, say N.	  
	  
	  To compile this driver as a module, choose M here: the	  
	  module will be called mxt336S.	  
```

## drivers/input/touchscreen/cyttsp5_tma445a/Kconfig
```kconfig
#
# Cypress cyttsp5 touchscreen driver configuration
#

config TOUCHSCREEN_CYTTSP5_TMA445A
        tristate "Cypress TrueTouch Gen5 Touchscreen Driver"
	depends on I2C
	default n
        select TOUCHSCREEN_CYPRESS_CYTTSP5_MT_B
	help
          Core driver for Cypress TrueTouch(tm) Standard Product
          Geneartion5 touchscreen controllers.
	   Say Y here if you have a Cypress Gen5 touchscreen.
	   If unsure, say N.
	   To compile this driver as a module, choose M here.
```

## drivers/input/touchscreen/imagis_30xxc/Kconfig
```kconfig
#
# Imagis IST30XXC Touchscreen driver
#

config TOUCHSCREEN_IST30XXC
  tristate "IST30XXC I2C Touchscreen"
	depends on I2C
	help
	  Say Y here if you have the Imagis IST30XXC I2C touchscreen
	  connected to your system.
```

## drivers/input/touchscreen/imagis_core3/Kconfig
```kconfig
#
# Goodix IST30XX Touchscreen driver
#

config TOUCHSCREEN_IST30XX_CORE3
  tristate "IST30XX I2C Touchscreen"
	depends on I2C
	help
	  Say Y here if you have the Imagis IST30XX I2C touchscreen
	  connected to your system.
```

## drivers/input/touchscreen/melfas_mms400/Kconfig
```kconfig
#
# Kconfig for MELFAS MMS400 Touchscreen driver
#

if INPUT_TOUCHSCREEN

config TOUCHSCREEN_MELFAS_MMS438
        tristate "MELFAS MMS438 Touchscreen"
        depends on I2C
        help
          Say Y here if you have a MELFAS MMS438 touchscreen device in your system.

          If unsure, say N.

          To compile this driver as a module, choose M here: the module will be called mms_ts.

config TOUCHSCREEN_MELFAS_MMS449
        tristate "MELFAS MMS449 Touchscreen"
        depends on I2C
        help
          Say Y here if you have a MELFAS MMS449 touchscreen device in your system.

          If unsure, say N.

          To compile this driver as a module, choose M here: the module will be called mms_ts.

config TOUCHSCREEN_MELFAS_MMS458
        tristate "MELFAS MMS458 Touchscreen"
        depends on I2C
        help
          Say Y here if you have a MELFAS MMS458 touchscreen device in your system.

          If unsure, say N.

          To compile this driver as a module, choose M here: the module will be called mms_ts.

config TOUCHSCREEN_MELFAS_MMS492
        tristate "MELFAS MMS492 Touchscreen"
        depends on I2C
        help
          Say Y here if you have a MELFAS MMS492 touchscreen device in your system.

          If unsure, say N.

          To compile this driver as a module, choose M here: the module will be called mms_ts.

config TOUCHSCREEN_DUMP_MODE
        tristate "TSP dump mode"
        depends on I2C

endif
```

## drivers/input/touchscreen/zinitix/Kconfig
```kconfig
#
# Goodix IST30XX Touchscreen driver
#

config TOUCHSCREEN_ZINITIX_BT541
	tristate "ZINITIX BT541 I2C Touchscreen"
	depends on I2C
	help
	  Say Y here if you have Zinitix BT541 I2C touchscreen,
	  such as BT541, connected to your system.

	  If unsure, say N.

	  To compile this driver as a module, choose M here: the
	  module will be called BT541.
```

## drivers/input/touchscreen/zinitix_bt432/Kconfig
```kconfig
#
# Zinitix Touchscreen driver configuration
#

config TOUCHSCREEN_BT432_TS
	tristate "ZINITIX BT432 I2C touchscreen driver"
	depends on I2C
	default n
	help
	  Say Y here to enable BT432 I2C touchscreen support
```

## drivers/input/touchscreen/zinitix_bt532/Kconfig
```kconfig
#
# Zinitix BT532 Touchscreen driver
#

config TOUCHSCREEN_ZINITIX_BT532
	tristate "ZINITIX BT532 I2C Touchscreen"
	depends on I2C
	help
	  Say Y here if you have Zinitix BT541 I2C touchscreen,
	  such as BT532, connected to your system.

	  If unsure, say N.

	  To compile this driver as a module, choose M here: the
	  module will be called BT541.
```

## drivers/input/touchscreen/zinitix_j1/Kconfig
```kconfig
#
# Zinitix Touchscreen driver configuration
#

config TOUCHSCREEN_ZINITIX_BT432
	tristate "ZINITIX BT432 I2C touchscreen driver"
	depends on I2C
	default n
	help
	  Say Y here to enable BT432 I2C touchscreen support
```

## drivers/input/touchscreen/zinitix_zt7538/Kconfig
```kconfig
#
# Zinitix zt75xx Touchscreen driver configuration
#

config TOUCHSCREEN_ZT7538
	tristate "ZINITIX zt7538 I2C touchscreen driver"
	depends on I2C
	help
	  Say Y here if you have Zinitix zt7538 I2C touchscreen,
	  such as zt75xx, connected to your system.

	  If unsure, say N.

	  To compile this driver as a module, choose M here: the
	  module will be called zt7538.
```

## drivers/media/isdbt/Kconfig
```kconfig
config ISDBT
	bool "isdbt"
	default n

choice
	depends on ISDBT
	prompt "isdbt driver"
	default ISDBT_FC8300_SPI

	config ISDBT_FC8300_SPI
		bool "ISDBT_FC8300_SPI"

	config ISDBT_FC8180_SPI
		bool "ISDBT_FC8180_SPI"

endchoice

config ISDBT_F_TYPE_ANTENNA
	bool "isdbt F type antenna"
	default n
```
