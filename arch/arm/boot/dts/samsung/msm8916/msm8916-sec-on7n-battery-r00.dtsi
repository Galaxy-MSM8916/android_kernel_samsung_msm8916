/* Copyright (c) 2012, The Linux Foundation. All rights reserved.
 *
 * This program is free software; you can redistribute it and/or modify
 * it under the terms of the GNU General Public License version 2 and
 * only version 2 as published by the Free Software Foundation.
 *
 * This program is distributed in the hope that it will be useful,
 * but WITHOUT ANY WARRANTY; without even the implied warranty of
 * MERCHANTABILITY or FITNESS FOR A PARTICULAR PURPOSE.  See the
 * GNU General Public License for more details.
 */

/ {
	battery {
		status = "okay";
		compatible = "samsung,sec-battery";
		battery,vendor = "SDI SDI";
		battery,charger_name = "sm5703-charger";
		battery,fuelgauge_name = "sm5703-fuelgauge";
		battery,technology = <2>; /* POWER_SUPPLY_TECHNOLOGY_LION */

		battery,chip_vendor = "QCOM";
		battery,temp_adc_type = <1>; /* SEC_BATTERY_ADC_TYPE_AP */

		battery,polling_time = <10 30 30 30 3600>;

		battery,adc_check_count = <5>;

		battery,cable_check_type = <4>; /* SEC_BATTERY_CABLE_CHECK_PSY */
		battery,cable_source_type = <3>; /* SEC_BATTERY_CABLE_SOURCE_EXTERNAL */
		battery,event_waiting_time = <600>;
		battery,polling_type = <1>; /* SEC_BATTERY_MONITOR_ALARM */
		battery,monitor_initial_count = <3>;

		battery,battery_check_type = <1>; /* SEC_BATTERY_CHECK_ADC */
		battery,check_count = <0>;
		battery,check_adc_max = <1440000>;
		battery,check_adc_min = <0>;

		battery,ovp_uvlo_check_type = <3>; /* SEC_BATTERY_OVP_UVLO_CHGPOLLING */

		battery,thermal_source = <2>; /* SEC_BATTERY_THERMAL_SOURCE_ADC */

		battery,temp_table_adc = <27084 27490 28010 28574 29217 29960 30761 31676 32646 33708 34797 35896 36961
			37972 38164 38353 38538 38719 38935 39113 39451 39564 39730 40447 41045 41528>;
		battery,temp_table_data = <700 650 600 550 500 450 400 350 300 250 200 150 100
			50 40 30 20 10 0 (-10) (-30) (-40) (-50) (-100) (-150) (-200)>;
		battery,temp_check_type = <2>; /* SEC_BATTERY_TEMP_CHECK_TEMP */
		battery,temp_check_count = <1>;
		battery,temp_high_threshold_event = <550>;
		battery,temp_high_recovery_event = <500>;
		battery,temp_low_threshold_event = <(-50)>;
		battery,temp_low_recovery_event = <0>;
		battery,temp_high_threshold_normal = <550>;
		battery,temp_high_recovery_normal = <500>;
		battery,temp_low_threshold_normal = <(-50)>;
		battery,temp_low_recovery_normal = <0>;
		battery,temp_high_threshold_lpm = <550>;
		battery,temp_high_recovery_lpm = <500>;
		battery,temp_low_threshold_lpm = <(-50)>;
		battery,temp_low_recovery_lpm = <0>;
		battery,full_check_type = <2>; /* SEC_BATTERY_FULLCHARGED_FG_CURRENT */
		battery,full_check_type_2nd = <2>; /* SEC_BATTERY_FULLCHARGED_FG_CURRENT */
		battery,full_check_count = <2>;
		battery,chg_gpio_full_check = <0>;
		battery,chg_polarity_full_check = <1>;

		/* SEC_BATTERY_FULL_CONDITION_SOC |
		   SEC_BATTERY_FULL_CONDITION_NOTIMEFULL |
		   SEC_BATTERY_FULL_CONDITION_VCELL */
		battery,full_condition_type = <13>;
		battery,full_condition_soc = <93>;
		battery,full_condition_vcell = <4300>;

		battery,recharge_check_count = <3>;
		battery,recharge_condition_type = <4>; /* SEC_BATTERY_RECHARGE_CONDITION_VCELL */
		battery,recharge_condition_soc = <98>;
		battery,recharge_condition_vcell = <4340>;

		battery,charging_total_time = <21600>;
		battery,recharging_total_time = <5400>;
		battery,charging_reset_time = <0>;
		qcom,sec-battery-vadc = <&pm8916_vadc>;

		//battery,swelling_chg_current = <1500>;
		battery,swelling_high_chg_current = <2000>;
		battery,swelling_low_chg_current = <1500>;
		battery,swelling_full_check_current_2nd = <150>;

		battery,swelling_drop_float_voltage = <4200>;
		battery,swelling_high_rechg_voltage = <4150>;
		battery,swelling_low_rechg_voltage = <4050>;

		battery,self_discharging_temp_block = <600>;
		battery,self_discharging_volt_block = <4250>;
		battery,self_discharging_temp_recov = <550>;
		battery,self_discharging_temp_pollingtime = <400>;

			battery,input_current_limit = <1500 500 500 1500 500 1000 1000 500 500 1000 1000 1500 1500 500 1000 500 700 1000 500 1000 1500 500 500>;
			battery,fast_charging_current = <2000 0 500 2000 500 1000 1000 500 0 1200 2000 2000 2000 (-1) 1300 500 800 1300 500 1000 2000 0 0>;
			battery,full_check_current_1st = <200 0 200 200 200 200 200 200 0 200 200 200 200 0 200 200 200 200 200 200 200 0 0>;
			battery,full_check_current_2nd = <150 0 150 150 150 150 150 150 0 150 150 150 150 0 150 150 150 150 150 150 150 0 0>;

		charger{
			status = "disable";
			/* Charger */
			battery,charger_name = "sm5703-charger";
			battery,chg_gpio_en = <&msm_gpio 114 0x00>;
			battery,chg_polarity_en = <0>;
			battery,chg_gpio_status = <0>;
			battery,chg_polarity_status = <0>;
			battery,chg_float_voltage = <4390>;
			battery,ovp_uvlo_check_type = <3>; /* SEC_BATTERY_OVP_UVLO_CHGPOLLING */
			battery,full_check_type = <2>; /* SEC_BATTERY_FULLCHARGED_FG_CURRENT */

			battery,input_current_limit = <1500 500 500 1500 500 1000 1000 500 500 1000 1000 1500 1500 500 1000 500 700 1000 500 1000 1500 500 500>;
			battery,fast_charging_current = <2000 0 500 2000 500 1000 1000 500 0 1200 2000 2000 2000 (-1) 1300 500 800 1300 500 1000 2000 0 0>;
			battery,full_check_current_1st = <200 0 200 200 200 200 200 200 0 200 200 200 200 0 200 200 200 200 200 200 200 0 0>;
			battery,full_check_current_2nd = <150 0 150 150 150 150 150 150 0 150 150 150 150 0 150 150 150 150 150 150 150 0 0>;
		};
	};

	battery_params {
		battery,id = <0>; /* -1 means auto, detected by F/G */
		battery0,battery_type = <4400>; /* 4200 4350 4400 */
		battery0,battery_table0 = <0x1400 0x1B33 0x1CB6 0x1D64 0x1D80 0x1DEA 0x1E55 0x1E99 0x1EC7 0x1F01 0x1F2C 0x1F77 0x2027 0x20EE 0x22C1 0x2399>;
		battery0,battery_table1 = <0x1400 0x1B33 0x1CB6 0x1D64 0x1D80 0x1DEA 0x1E55 0x1E99 0x1EC7 0x1F01 0x1F2C 0x1F77 0x2027 0x20EE 0x22C1 0x2399>;
		battery0,battery_table2 = <0x00 0x3D 0xD7 0x18F 0x300 0x4CC 0x866 0xACC 0xC00 0xD33 0xDCC 0xE66 0x10CC 0x1333 0x1800 0x1812>;
		battery0,temp_std = <25>;
		battery0,temp_offset = <10>;
		battery0,temp_offset_cal = <0x01>;
		battery0,charge_offset_cal = <(-0x2)>;
		battery0,rce_value = <0x0749 0x0580 0x371>;
		battery0,dtcd_value = <0x1>;
		battery0,rs_value = <0x1ae 0x47a 0x3800 0x00a4>; /*rs mix_factor max min*/
		battery0,vit_period = <0x3506>;
		battery0,mix_value = <0x0503 0x0004>; /*mix_rate init_blank*/
		battery0,topoff_soc = <0x0 0x5>; /*disable soc*/
		battery0,volt_cal = <0x809E>;
		battery0,curr_cal = <0x7585>;
		battery0,tem_poff = <3350 50 3300 50>;
	};

};
