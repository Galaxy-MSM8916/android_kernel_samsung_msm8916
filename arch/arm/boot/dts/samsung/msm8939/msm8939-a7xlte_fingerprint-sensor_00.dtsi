/* Copyright (c) 2013-2014, The Linux Foundation. All rights reserved.
 *
 * This program is free software; you can redistribute it and/or modify
 * it under the terms of the GNU General Public License version 2 and
 * only version 2 as published by the Free Software Foundation.
 *
 * This program is distributed in the hope that it will be useful,
 * but WITHOUT ANY WARRANTY; without even the implied warranty of
 * MERCHANTABILITY or FITNESS FOR A PARTICULAR PURPOSE.  See the
 * GNU General Public License for more details.
 */

&soc {
	spi_0: spi@78b7000 { /* BLSP1 QUP3 */
		status = "ok";
		compatible = "qcom,spi-qup-v2";
		cell-index = <0>;
		reg-names = "spi_physical", "spi_bam_physical";
		reg = <0x78b7000 0x1000>,
				<0x7884000 0x23000>;
		interrupt-names = "spi_irq", "spi_bam_irq";
		interrupts = <0 97 0>, <0 238 0>;
		spi-max-frequency = <16000000>;
		#address-cells = <1>;
		#size-cells = <0>;

		qcom,infinite-mode = <0>;
		qcom,use-bam;
		qcom,use-pinctrl;
		qcom,ver-reg-exists;
		qcom,bam-consumer-pipe-index = <8>;
		qcom,bam-producer-pipe-index = <9>;
		qcom,master-id = <86>;

		pinctrl-names = "default", "sleep";
		pinctrl-0 = <&spi0_mosi0_active &spi0_miso0_active &spi0_cs0_active &spi0_clk0_active>;
		pinctrl-1 = <&spi0_mosi0_sleep &spi0_miso0_sleep &spi0_cs0_sleep &spi0_clk0_sleep>;

		clock-names = "iface_clk", "core_clk";
		clocks = <&clock_gcc clk_gcc_blsp1_ahb_clk>,
			<&clock_gcc clk_gcc_blsp1_qup3_spi_apps_clk>;

		vfsspi-spi@0 {
			compatible = "vfsspi,vfs7xxx";
			reg = <0>;
			spi-max-frequency = <9600000>;
			vfsspi-sleepPin = <&expander_gpios 10 0x00>;
			vfsspi-drdyPin = <&msm_gpio 28 0x01>;
			vfsspi-ldoPin = <&expander_gpios 8 0x00>;
			vfsspi-orient = <0>;
			vfsspi-ldocontrol= <1>;
			vfsspi-expander_call= <1>;
			vfsspi-min_cpufeq_limit = <1344000>;

			pinctrl-names = "default", "sleep", "idle";
			pinctrl-0 = <&vfsspi_drdypin_active>;
			pinctrl-1 = <&vfsspi_drdypin_suspend>;
			pinctrl-2 = <&vfsspi_drdypin_active>;
		};
	};
};
