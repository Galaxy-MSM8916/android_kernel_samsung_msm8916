/* Copyright (c) 2014, The Linux Foundation. All rights reserved.
 *
 * This program is free software; you can redistribute it and/or modify
 * it under the terms of the GNU General Public License version 2 and
 * only version 2 as published by the Free Software Foundation.
 *
 * This program is distributed in the hope that it will be useful,
 * but WITHOUT ANY WARRANTY; without even the implied warranty of
 * MERCHANTABILITY or FITNESS FOR A PARTICULAR PURPOSE.  See the
 * GNU General Public License for more details.
 */
/ {
	battery {
		status = "okay";
		compatible = "samsung,sec-battery";
		battery,vendor = "SDI SDI";
		battery,charger_name = "sm5703-charger";
		battery,fuelgauge_name = "sm5703-fuelgauge";
		battery,technology = <2>; /* POWER_SUPPLY_TECHNOLOGY_LION */

		battery,chip_vendor = "QCOM";
		battery,temp_adc_type = <1>; /* SEC_BATTERY_ADC_TYPE_AP */

		battery,polling_time = <10 30 30 30 3600>;

		battery,adc_check_count = <5>;

		battery,cable_check_type = <4>; /* SEC_BATTERY_CABLE_CHECK_PSY */
		battery,cable_source_type = <3>; /* SEC_BATTERY_CABLE_SOURCE_EXTERNAL */
		battery,event_waiting_time = <600>;
		battery,polling_type = <1>; /* SEC_BATTERY_MONITOR_ALARM */
		battery,monitor_initial_count = <3>;

		battery,battery_check_type = <0>; /* SEC_BATTERY_CHECK_NONE */
		battery,check_count = <0>;
		battery,check_adc_max = <1440>;
		battery,check_adc_min = <0>;

		battery,ovp_uvlo_check_type = <3>; /* SEC_BATTERY_OVP_UVLO_CHGPOLLING */

		battery,thermal_source = <2>; /* SEC_BATTERY_THERMAL_SOURCE_ADC */

		battery,temp_check_type = <2>; /* SEC_BATTERY_TEMP_CHECK_TEMP */
		battery,temp_check_count = <1>;
		battery,temp_high_threshold_event = <600>;
		battery,temp_high_recovery_event = <450>;
		battery,temp_low_threshold_event = <(-50)>;
		battery,temp_low_recovery_event = <0>;
		battery,temp_high_threshold_normal = <600>;
		battery,temp_high_recovery_normal = <450>;
		battery,temp_low_threshold_normal = <(-50)>;
		battery,temp_low_recovery_normal = <0>;
		battery,temp_high_threshold_lpm = <600>;
		battery,temp_high_recovery_lpm = <450>;
		battery,temp_low_threshold_lpm = <(-50)>;
		battery,temp_low_recovery_lpm = <0>;
		battery,full_check_type = <7>; /* SEC_BATTERY_FULLCHARGED_CHGPSY */
		battery,full_check_type_2nd = <7>; /* SEC_BATTERY_FULLCHARGED_CHGPSY */
		battery,full_check_count = <1>;
		battery,chg_gpio_full_check = <0>;
		battery,chg_polarity_full_check = <1>;

		/* SEC_BATTERY_FULL_CONDITION_SOC |
		   SEC_BATTERY_FULL_CONDITION_NOTIMEFULL |
		   SEC_BATTERY_FULL_CONDITION_VCELL */
		battery,full_condition_type = <13>;
		battery,full_condition_soc = <93>;
		battery,full_condition_vcell = <4300>;

		battery,recharge_check_count = <1>;
		battery,recharge_condition_type = <4>; /* SEC_BATTERY_RECHARGE_CONDITION_VCELL */
		battery,recharge_condition_soc = <98>;
		battery,recharge_condition_vcell = <4350>;

		battery,self_discharging_en;
		battery,factory_discharging = <&expander_gpios 13 0x00>;
		battery,force_discharging_limit = <600>;
		battery,force_discharging_recov = <550>;
		battery,self_discharging_voltage_limit = <4250>;
		battery,discharging_adc_max = <29864>;
		battery,discharging_adc_min = <25768>;
		battery,discharging_ntc_limit = <2750>;

		battery,charging_total_time = <21600>;
		battery,recharging_total_time = <5400>;
		battery,charging_reset_time = <0>;
		qcom,sec-battery-vadc = <&pm8916_vadc>;

		battery,swelling_chg_current = <1500>;
		battery,swelling_drop_float_voltage = <4200>;
		battery,swelling_high_rechg_voltage = <4150>;
		battery,swelling_low_rechg_voltage = <4050>;

		charger {
			status = "disable";
			/* Charger */
			battery,charger_name = "sm5703-charger";
			battery,chg_gpio_en = <&expander_gpios 5 0x00>;
			battery,is_1MHz_switching = <1>;
			battery,chg_polarity_en = <0>;
			battery,chg_gpio_status = <0>;
			battery,chg_polarity_status = <0>;
			battery,chg_float_voltage = <4400>;
			battery,chg_vbuslimit = <0>;
			battery,full_check_type = <7>; /* SEC_BATTERY_FULLCHARGED_CHGPSY */
			battery,full_check_type_2nd = <7>; /* SEC_BATTERY_FULLCHARGED_CHGPSY */

			battery,input_current_limit = <2000 500 500 2000 500 900 1000 500 500 1000 820 2000 2000 500 1300 300 700 1300 2000 300 80 2000 500 1000 1667>;
			battery,fast_charging_current = <1700 0 500 1700 500 1200 1000 500 0 1200 1000 1700 1700 0 1300 300 700 1300 1500 300 80 1700 0 1000 1700>;
			battery,full_check_current_1st = <200 0 200 200 200 200 200 200 0 200 200 200 200 0 200 200 200 200 200 200 200 200 0 200 200>;
			battery,full_check_current_2nd = <100 0 100 100 100 100 100 100 0 100 100 100 100 0 100 100 100 100 100 100 100 100 0 100 100>;
		};
	};

	battery_params {
		battery,id = <0>; /* -1 means auto, detected by F/G */
		battery0,battery_type = <4400>; /* 4200 4350 4400 */
		battery0,battery_table0 = <0x1400 0x1B33 0x1C9B 0x1D60 0x1D83 0x1DD4 0x1E12 0x1E73 0x1ECA 0x1F09 0x1F78 0x1FD5 0x2090 0x20F8 0x22CC 0x2400>;
		battery0,battery_table1 = <0x1400 0x1B33 0x1C9B 0x1D60 0x1D83 0x1DD4 0x1E12 0x1E73 0x1ECA 0x1F09 0x1F78 0x1FD5 0x2090 0x20F8 0x22CC 0x2400>;
		battery0,battery_table2 = <0x00 0x38 0x9C 0x138 0x271 0x445 0x61A 0x9C2 0xC33 0xD6B 0xEA4 0xFDC 0x124C 0x1385 0x1866 0x186C>;
		battery0,temp_std = <25>;
		battery0,temp_offset = <10>;
		battery0,temp_offset_cal = <0x01>;
		battery0,charge_offset_cal = <(-0x0B)>;
		battery0,rce_value = <0x0749 0x0580 0x371>;
		battery0,dtcd_value = <0x1>;
		battery0,rs_value = <0x1ae 0x47a 0x3800 0x00a4>; /*rs mix_factor max min*/
		battery0,vit_period = <0x350a>;
		battery0,mix_value = <0x0a03 0x0004>; /*mix_rate init_blank*/
		battery0,topoff_soc = <0x0 0x101>; /*enable soc*/
		battery0,volt_cal = <0x8000>;
		battery0,curr_cal = <0x7900>;
		battery0,tem_poff = <3380 100 3300 100>;
		battery0,ext_temp_cal = <1 10 1 1 1 7 3 2>;
	};
};
