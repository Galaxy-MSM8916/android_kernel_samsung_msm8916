/* Copyright (c) 2013, The Linux Foundation. All rights reserved.
 *
 * This program is free software; you can redistribute it and/or modify
 * it under the terms of the GNU General Public License version 2 and
 * only version 2 as published by the Free Software Foundation.
 *
 * This program is distributed in the hope that it will be useful,
 * but WITHOUT ANY WARRANTY; without even the implied warranty of
 * MERCHANTABILITY or FITNESS FOR A PARTICULAR PURPOSE.  See the
 * GNU General Public License for more details.
 */

/*---------------------------------------------------------------------------
 * This file is autogenerated file using gcdb parser. Please do not edit it.
 * Update input XML file to add a new entry or update variable in this file
 * VERSION = "1.0"
 *---------------------------------------------------------------------------*/
&mdss_mdp {
	dsi_sdc_hd_vid: qcom,mdss_dsi_sdc_hd_video {
		qcom,mdss-dsi-panel-name = "S6D7AA0X62 hd video mode dsi panel";
		label = "ss_dsi_panel_S6D7AA0X62_BV050HDM_HD";
		qcom,mdss-dsi-panel-controller = <&mdss_dsi0>;
		qcom,mdss-dsi-panel-type = "dsi_video_mode";
		qcom,mdss-dsi-panel-destination = "display_1";
		qcom,cont-splash-enabled;
		qcom,mdss-dsi-panel-framerate = <60>;
		qcom,mdss-dsi-virtual-channel-id = <0>;
		qcom,mdss-dsi-stream = <0>;
		qcom,mdss-dsi-panel-width = <720>;
		qcom,mdss-dsi-panel-height = <1280>;
		qcom,mdss-pan-physical-width-dimension = <72>; /* <Width> real size of panel in mm */
		qcom,mdss-pan-physical-height-dimension = <129>; /*<Height> real size of panel in mm */
		qcom,mdss-dsi-lp11-init;
		qcom,mdss-dsi-init-delay-us = <20000>;
		qcom,mdss-dsi-h-front-porch = <40>;
		qcom,mdss-dsi-h-back-porch = <96>;
		qcom,mdss-dsi-h-pulse-width = <24>;
		qcom,mdss-dsi-h-sync-skew = <0>;
		qcom,mdss-dsi-v-back-porch = <12>;
		qcom,mdss-dsi-v-front-porch = <16>;
		qcom,mdss-dsi-v-pulse-width = <4>;
		qcom,mdss-dsi-h-left-border = <0>;
		qcom,mdss-dsi-h-right-border = <0>;
		qcom,mdss-dsi-v-top-border = <0>;
		qcom,mdss-dsi-v-bottom-border = <0>;
		qcom,mdss-dsi-bpp = <24>;
		qcom,mdss-dsi-color-order = <0>;
		qcom,mdss-dsi-underflow-color = <0xff>;
		qcom,mdss-dsi-border-color = <0>;
		qcom,mdss-dsi-dma-trigger = "trigger_sw";
		qcom,mdss-dsi-mdp-trigger = "none";
		qcom,mdss-dsi-bl-min-level = <1>;
		qcom,mdss-dsi-bl-max-level = <255>;
		qcom,mdss-dsi-bl-pmic-control-type = "bl_ctrl_dcs";
		qcom,mdss-dsi-lane-0-state;
		qcom,mdss-dsi-lane-1-state;
		qcom,mdss-dsi-lane-2-state;
		qcom,mdss-dsi-lane-3-state;
		qcom,mdss-dsi-bllp-eof-power-mode;
		qcom,mdss-dsi-bllp-power-mode;
		qcom,mdss-dsi-traffic-mode = "burst_mode";
		qcom,mdss-dsi-force-clk-lane-hs;
		qcom,mdss-dsi-reset-sequence = <1 20>, <0 1>, <1 20>;
		qcom,mdss-dsi-h-sync-pulse = <0>;
/*		qcom,mdss-dsi-hfp-power-mode;*/
		qcom,mdss-dsi-hbp-power-mode;
/*		qcom,mdss-dsi-hsa-power-mode;*/
		qcom,mdss-dsi-panel-timings = [8B 1A 10 00 3E 40 16 1E 15 03 04 00];
		qcom,mdss-dsi-t-clk-pre = <0x1B>;
		qcom,mdss-dsi-t-clk-post = <0x04>;
		qcom,mdss-dsi-on-command = [
               39 01 00 00 00 00 03 F0 5A 5A
               39 01 00 00 00 00 03 F1 5A 5A
               39 01 00 00 00 00 03 FC A5 A5
               39 01 00 00 00 00 03 D0 00 10
               39 01 00 00 00 00 02 B1 12
               39 01 00 00 00 00 05 B2 14 22 2F 18
               39 01 00 00 00 00 02 B3 11
               39 01 00 00 00 00 0A BA 03 19 19 11 03 05 18 18 77
               39 01 00 00 00 00 04 BC 00 4E 0B
               39 01 00 00 00 00 04 C0 80 80 30
               39 01 00 00 01 00 02 C1 01	/* CABC(MIE) off & manual dimming off */
               39 01 00 00 0A 00 02 C2 00
               39 01 00 00 00 00 04 C3 40 00 28
               39 01 00 00 00 00 09 EE A8 00 95 00 A8 00 95 00
               39 01 00 00 00 00 06 F2 02 10 10 6F 32
               39 01 00 00 00 00 0B F3 01 93 20 22 80 05 25 3C 26 00
               39 01 00 00 00 00 21 F7 01 1B 08 0C 09 0D 01 01 01 04 06
			01 01 00 00 1A 01 1B 0A 0E 0B 0F 01 01 01 05
			07 01 01 00 00 1A
               39 01 00 00 00 00 12 EF 34 12 98 BA 10 80 24 80 80 80 00
			00 00 44 A0 82 00
               39 01 00 00 00 00 07 F6 60 25 05 00 00 03
               39 01 00 00 00 00 0E CD 2E 2E 2E 2E 2E 2E 2E 2E 2E 2E 2E 2E 2E
		 39 01 00 00 00 00 0E CE 00 00 00 00 00 00 00 00 00 00 00 00 00
               39 01 00 00 00 00 02 53 24
               39 01 00 00 00 00 02 55 00
               39 01 00 00 00 00 12 FA 01 3F 09 0C 00 01 06 04 04 0C 10
			15 16 18 1C 20 2A
               39 01 00 00 00 00 12 FB 01 3F 09 0C 00 01 06 04 04 0C 10
			15 16 18 1C 20 2A
               39 01 00 00 00 00 03 F0 A5 A5
               39 01 00 00 00 00 03 F1 A5 A5
               39 01 00 00 00 00 03 FC 5A 5A
               05 01 00 00 78 00 02 11 00
               05 01 00 00 14 00 02 29 00
		];
		qcom,mdss-dsi-off-command = [
					39 01 00 00 00 00 02 22 00
					05 01 00 00 0A 00 02 28 00
					05 01 00 00 78 00 02 10 00
		];
		qcom,mdss-dsi-on-command-state = "dsi_lp_mode";
		qcom,mdss-dsi-off-command-state = "dsi_hs_mode";
		qcom,esd_irq_gpio = <&msm_gpio 60 0>;
		qcom,esd-check-enabled;
		qcom,mdss-dsi-panel-status-check-mode="reg_read_irq";
		qcom,mdss-dsi-panel-status-value = <1>;
		qcom,mdss-dsi-panel-status-irq-trigger="rising";
/*
 * ************************************************************************************************************************************
 *
 *
 *			Below  parameters are samsung dependent thigs
 *
 *
 * ************************************************************************************************************************************
 */
		samsung,mdnie-tuning-enable-tft;
		samsung,lcd-display-format-bgr;
		samsung,panel-vendor = "BOE";
		samsung,tft-common-support;
		samsung,level2_key_enable_tx_cmds_revA=[
			39 01 00 00 00 00 03 F0 5A 5A
		];
		samsung,level2_key_disable_tx_cmds_revA=[
			39 01 00 00 00 00 03 F0 A5 A5
		];
		samsung,packet_size_tx_cmds_revA = [
			37 01 00 00 00 00 02 07 00
		];
		/*
		 * First parameters can be changed
		 * by function of samsung_nv_read()
		 * because of that means offset of
		 * read position
		 */
		samsung,reg_read_pos_tx_cmds_revA = [
			15 01 00 00 00 00 02 B0 00
		];
		samsung,manufacture_id0_rx_cmds_revA = [06 01 00 00 00 00 01 da 03 00];
		samsung,manufacture_id1_rx_cmds_revA = [06 01 00 00 00 00 01 db 03 00];
		samsung,manufacture_id2_rx_cmds_revA = [06 01 00 00 00 00 01 dc 03 00];
/*
		* Command sets for CABC control
*/
		samsung,tft_pwm_tx_cmds_revA=[
			39 01 00 00 00 00 02 51 FF/*First command should be PWM duty change command*/
		];
		samsung,cabc_on_tx_cmds_revA = [
			39 01 00 00 00 00 02 55 01
		];
		samsung,cabc_off_tx_cmds_revA = [
			39 01 00 00 00 00 02 55 00
		];
		/*
		* ************************************************************************************************************************
		* Scaled level to index mappings
		* ************************************************************************************************************************
		*/
		samsung,scaled_level_map_table_revA = <
		/*<idx>	  <from>  <till> <scaled_level> */
			0		0		0		0
			1		1		2		2
			2		3		4		3
			3		5		7		5
			4		8		10		7
			5		11		13		9
			6		14		16		11
			7		17		19		13
			8		20		22		15
			9		23		25		17
			10		26		28		19
			11		29		31		21
			12		32		34		23
			13		35		37		25
			14		38		40		27
			15		41		43		29
			16		44		46		31
			17		47		49		33
			18		50		52		35
			19		53		55		37
			20		56		58		39
			21		59		61		41
			22		62		64		43
			23		65		67		45
			24		68		70		47
			25		71		73		49
			26		74		76		51
			27		77		79		53
			28		80		82		55
			29		83		85		57
			30		86		88		59
			31		89		91		61
			32		92		94		63
			33		95		97		65
			34		98		100		67
			35		101		103		69
			36		104		106		71
			37		107		109		73
			38		110		112		75
			39		113		115		77
			40		116		118		79
			41		119		121		81
			42		122		124		83
			43		125		127		85
			44		128		130		87
			45		131		133		89
			46		134		136		91
			47		137		139		93
			48		140		142		95
			49		143		145		97
			50		146		148		99
			51		149		151		102
			52		152		154		105
			53		155		157		108
			54		158		160		111
			55		161		163		114
			56		164		166		117
			57		167		169		120
			58		170		172		123
			59		173		175		126
			60		176		178		129
			61		179		181		132
			62		182		184		135
			63		185		187		138
			64		188		190		141
			65		191		193		144
			66		194		196		147
			67		197		199		150
			68		200		202		153
			69		203		205		156
			70		206		208		159
			71		209		211		162
			72		212		214		165
			73		215		217		168
			74		218		220		171
			75		221		223		174
			76		224		226		177
			77		227		229		180
			78		230		232		183
			79		233		235		186
			80		236		238		189
			81		239		241		192
			82		242		244		195
			83		245		247		198
			84		248		250		201
			85		251		253		204
			86		254		255		207
		>;
	};
};
