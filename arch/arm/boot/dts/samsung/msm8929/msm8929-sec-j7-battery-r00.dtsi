/* Copyright (c) 2015, The Linux Foundation. All rights reserved.
 *
 * This program is free software; you can redistribute it and/or modify
 * it under the terms of the GNU General Public License version 2 and
 * only version 2 as published by the Free Software Foundation.
 *
 * This program is distributed in the hope that it will be useful,
 * but WITHOUT ANY WARRANTY; without even the implied warranty of
 * MERCHANTABILITY or FITNESS FOR A PARTICULAR PURPOSE.  See the
 * GNU General Public License for more details.
 */

/ {
	battery {
		status = "okay";
		compatible = "samsung,sec-battery";
		battery,vendor = "SDI SDI";
		battery,charger_name = "sm5703-charger";
		battery,fuelgauge_name = "sm5703-fuelgauge";
		battery,technology = <2>; /* POWER_SUPPLY_TECHNOLOGY_LION */

		battery,chip_vendor = "QCOM";
		battery,temp_adc_type = <1>; /* SEC_BATTERY_ADC_TYPE_AP */

		battery,polling_time = <10 30 30 30 3600>;

		battery,adc_check_count = <5>;

		battery,cable_check_type = <4>; /* SEC_BATTERY_CABLE_CHECK_PSY */
		battery,cable_source_type = <3>; /* SEC_BATTERY_CABLE_SOURCE_EXTERNAL */
		battery,event_waiting_time = <600>;
		battery,polling_type = <1>; /* SEC_BATTERY_MONITOR_ALARM */
		battery,monitor_initial_count = <3>;

		battery,battery_check_type = <1>; /* SEC_BATTERY_CHECK_ADC */
		battery,check_count = <0>;
		battery,check_adc_max = <1440000>;
		battery,check_adc_min = <0>;

		battery,ovp_uvlo_check_type = <3>; /* SEC_BATTERY_OVP_UVLO_CHGPOLLING */

		battery,thermal_source = <2>; /* SEC_BATTERY_THERMAL_SOURCE_ADC */

		battery,temp_check_type = <2>; /* SEC_BATTERY_TEMP_CHECK_TEMP */
		battery,temp_check_count = <1>;
		battery,full_check_type = <2>; /* SEC_BATTERY_FULLCHARGED_FG_CURRENT */
		battery,full_check_type_2nd = <2>; /* SEC_BATTERY_FULLCHARGED_FG_CURRENT */
		battery,full_check_count = <2>;
		battery,chg_gpio_full_check = <0>;
		battery,chg_polarity_full_check = <1>;

		/* SEC_BATTERY_FULL_CONDITION_SOC |
		   SEC_BATTERY_FULL_CONDITION_NOTIMEFULL |
		   SEC_BATTERY_FULL_CONDITION_VCELL */
		battery,full_condition_type = <13>;
		battery,full_condition_soc = <93>;
		battery,full_condition_vcell = <4300>;

		battery,recharge_check_count = <2>;
		battery,recharge_condition_type = <4>; /* SEC_BATTERY_RECHARGE_CONDITION_VCELL */
		battery,recharge_condition_soc = <98>;
		battery,recharge_condition_vcell = <4350>;

		battery,charging_total_time = <21600>;
		battery,recharging_total_time = <5400>;
		battery,charging_reset_time = <0>;
		qcom,sec-battery-vadc = <&pm8916_vadc>;

		//battery,swelling_chg_current = <1500>;
		battery,swelling_high_chg_current = <2000>;
		battery,swelling_low_chg_current = <1500>;
		battery,swelling_full_check_current_2nd = <150>;
		battery,swelling_drop_float_voltage = <4200>;
		battery,swelling_high_rechg_voltage = <4160>;
		battery,swelling_low_rechg_voltage = <4060>;

		charger{
			status = "disable";
			/* Charger */
			battery,charger_name = "sm5703-charger";
			battery,chg_gpio_en = <&msm_gpio 33 0x00>;
			battery,chg_polarity_en = <0>;
			battery,chg_gpio_status = <0>;
			battery,chg_polarity_status = <0>;
			battery,chg_float_voltage = <4390>;
			battery,ovp_uvlo_check_type = <3>; /* SEC_BATTERY_OVP_UVLO_CHGPOLLING */
			battery,full_check_type = <2>; /* SEC_BATTERY_FULLCHARGED_FG_CURRENT */

			battery,input_current_limit = <1550 500 500 1550 500 1000 1000 500 500 1000 1000 1550 1550 500 1000 500 700 1000 500 1000 1550 500 500>;
			battery,fast_charging_current = <2000 0 500 2000 500 1000 1000 500 0 1200 2000 2000 2000 (-1) 1300 500 800 1300 500 1000 2000 0 0>;
			battery,full_check_current_1st = <200 0 200 200 200 200 200 200 0 200 200 200 200 0 200 200 200 200 200 200 200 0 0>;
			battery,full_check_current_2nd = <100 0 100 100 100 100 100 100 0 100 100 100 100 0 100 100 100 100 100 100 100 0 0>;
		};
	};

	battery_params {
		battery,id = <0>; /* -1 means auto, detected by F/G */
		battery0,battery_type = <4400>; /* 4200 4350 4400 */
		battery0,battery_table0 = <0x1400 0x1B33 0x1B5C 0x1D56 0x1DA3 0x1DB1 0x1E1D 0x1E4A 0x1E8E 0x1EFD 0x1F28 0x1F93 0x2035 0x20FD 0x22E1 0x2431>;
		battery0,battery_table1 = <0x1400 0x1B33 0x1B5C 0x1D56 0x1DA3 0x1DB1 0x1E1D 0x1E4A 0x1E8E 0x1EFD 0x1F28 0x1F93 0x2035 0x20FD 0x22E1 0x2431>;
		battery0,battery_table2 = <0x0 0x6 0x3D 0x133 0x1CD 0x300 0x4CD 0x600 0x999 0xC99 0xD33 0xE66 0x10CC 0x1333 0x1800 0x1806>;
		battery0,temp_std = <25>;
		battery0,temp_offset = <10>;
		battery0,temp_offset_cal = <0x01>;
		battery0,charge_offset_cal = <0x00>;
                battery0,rce_value = <0x0749 0x0580 0x371>;
                battery0,dtcd_value = <0x1>;
                battery0,rs_value = <0x1ae 0x47a 0x3800 0x00a4>; /*rs mix_factor max min*/
                battery0,vit_period = <0x350a>;
                battery0,mix_value = <0x0a03 0x0004>; /*mix_rate init_blank*/
                battery0,topoff_soc = <0x0 0x5>; /*disable soc*/
                battery0,volt_cal = <0x8000>;
		battery0,curr_cal = <0x7500>;
		battery0,tem_poff = <3420 100 3350 100>;
		battery0,ext_temp_cal = <1 10 1 1 1 7 2 2>;
	};
};
