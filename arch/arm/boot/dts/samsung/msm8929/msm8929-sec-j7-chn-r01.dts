/*
 * Copyright (c) 2015, The Linux Foundation. All rights reserved.
 *
 * This program is free software; you can redistribute it and/or modify
 * it under the terms of the GNU General Public License version 2 and
 * only version 2 as published by the Free Software Foundation.
 *
 * This program is distributed in the hope that it will be useful,
 * but WITHOUT ANY WARRANTY; without even the implied warranty of
 * MERCHANTABILITY or FITNESS FOR A PARTICULAR PURPOSE.  See the
 * GNU General Public License for more details.
 */

/dts-v1/;

#include "msm8929-sec-j7-chn-r01.dtsi"

/ {
	model = "MSM8929 SAMSUNG J7 CHN PROJECT REV01";
	compatible = "qcom,msm8929-cdp", "qcom,msm8929", "qcom,cdp";
	/*QCOM BOARD REV TYPE...*/
	/*qcom,board-id = <8 0>;*/
	/*SEC BOARD REV TYPE...*/
	qcom,board-id = <0x0C01FF01 1>;
	/*parm1)[31:20]platform_id [19:12]qc_hw_id [11:4]national code [3:0] operator, param2)SEC hw-rev*/
};

